// Generated by dts-visualizer
/ {
  compatible = rockchip,rk3566-firefly-roc-pc\0rockchip,rk3566;
  interrupt-parent = <0x01>;
  #address-cells = <0x02>;
  #size-cells = <0x02>;
  model = Firefly RK3566-ROC-PC MIPI (Linux);
  ddr_timing {
    compatible = rockchip,ddr-timing;
    ddr2_speed_bin = <0x00>;
    ddr3_speed_bin = <0x15>;
    ddr4_speed_bin = <0x0c>;
    pd_idle = <0x0d>;
    sr_idle = <0x5d>;
    sr_mc_gate_idle = <0x00>;
    srpd_lite_idle = <0x00>;
    standby_idle = <0x00>;
    auto_pd_dis_freq = <0x42a>;
    auto_sr_dis_freq = <0x320>;
    ddr2_dll_dis_freq = <0x12c>;
    ddr3_dll_dis_freq = <0x12c>;
    ddr4_dll_dis_freq = <0x271>;
    phy_dll_dis_freq = <0x190>;
    ddr2_odt_dis_freq = <0x64>;
    phy_ddr2_odt_dis_freq = <0x64>;
    ddr2_drv = <0x02>;
    ddr2_odt = <0x40>;
    phy_ddr2_ca_drv = <0x00>;
    phy_ddr2_ck_drv = <0x00>;
    phy_ddr2_dq_drv = <0x00>;
    phy_ddr2_odt = <0x00>;
    ddr3_odt_dis_freq = <0x14d>;
    phy_ddr3_odt_dis_freq = <0x14d>;
    ddr3_drv = <0x02>;
    ddr3_odt = <0x40>;
    phy_ddr3_ca_drv = <0x00>;
    phy_ddr3_ck_drv = <0x00>;
    phy_ddr3_dq_drv = <0x00>;
    phy_ddr3_odt = <0x00>;
    phy_lpddr2_odt_dis_freq = <0x14d>;
    lpddr2_drv = <0x02>;
    phy_lpddr2_ca_drv = <0x00>;
    phy_lpddr2_ck_drv = <0x00>;
    phy_lpddr2_dq_drv = <0x00>;
    phy_lpddr2_odt = <0x00>;
    lpddr3_odt_dis_freq = <0x14d>;
    phy_lpddr3_odt_dis_freq = <0x14d>;
    lpddr3_drv = <0x01>;
    lpddr3_odt = <0x02>;
    phy_lpddr3_ca_drv = <0x00>;
    phy_lpddr3_ck_drv = <0x00>;
    phy_lpddr3_dq_drv = <0x00>;
    phy_lpddr3_odt = <0x00>;
    lpddr4_odt_dis_freq = <0x14d>;
    phy_lpddr4_odt_dis_freq = <0x14d>;
    lpddr4_drv = <0x30>;
    lpddr4_dq_odt = <0x01>;
    lpddr4_ca_odt = <0x00>;
    phy_lpddr4_ca_drv = <0x00>;
    phy_lpddr4_ck_cs_drv = <0x00>;
    phy_lpddr4_dq_drv = <0x00>;
    phy_lpddr4_odt = <0x00>;
    ddr4_odt_dis_freq = <0x271>;
    phy_ddr4_odt_dis_freq = <0x271>;
    ddr4_drv = <0x00>;
    ddr4_odt = <0x200>;
    phy_ddr4_ca_drv = <0x00>;
    phy_ddr4_ck_drv = <0x00>;
    phy_ddr4_dq_drv = <0x00>;
    phy_ddr4_odt = <0x00>;
    phandle = <0x9f>;
  };
  aliases {
    csi2dphy0 = /csi2-dphy0;
    csi2dphy1 = /csi2-dphy1;
    csi2dphy2 = /csi2-dphy2;
    dsi0 = /dsi@fe060000;
    dsi1 = /dsi@fe070000;
    ethernet1 = /ethernet@fe010000;
    gpio0 = /pinctrl/gpio@fdd60000;
    gpio1 = /pinctrl/gpio@fe740000;
    gpio2 = /pinctrl/gpio@fe750000;
    gpio3 = /pinctrl/gpio@fe760000;
    gpio4 = /pinctrl/gpio@fe770000;
    i2c0 = /i2c@fdd40000;
    i2c1 = /i2c@fe5a0000;
    i2c2 = /i2c@fe5b0000;
    i2c3 = /i2c@fe5c0000;
    i2c4 = /i2c@fe5d0000;
    i2c5 = /i2c@fe5e0000;
    mmc0 = /sdhci@fe310000;
    mmc1 = /dwmmc@fe2b0000;
    mmc2 = /dwmmc@fe2c0000;
    mmc3 = /dwmmc@fe000000;
    serial0 = /serial@fdd50000;
    serial1 = /serial@fe650000;
    serial2 = /serial@fe660000;
    serial3 = /serial@fe670000;
    serial4 = /serial@fe680000;
    serial5 = /serial@fe690000;
    serial6 = /serial@fe6a0000;
    serial7 = /serial@fe6b0000;
    serial8 = /serial@fe6c0000;
    serial9 = /serial@fe6d0000;
    spi0 = /spi@fe610000;
    spi1 = /spi@fe620000;
    spi2 = /spi@fe630000;
    spi3 = /spi@fe640000;
    spi4 = /sfc@fe300000;
  };
  cpus {
    #address-cells = <0x02>;
    #size-cells = <0x00>;
    cpu@0 {
      device_type = cpu;
      compatible = arm,cortex-a55;
      reg = <0x00 0x00>;
      enable-method = psci;
      clocks = <0x02 0x00>;
      operating-points-v2 = <0x03>;
      cpu-idle-states = <0x04>;
      #cooling-cells = <0x02>;
      dynamic-power-coefficient = <0xbb>;
      cpu-supply = <0x05>;
      phandle = <0x09>;
    };
    cpu@100 {
      device_type = cpu;
      compatible = arm,cortex-a55;
      reg = <0x00 0x100>;
      enable-method = psci;
      clocks = <0x02 0x00>;
      operating-points-v2 = <0x03>;
      cpu-idle-states = <0x04>;
      phandle = <0x0a>;
    };
    cpu@200 {
      device_type = cpu;
      compatible = arm,cortex-a55;
      reg = <0x00 0x200>;
      enable-method = psci;
      clocks = <0x02 0x00>;
      operating-points-v2 = <0x03>;
      cpu-idle-states = <0x04>;
      phandle = <0x0b>;
    };
    cpu@300 {
      device_type = cpu;
      compatible = arm,cortex-a55;
      reg = <0x00 0x300>;
      enable-method = psci;
      clocks = <0x02 0x00>;
      operating-points-v2 = <0x03>;
      cpu-idle-states = <0x04>;
      phandle = <0x0c>;
    };
    idle-states {
      entry-method = psci;
      cpu-sleep {
        compatible = arm,idle-state;
        arm,psci-suspend-param = <0x10000>;
        entry-latency-us = <0x64>;
        exit-latency-us = <0x78>;
        min-residency-us = <0x3e8>;
        phandle = <0x04>;
      };
    };
  };
  cpu0-opp-table {
    compatible = operating-points-v2;
    mbist-vmin = <0xc96a8 0xdbba0 0xe7ef0>;
    nvmem-cells = <0x06 0x07 0x08>;
    nvmem-cell-names = leakage\0pvtm\0mbist-vmin;
    rockchip,pvtm-voltage-sel = <0x00 0x14050 0x00 0x14051 0x16b48 0x01 0x16b49 0x186a0 0x02>;
    rockchip,pvtm-freq = <0x639c0>;
    rockchip,pvtm-volt = <0xdbba0>;
    rockchip,pvtm-ch = <0x00 0x05>;
    rockchip,pvtm-sample-time = <0x3e8>;
    rockchip,pvtm-number = <0x0a>;
    rockchip,pvtm-error = <0x3e8>;
    rockchip,pvtm-ref-temp = <0x28>;
    rockchip,pvtm-temp-prop = <0x1a 0x1a>;
    rockchip,thermal-zone = soc-thermal;
    rockchip,temp-hysteresis = <0x1388>;
    rockchip,low-temp = <0x00>;
    rockchip,low-temp-adjust-volt = <0x00 0x648 0x124f8>;
    phandle = <0x03>;
    opp-408000000 {
      opp-hz = <0x00 0x18519600>;
      opp-microvolt = <0xc96a8 0xc96a8 0x118c30>;
      clock-latency-ns = <0x9c40>;
    };
    opp-600000000 {
      opp-hz = <0x00 0x23c34600>;
      opp-microvolt = <0xc96a8 0xc96a8 0x118c30>;
      clock-latency-ns = <0x9c40>;
    };
    opp-816000000 {
      opp-hz = <0x00 0x30a32c00>;
      opp-microvolt = <0xc96a8 0xc96a8 0x118c30>;
      clock-latency-ns = <0x9c40>;
    };
    opp-1104000000 {
      opp-hz = <0x00 0x41cdb400>;
      opp-microvolt = <0xc96a8 0xc96a8 0x118c30>;
      clock-latency-ns = <0x9c40>;
    };
    opp-1416000000 {
      opp-hz = <0x00 0x54667200>;
      opp-microvolt = <0xe1d48 0xe1d48 0x118c30>;
      clock-latency-ns = <0x9c40>;
    };
    opp-1608000000 {
      opp-hz = <0x00 0x5fd82200>;
      opp-microvolt = <0xf4240 0xf4240 0x118c30>;
      clock-latency-ns = <0x9c40>;
    };
    opp-1800000000 {
      opp-hz = <0x00 0x6b49d200>;
      opp-microvolt = <0x100590 0x100590 0x118c30>;
      clock-latency-ns = <0x9c40>;
    };
  };
  arm-pmu {
    compatible = arm,cortex-a55-pmu\0arm,armv8-pmuv3;
    interrupts = <0x00 0xe4 0x04 0x00 0xe5 0x04 0x00 0xe6 0x04 0x00 0xe7 0x04>;
    interrupt-affinity = <0x09 0x0a 0x0b 0x0c>;
  };
  cpuinfo {
    compatible = rockchip,cpuinfo;
    nvmem-cells = <0x0d 0x0e 0x0f>;
    nvmem-cell-names = id\0cpu-version\0cpu-code;
  };
  display-subsystem {
    compatible = rockchip,display-subsystem;
    memory-region = <0x10 0x11>;
    memory-region-names = drm-logo\0drm-cubic-lut;
    ports = <0x12>;
    devfreq = <0x13>;
    phandle = <0x12c>;
    route {
      route-dsi0 {
        status = okay;
        logo,uboot = logo.bmp;
        logo,kernel = logo_kernel.bmp;
        logo,mode = center;
        charge_logo,mode = center;
        connect = <0x14>;
        phandle = <0x12d>;
      };
      route-hdmi {
        status = okay;
        logo,uboot = logo.bmp;
        logo,kernel = logo_kernel.bmp;
        logo,mode = center;
        charge_logo,mode = center;
        connect = <0x17>;
        phandle = <0x130>;
      };
    };
  };
  firmware {
    optee {
      compatible = linaro,optee-tz;
      method = smc;
      phandle = <0x133>;
    };
    scmi {
      compatible = arm,scmi-smc;
      shmem = <0x1a>;
      arm,smc-id = <0x82000010>;
      #address-cells = <0x01>;
      #size-cells = <0x00>;
      phandle = <0x134>;
      protocol@14 {
        reg = <0x14>;
        #clock-cells = <0x01>;
        rockchip,clk-init = Tfr;
        phandle = <0x02>;
      };
    };
    sdei {
      compatible = arm,sdei-1.0;
      method = smc;
      phandle = <0x135>;
    };
  };
  mpp-srv {
    compatible = rockchip,mpp-service;
    rockchip,taskqueue-count = <0x06>;
    rockchip,resetgroup-count = <0x06>;
    status = okay;
    phandle = <0x68>;
  };
  psci {
    compatible = arm,psci-1.0;
    method = smc;
  };
  reserved-memory {
    #address-cells = <0x02>;
    #size-cells = <0x02>;
    phandle = <0x136>;
    drm-logo@00000000 {
      compatible = rockchip,drm-logo;
      reg = <0x00 0x00 0x00 0x00>;
      phandle = <0x10>;
    };
    drm-cubic-lut@00000000 {
      compatible = rockchip,drm-cubic-lut;
      reg = <0x00 0x00 0x00 0x00>;
      phandle = <0x11>;
    };
    linux,cma {
      compatible = shared-dma-pool;
      reg = <0x00 0x10000000 0x00 0x800000>;
    };
    ramoops@110000 {
      compatible = ramoops;
      reg = <0x00 0x110000 0x00 0xf0000>;
      record-size = <0x20000>;
      console-size = <0x80000>;
      ftrace-size = <0x00>;
      pmsg-size = <0x50000>;
      phandle = <0x137>;
    };
  };
  rockchip-suspend {
    compatible = rockchip,pm-rk3568;
    status = okay;
    rockchip,sleep-debug-en = <0x01>;
    rockchip,sleep-mode-config = <0x5ec>;
    rockchip,wakeup-config = <0x10>;
    phandle = <0x138>;
  };
  rockchip-system-monitor {
    compatible = rockchip,system-monitor;
    rockchip,thermal-zone = soc-thermal;
    phandle = <0x139>;
  };
  thermal-zones {
    phandle = <0x13a>;
    soc-thermal {
      polling-delay-passive = <0x14>;
      polling-delay = <0x3e8>;
      sustainable-power = <0x389>;
      thermal-sensors = <0x1b 0x00>;
      phandle = <0x13b>;
      trips {
        trip-point-0 {
          temperature = <0x124f8>;
          hysteresis = <0x7d0>;
          type = passive;
          phandle = <0x13c>;
        };
        trip-point-1 {
          temperature = <0x14c08>;
          hysteresis = <0x7d0>;
          type = passive;
          phandle = <0x1c>;
        };
        soc-crit {
          temperature = <0x1c138>;
          hysteresis = <0x7d0>;
          type = critical;
          phandle = <0x13d>;
        };
      };
      cooling-maps {
        map0 {
          trip = <0x1c>;
          cooling-device = <0x09 0xffffffff 0xffffffff>;
          contribution = <0x400>;
        };
        map1 {
          trip = <0x1c>;
          cooling-device = <0x1d 0xffffffff 0xffffffff>;
          contribution = <0x400>;
        };
      };
    };
    gpu-thermal {
      polling-delay-passive = <0x14>;
      polling-delay = <0x3e8>;
      thermal-sensors = <0x1b 0x01>;
      phandle = <0x13e>;
    };
  };
  timer {
    compatible = arm,armv8-timer;
    interrupts = <0x01 0x0d 0xf04 0x01 0x0e 0xf04 0x01 0x0b 0xf04 0x01 0x0a 0xf04>;
  };
  external-gmac1-clock {
    compatible = fixed-clock;
    clock-frequency = <0x7735940>;
    clock-output-names = gmac1_clkin;
    #clock-cells = <0x00>;
    phandle = <0x13f>;
  };
  xpcs-gmac1-clock {
    compatible = fixed-clock;
    clock-frequency = <0x7735940>;
    clock-output-names = clk_gmac1_xpcs_mii;
    #clock-cells = <0x00>;
    phandle = <0x140>;
  };
  i2s1-mclkin-rx {
    compatible = fixed-clock;
    #clock-cells = <0x00>;
    clock-frequency = <0xbb8000>;
    clock-output-names = i2s1_mclkin_rx;
    phandle = <0x141>;
  };
  i2s1-mclkin-tx {
    compatible = fixed-clock;
    #clock-cells = <0x00>;
    clock-frequency = <0xbb8000>;
    clock-output-names = i2s1_mclkin_tx;
    phandle = <0x142>;
  };
  i2s2-mclkin {
    compatible = fixed-clock;
    #clock-cells = <0x00>;
    clock-frequency = <0xbb8000>;
    clock-output-names = i2s2_mclkin;
    phandle = <0x143>;
  };
  i2s3-mclkin {
    compatible = fixed-clock;
    #clock-cells = <0x00>;
    clock-frequency = <0xbb8000>;
    clock-output-names = i2s3_mclkin;
    phandle = <0x144>;
  };
  mpll {
    compatible = fixed-clock;
    #clock-cells = <0x00>;
    clock-frequency = <0x2faf0800>;
    clock-output-names = mpll;
    phandle = <0x145>;
  };
  xin24m {
    compatible = fixed-clock;
    #clock-cells = <0x00>;
    clock-frequency = <0x16e3600>;
    clock-output-names = xin24m;
    phandle = <0x146>;
  };
  xin32k {
    compatible = fixed-clock;
    clock-frequency = <0x8000>;
    clock-output-names = xin32k;
    #clock-cells = <0x00>;
    pinctrl-names = default;
    pinctrl-0 = <0x1e>;
    phandle = <0x147>;
  };
  scmi-shmem@10f000 {
    compatible = arm,scmi-shmem;
    reg = <0x00 0x10f000 0x00 0x100>;
    phandle = <0x1a>;
  };
  sata@fc400000 {
    compatible = snps,dwc-ahci;
    reg = <0x00 0xfc400000 0x00 0x1000>;
    clocks = <0x1f 0x9b 0x1f 0x9c 0x1f 0x9d>;
    clock-names = sata\0pmalive\0rxoob;
    interrupts = <0x00 0x5f 0x04>;
    interrupt-names = hostc;
    phys = <0x20 0x01>;
    phy-names = sata-phy;
    ports-implemented = <0x01>;
    power-domains = <0x21 0x0f>;
    status = disabled;
    phandle = <0x148>;
  };
  sata@fc800000 {
    compatible = snps,dwc-ahci;
    reg = <0x00 0xfc800000 0x00 0x1000>;
    clocks = <0x1f 0xa0 0x1f 0xa1 0x1f 0xa2>;
    clock-names = sata\0pmalive\0rxoob;
    interrupts = <0x00 0x60 0x04>;
    interrupt-names = hostc;
    phys = <0x22 0x01>;
    phy-names = sata-phy;
    ports-implemented = <0x01>;
    power-domains = <0x21 0x0f>;
    status = disabled;
    phandle = <0x149>;
  };
  usbdrd {
    compatible = rockchip,rk3568-dwc3\0rockchip,rk3399-dwc3;
    clocks = <0x1f 0xa6 0x1f 0xa7 0x1f 0xa5 0x1f 0x7f>;
    clock-names = ref_clk\0suspend_clk\0bus_clk\0pipe_clk;
    #address-cells = <0x02>;
    #size-cells = <0x02>;
    status = okay;
    phandle = <0x14a>;
    dwc3@fcc00000 {
      compatible = snps,dwc3;
      reg = <0x00 0xfcc00000 0x00 0x400000>;
      interrupts = <0x00 0xa9 0x04>;
      dr_mode = otg;
      phys = <0x23>;
      phy-names = usb2-phy;
      phy_type = utmi_wide;
      power-domains = <0x21 0x0f>;
      resets = <0x1f 0x94>;
      reset-names = usb3-otg;
      status = okay;
      extcon = <0x24>;
      maximum-speed = high-speed;
      phandle = <0x14b>;
    };
  };
  usbhost {
    compatible = rockchip,rk3568-dwc3\0rockchip,rk3399-dwc3;
    clocks = <0x1f 0xa9 0x1f 0xaa 0x1f 0xa8 0x1f 0x7f>;
    clock-names = ref_clk\0suspend_clk\0bus_clk\0pipe_clk;
    #address-cells = <0x02>;
    #size-cells = <0x02>;
    status = okay;
    phandle = <0x14c>;
    dwc3@fd000000 {
      compatible = snps,dwc3;
      reg = <0x00 0xfd000000 0x00 0x400000>;
      interrupts = <0x00 0xaa 0x04>;
      dr_mode = host;
      phys = <0x25 0x20 0x04>;
      phy-names = usb2-phy\0usb3-phy;
      phy_type = utmi_wide;
      power-domains = <0x21 0x0f>;
      resets = <0x1f 0x95>;
      reset-names = usb3-host;
      status = okay;
      phandle = <0x14d>;
    };
  };
  interrupt-controller@fd400000 {
    compatible = arm,gic-v3;
    #interrupt-cells = <0x03>;
    #address-cells = <0x02>;
    #size-cells = <0x02>;
    reg = <0x00 0xfd400000 0x00 0x10000 0x00 0xfd460000 0x00 0xc0000>;
    interrupts = <0x01 0x09 0x04>;
    phandle = <0x01>;
    interrupt-controller@fd440000 {
      compatible = arm,gic-v3-its;
      #msi-cells = <0x01>;
      reg = <0x00 0xfd440000 0x00 0x20000>;
      phandle = <0xa2>;
    };
  };
  usb@fd800000 {
    compatible = generic-ehci;
    reg = <0x00 0xfd800000 0x00 0x40000>;
    interrupts = <0x00 0x82 0x04>;
    clocks = <0x1f 0xbd 0x1f 0xbe 0x1f 0xbc 0x26>;
    clock-names = usbhost\0arbiter\0pclk\0utmi;
    phys = <0x27>;
    phy-names = usb2-phy;
    status = okay;
    phandle = <0x14e>;
  };
  usb@fd840000 {
    compatible = generic-ohci;
    reg = <0x00 0xfd840000 0x00 0x40000>;
    interrupts = <0x00 0x83 0x04>;
    clocks = <0x1f 0xbd 0x1f 0xbe 0x1f 0xbc 0x26>;
    clock-names = usbhost\0arbiter\0pclk\0utmi;
    phys = <0x27>;
    phy-names = usb2-phy;
    status = okay;
    phandle = <0x14f>;
  };
  usb@fd880000 {
    compatible = generic-ehci;
    reg = <0x00 0xfd880000 0x00 0x40000>;
    interrupts = <0x00 0x85 0x04>;
    clocks = <0x1f 0xbf 0x1f 0xc0 0x1f 0xbc 0x26>;
    clock-names = usbhost\0arbiter\0pclk\0utmi;
    phys = <0x28>;
    phy-names = usb2-phy;
    status = okay;
    phandle = <0x150>;
  };
  usb@fd8c0000 {
    compatible = generic-ohci;
    reg = <0x00 0xfd8c0000 0x00 0x40000>;
    interrupts = <0x00 0x86 0x04>;
    clocks = <0x1f 0xbf 0x1f 0xc0 0x1f 0xbc 0x26>;
    clock-names = usbhost\0arbiter\0pclk\0utmi;
    phys = <0x28>;
    phy-names = usb2-phy;
    status = okay;
    phandle = <0x151>;
  };
  syscon@fda00000 {
    compatible = rockchip,rk3568-xpcs\0syscon;
    reg = <0x00 0xfda00000 0x00 0x200000>;
    status = disabled;
    phandle = <0x152>;
  };
  syscon@fdc20000 {
    compatible = rockchip,rk3568-pmugrf\0syscon\0simple-mfd;
    reg = <0x00 0xfdc20000 0x00 0x10000>;
    phandle = <0x33>;
    io-domains {
      compatible = rockchip,rk3568-pmu-io-voltage-domain;
      status = okay;
      pmuio2-supply = <0x29>;
      vccio1-supply = <0x2a>;
      vccio3-supply = <0x2b>;
      vccio4-supply = <0x2c>;
      vccio5-supply = <0x2d>;
      vccio6-supply = <0x2c>;
      vccio7-supply = <0x29>;
      phandle = <0x153>;
    };
    reboot-mode {
      compatible = syscon-reboot-mode;
      offset = <0x200>;
      mode-bootloader = <0x5242c301>;
      mode-charge = <0x5242c30b>;
      mode-fastboot = <0x5242c309>;
      mode-loader = <0x5242c301>;
      mode-normal = <0x5242c300>;
      mode-recovery = <0x5242c303>;
      mode-ums = <0x5242c30c>;
      mode-panic = <0x5242c307>;
      mode-watchdog = <0x5242c308>;
      phandle = <0x154>;
    };
  };
  syscon@fdc50000 {
    compatible = rockchip,rk3568-pipegrf\0syscon;
    reg = <0x00 0xfdc50000 0x00 0x1000>;
    phandle = <0xfc>;
  };
  syscon@fdc60000 {
    compatible = rockchip,rk3568-grf\0syscon\0simple-mfd;
    reg = <0x00 0xfdc60000 0x00 0x10000>;
    phandle = <0x32>;
    io-domains {
      compatible = rockchip,rk3568-io-voltage-domain;
      status = disabled;
      phandle = <0x155>;
    };
    lvds {
      compatible = rockchip,rk3568-lvds;
      phys = <0x2e>;
      phy-names = phy;
      status = disabled;
      phandle = <0x156>;
      ports {
        #address-cells = <0x01>;
        #size-cells = <0x00>;
        port@0 {
          reg = <0x00>;
          #address-cells = <0x01>;
          #size-cells = <0x00>;
          endpoint@1 {
            reg = <0x01>;
            remote-endpoint = <0x18>;
            status = disabled;
            phandle = <0x84>;
          };
          endpoint@2 {
            reg = <0x02>;
            remote-endpoint = <0x2f>;
            status = disabled;
            phandle = <0x85>;
          };
        };
      };
    };
    rgb {
      compatible = rockchip,rk3568-rgb;
      pinctrl-names = default;
      pinctrl-0 = <0x30>;
      status = disabled;
      phandle = <0x157>;
      ports {
        #address-cells = <0x01>;
        #size-cells = <0x00>;
        port@0 {
          reg = <0x00>;
          #address-cells = <0x01>;
          #size-cells = <0x00>;
          endpoint@2 {
            reg = <0x02>;
            remote-endpoint = <0x19>;
            status = disabled;
            phandle = <0x86>;
          };
        };
      };
    };
  };
  syscon@fdc70000 {
    compatible = rockchip,pipe-phy-grf\0syscon;
    reg = <0x00 0xfdc70000 0x00 0x1000>;
    phandle = <0x158>;
  };
  syscon@fdc80000 {
    compatible = rockchip,pipe-phy-grf\0syscon;
    reg = <0x00 0xfdc80000 0x00 0x1000>;
    phandle = <0xfd>;
  };
  syscon@fdc90000 {
    compatible = rockchip,pipe-phy-grf\0syscon;
    reg = <0x00 0xfdc90000 0x00 0x1000>;
    phandle = <0xfe>;
  };
  syscon@fdca0000 {
    compatible = rockchip,rk3568-usb2phy-grf\0syscon;
    reg = <0x00 0xfdca0000 0x00 0x8000>;
    phandle = <0x103>;
  };
  syscon@fdca8000 {
    compatible = rockchip,rk3568-usb2phy-grf\0syscon;
    reg = <0x00 0xfdca8000 0x00 0x8000>;
    phandle = <0x106>;
  };
  edp-phy@fdcb0000 {
    compatible = rockchip,rk3568-edp-phy;
    reg = <0x00 0xfdcb0000 0x00 0x8000>;
    clocks = <0x31 0x29 0x1f 0x192>;
    clock-names = refclk\0pclk;
    resets = <0x1f 0x1d6>;
    reset-names = apb;
    #phy-cells = <0x00>;
    status = disabled;
    phandle = <0x9a>;
  };
  sram@fdcc0000 {
    compatible = mmio-sram;
    reg = <0x00 0xfdcc0000 0x00 0xb000>;
    #address-cells = <0x01>;
    #size-cells = <0x01>;
    ranges = <0x00 0x00 0xfdcc0000 0xb000>;
    phandle = <0x159>;
    rkvdec-sram@0 {
      reg = <0x00 0xb000>;
      phandle = <0x70>;
    };
  };
  clock-controller@fdd00000 {
    compatible = rockchip,rk3568-pmucru;
    reg = <0x00 0xfdd00000 0x00 0x1000>;
    rockchip,grf = <0x32>;
    rockchip,pmugrf = <0x33>;
    #clock-cells = <0x01>;
    #reset-cells = <0x01>;
    assigned-clocks = <0x31 0x32>;
    assigned-clock-parents = <0x31 0x05>;
    phandle = <0x31>;
  };
  clock-controller@fdd20000 {
    compatible = rockchip,rk3568-cru;
    reg = <0x00 0xfdd20000 0x00 0x1000>;
    rockchip,grf = <0x32>;
    #clock-cells = <0x01>;
    #reset-cells = <0x01>;
    assigned-clocks = <0x31 0x05 0x1f 0x106 0x1f 0x10b 0x31 0x01 0x31 0x2b 0x1f 0x03 0x1f 0x19b 0x1f 0x09 0x1f 0x19c 0x1f 0x19d 0x1f 0x1a1 0x1f 0x19e 0x1f 0x19f 0x1f 0x1a0 0x1f 0x04 0x1f 0x10d 0x1f 0x10e 0x1f 0x173 0x1f 0x174 0x1f 0x175 0x1f 0x176 0x1f 0xc9 0x1f 0xca 0x1f 0x06 0x1f 0x7e 0x1f 0x7f 0x1f 0x3d 0x1f 0x41 0x1f 0x45 0x1f 0x49 0x1f 0x4d 0x1f 0x4d 0x1f 0x55 0x1f 0x51 0x1f 0x5d 0x1f 0xdd>;
    assigned-clock-rates = <0x8000 0x11e1a300 0x11e1a300 0xbebc200 0x5f5e100 0x3b9aca00 0x1dcd6500 0x13d92d40 0xee6b280 0x7735940 0x5f5e100 0x3b9aca0 0x2faf080 0x17d7840 0x46cf7100 0x8f0d180 0x5f5e100 0x1dcd6500 0x17d78400 0x8f0d180 0x5f5e100 0x11e1a300 0x8f0d180 0x47868c00 0x17d78400 0x5f5e100 0x46cf7100 0x46cf7100 0x46cf7100 0x46cf7100 0x46cf7100 0x46cf7100 0x46cf7100 0x46cf7100 0x46cf7100 0x1dcd6500>;
    assigned-clock-parents = <0x31 0x08 0x1f 0x04 0x1f 0x04>;
    phandle = <0x1f>;
  };
  i2c@fdd40000 {
    compatible = rockchip,rk3399-i2c;
    reg = <0x00 0xfdd40000 0x00 0x1000>;
    clocks = <0x31 0x07 0x31 0x2d>;
    clock-names = i2c\0pclk;
    interrupts = <0x00 0x2e 0x04>;
    pinctrl-names = default;
    pinctrl-0 = <0x34>;
    #address-cells = <0x01>;
    #size-cells = <0x00>;
    status = okay;
    phandle = <0x15a>;
    tcs4525@1c {
      compatible = tcs,tcs452x;
      reg = <0x1c>;
      vin-supply = <0x35>;
      regulator-compatible = fan53555-reg;
      regulator-name = vdd_cpu;
      regulator-min-microvolt = <0xadf34>;
      regulator-max-microvolt = <0x1535b0>;
      regulator-init-microvolt = <0xdbba0>;
      regulator-ramp-delay = <0x8fc>;
      fcs,suspend-voltage-selector = <0x01>;
      phandle = <0x05>;
      regulator-state-mem {
      };
    };
    pmic@20 {
      compatible = rockchip,rk809;
      reg = <0x20>;
      interrupt-parent = <0x36>;
      interrupts = <0x03 0x08>;
      pinctrl-names = default\0pmic-sleep\0pmic-power-off\0pmic-reset;
      pinctrl-0 = <0x37>;
      pinctrl-1 = <0x38 0x39>;
      pinctrl-2 = <0x3a 0x3b>;
      pinctrl-3 = <0x3a 0x3c>;
      #clock-cells = <0x01>;
      clock-output-names = rk808-clkout1\0rk808-clkout2;
      pmic-reset-func = <0x00>;
      not-save-power-en = <0x01>;
      vcc1-supply = <0x3d>;
      vcc2-supply = <0x3d>;
      vcc3-supply = <0x3d>;
      vcc4-supply = <0x3d>;
      vcc5-supply = <0x3d>;
      vcc6-supply = <0x3d>;
      vcc7-supply = <0x3d>;
      vcc8-supply = <0x3d>;
      vcc9-supply = <0x3d>;
      phandle = <0x125>;
      pwrkey {
        status = okay;
      };
      pinctrl_rk8xx {
        #gpio-cells = <0x02>;
        phandle = <0x15b>;
        rk817_slppin_null {
          pins = gpio_slp;
          function = pin_fun0;
          phandle = <0x15c>;
        };
        rk817_slppin_slp {
          pins = gpio_slp;
          function = pin_fun1;
          phandle = <0x39>;
        };
        rk817_slppin_pwrdn {
          pins = gpio_slp;
          function = pin_fun2;
          phandle = <0x3b>;
        };
        rk817_slppin_rst {
          pins = gpio_slp;
          function = pin_fun3;
          phandle = <0x3c>;
        };
      };
      regulators {
        DCDC_REG1 {
          regulator-min-microvolt = <0x7a120>;
          regulator-max-microvolt = <0x149970>;
          regulator-init-microvolt = <0xdbba0>;
          regulator-ramp-delay = <0x1771>;
          regulator-initial-mode = <0x02>;
          regulator-name = vdd_logic;
          phandle = <0x63>;
          regulator-state-mem {
          };
        };
        DCDC_REG2 {
          regulator-min-microvolt = <0x7a120>;
          regulator-max-microvolt = <0x149970>;
          regulator-init-microvolt = <0xdbba0>;
          regulator-ramp-delay = <0x1771>;
          regulator-initial-mode = <0x02>;
          regulator-name = vdd_gpu;
          phandle = <0x65>;
          regulator-state-mem {
          };
        };
        DCDC_REG3 {
          regulator-initial-mode = <0x02>;
          regulator-name = vcc_ddr;
          phandle = <0x15d>;
          regulator-state-mem {
          };
        };
        DCDC_REG4 {
          regulator-min-microvolt = <0x7a120>;
          regulator-max-microvolt = <0x149970>;
          regulator-init-microvolt = <0xdbba0>;
          regulator-ramp-delay = <0x1771>;
          regulator-initial-mode = <0x02>;
          regulator-name = vdd_npu;
          phandle = <0x60>;
          regulator-state-mem {
          };
        };
        LDO_REG1 {
          regulator-min-microvolt = <0x124f80>;
          regulator-max-microvolt = <0x124f80>;
          regulator-name = vdda0v9_image;
          phandle = <0x15e>;
          regulator-state-mem {
          };
        };
        LDO_REG2 {
          regulator-min-microvolt = <0xdbba0>;
          regulator-max-microvolt = <0xdbba0>;
          regulator-name = vdda_0v9;
          phandle = <0x15f>;
          regulator-state-mem {
          };
        };
        LDO_REG3 {
          regulator-min-microvolt = <0xdbba0>;
          regulator-max-microvolt = <0xdbba0>;
          regulator-name = vdda0v9_pmu;
          phandle = <0x160>;
          regulator-state-mem {
            regulator-suspend-microvolt = <0xdbba0>;
          };
        };
        LDO_REG4 {
          regulator-min-microvolt = <0x325aa0>;
          regulator-max-microvolt = <0x325aa0>;
          regulator-name = vccio_acodec;
          phandle = <0x2a>;
          regulator-state-mem {
          };
        };
        LDO_REG5 {
          regulator-min-microvolt = <0x1b7740>;
          regulator-max-microvolt = <0x325aa0>;
          regulator-name = vccio_sd;
          phandle = <0x2b>;
          regulator-state-mem {
          };
        };
        LDO_REG6 {
          regulator-min-microvolt = <0x325aa0>;
          regulator-max-microvolt = <0x325aa0>;
          regulator-name = vcc3v3_pmu;
          phandle = <0x2d>;
          regulator-state-mem {
            regulator-suspend-microvolt = <0x325aa0>;
          };
        };
        LDO_REG7 {
          regulator-min-microvolt = <0x1b7740>;
          regulator-max-microvolt = <0x1b7740>;
          regulator-name = vcca_1v8;
          phandle = <0xfb>;
          regulator-state-mem {
          };
        };
        LDO_REG8 {
          regulator-min-microvolt = <0x1b7740>;
          regulator-max-microvolt = <0x1b7740>;
          regulator-name = vcca1v8_pmu;
          phandle = <0x29>;
          regulator-state-mem {
            regulator-suspend-microvolt = <0x1b7740>;
          };
        };
        LDO_REG9 {
          regulator-min-microvolt = <0x2ab980>;
          regulator-max-microvolt = <0x2ab980>;
          regulator-name = vcca1v8_image;
          phandle = <0x161>;
          regulator-state-mem {
          };
        };
        DCDC_REG5 {
          regulator-min-microvolt = <0x1b7740>;
          regulator-max-microvolt = <0x1b7740>;
          regulator-name = vcc_1v8;
          phandle = <0x2c>;
          regulator-state-mem {
          };
        };
        SWITCH_REG1 {
          regulator-name = vcc_3v3;
          phandle = <0x162>;
          regulator-state-mem {
          };
        };
        SWITCH_REG2 {
          regulator-name = vcc3v3_sd;
          phandle = <0xa5>;
          regulator-state-mem {
          };
        };
      };
      codec {
        #sound-dai-cells = <0x00>;
        compatible = rockchip,rk809-codec\0rockchip,rk817-codec;
        clocks = <0x1f 0x1a3>;
        clock-names = mclk;
        assigned-clocks = <0x1f 0x1a3 0x1f 0x1a6>;
        assigned-clock-rates = <0xbb8000>;
        assigned-clock-parents = <0x1f 0x48 0x1f 0x48>;
        pinctrl-names = default;
        pinctrl-0 = <0x3e>;
        spk-ctl-gpios = <0x3f 0x08 0x01>;
        hp-volume = <0x03>;
        spk-volume = <0x03>;
        status = okay;
        phandle = <0x11d>;
      };
    };
  };
  serial@fdd50000 {
    compatible = rockchip,rk3568-uart\0snps,dw-apb-uart;
    reg = <0x00 0xfdd50000 0x00 0x100>;
    interrupts = <0x00 0x74 0x04>;
    clocks = <0x31 0x0b 0x31 0x2c>;
    clock-names = baudclk\0apb_pclk;
    reg-shift = <0x02>;
    reg-io-width = <0x04>;
    dmas = <0x40 0x00 0x40 0x01>;
    pinctrl-names = default;
    pinctrl-0 = <0x41>;
    status = disabled;
    phandle = <0x163>;
  };
  pwm@fdd70000 {
    compatible = rockchip,rk3568-pwm\0rockchip,rk3328-pwm;
    reg = <0x00 0xfdd70000 0x00 0x10>;
    #pwm-cells = <0x03>;
    pinctrl-names = active;
    pinctrl-0 = <0x42>;
    clocks = <0x31 0x0d 0x31 0x30>;
    clock-names = pwm\0pclk;
    status = disabled;
    phandle = <0x164>;
  };
  pwm@fdd70010 {
    compatible = rockchip,rk3568-pwm\0rockchip,rk3328-pwm;
    reg = <0x00 0xfdd70010 0x00 0x10>;
    #pwm-cells = <0x03>;
    pinctrl-names = active;
    pinctrl-0 = <0x43>;
    clocks = <0x31 0x0d 0x31 0x30>;
    clock-names = pwm\0pclk;
    status = disabled;
    phandle = <0x165>;
  };
  pwm@fdd70020 {
    compatible = rockchip,rk3568-pwm\0rockchip,rk3328-pwm;
    reg = <0x00 0xfdd70020 0x00 0x10>;
    #pwm-cells = <0x03>;
    pinctrl-names = active;
    pinctrl-0 = <0x44>;
    clocks = <0x31 0x0d 0x31 0x30>;
    clock-names = pwm\0pclk;
    status = disabled;
    phandle = <0x166>;
  };
  pwm@fdd70030 {
    compatible = rockchip,rk3568-pwm\0rockchip,rk3328-pwm;
    reg = <0x00 0xfdd70030 0x00 0x10>;
    interrupts = <0x00 0x52 0x04 0x00 0x56 0x04>;
    #pwm-cells = <0x03>;
    pinctrl-names = active;
    pinctrl-0 = <0x45>;
    clocks = <0x31 0x0d 0x31 0x30>;
    clock-names = pwm\0pclk;
    status = disabled;
    phandle = <0x167>;
  };
  power-management@fdd90000 {
    compatible = rockchip,rk3568-pmu\0syscon\0simple-mfd;
    reg = <0x00 0xfdd90000 0x00 0x1000>;
    phandle = <0x168>;
    power-controller {
      compatible = rockchip,rk3568-power-controller;
      #power-domain-cells = <0x01>;
      #address-cells = <0x01>;
      #size-cells = <0x00>;
      status = okay;
      phandle = <0x21>;
      pd_npu@6 {
        reg = <0x06>;
        clocks = <0x1f 0x27 0x1f 0x25 0x1f 0x26>;
        pm_qos = <0x46>;
      };
      pd_gpu@7 {
        reg = <0x07>;
        clocks = <0x1f 0x19 0x1f 0x1a>;
        pm_qos = <0x47>;
      };
      pd_vi@8 {
        reg = <0x08>;
        clocks = <0x1f 0xcc 0x1f 0xcd>;
        pm_qos = <0x48 0x49 0x4a>;
      };
      pd_vo@9 {
        reg = <0x09>;
        clocks = <0x1f 0xda 0x1f 0xdb 0x1f 0xdc>;
        pm_qos = <0x4b 0x4c 0x4d>;
      };
      pd_rga@10 {
        reg = <0x0a>;
        clocks = <0x1f 0xf1 0x1f 0xf2>;
        pm_qos = <0x4e 0x4f 0x50 0x51 0x52 0x53>;
      };
      pd_vpu@11 {
        reg = <0x0b>;
        clocks = <0x1f 0xed>;
        pm_qos = <0x54>;
      };
      pd_rkvdec@13 {
        clocks = <0x1f 0x107>;
        reg = <0x0d>;
        pm_qos = <0x55>;
      };
      pd_rkvenc@14 {
        reg = <0x0e>;
        clocks = <0x1f 0x102>;
        pm_qos = <0x56 0x57 0x58>;
      };
      pd_pipe@15 {
        reg = <0x0f>;
        clocks = <0x1f 0x7f>;
        pm_qos = <0x59 0x5a 0x5b 0x5c 0x5d>;
      };
    };
  };
  pvtm@fde00000 {
    compatible = rockchip,rk3568-core-pvtm;
    reg = <0x00 0xfde00000 0x00 0x100>;
    #address-cells = <0x01>;
    #size-cells = <0x00>;
    pvtm@0 {
      reg = <0x00>;
      clocks = <0x1f 0x13 0x1f 0x1c2>;
      clock-names = clk\0pclk;
      resets = <0x1f 0x1a 0x1f 0x19>;
      reset-names = rts\0rst-p;
      thermal-zone = soc-thermal;
    };
  };
  npu@fde40000 {
    compatible = rockchip,rk3568-rknpu\0rockchip,rknpu;
    reg = <0x00 0xfde40000 0x00 0x10000>;
    interrupts = <0x00 0x97 0x04>;
    clocks = <0x02 0x02 0x1f 0x23 0x1f 0x28 0x1f 0x29>;
    clock-names = scmi_clk\0clk\0aclk\0hclk;
    assigned-clocks = <0x1f 0x23>;
    assigned-clock-rates = <0x23c34600>;
    resets = <0x1f 0x2b 0x1f 0x2c>;
    reset-names = srst_a\0srst_h;
    power-domains = <0x21 0x06>;
    operating-points-v2 = <0x5e>;
    iommus = <0x5f>;
    status = okay;
    rknpu-supply = <0x60>;
    phandle = <0x169>;
  };
  npu-opp-table {
    compatible = operating-points-v2;
    mbist-vmin = <0xc96a8 0xdbba0 0xe7ef0>;
    nvmem-cells = <0x61 0x07 0x08>;
    nvmem-cell-names = leakage\0pvtm\0mbist-vmin;
    rockchip,temp-hysteresis = <0x1388>;
    rockchip,low-temp = <0x00>;
    rockchip,low-temp-adjust-volt = <0x00 0x2bc 0xc350>;
    phandle = <0x5e>;
    opp-200000000 {
      opp-hz = <0x00 0xbebc200>;
      opp-microvolt = <0xc96a8 0xc96a8 0xf4240>;
    };
    opp-300000000 {
      opp-hz = <0x00 0x11b3dc40>;
      opp-microvolt = <0xc96a8 0xc96a8 0xf4240>;
    };
    opp-400000000 {
      opp-hz = <0x00 0x17d78400>;
      opp-microvolt = <0xc96a8 0xc96a8 0xf4240>;
    };
    opp-600000000 {
      opp-hz = <0x00 0x23c34600>;
      opp-microvolt = <0xc96a8 0xc96a8 0xf4240>;
    };
    opp-700000000 {
      opp-hz = <0x00 0x29b92700>;
      opp-microvolt = <0xcf850 0xcf850 0xf4240>;
    };
    opp-800000000 {
      opp-hz = <0x00 0x2faf0800>;
      opp-microvolt = <0xd59f8 0xd59f8 0xf4240>;
    };
    opp-900000000 {
      opp-hz = <0x00 0x35a4e900>;
      opp-microvolt = <0xe1d48 0xe1d48 0xf4240>;
    };
    opp-1000000000 {
      opp-hz = <0x00 0x3b9aca00>;
      opp-microvolt = <0xf4240 0xf4240 0xf4240>;
      status = disabled;
    };
  };
  bus-npu {
    compatible = rockchip,rk3568-bus;
    rockchip,busfreq-policy = clkfreq;
    clocks = <0x02 0x02>;
    clock-names = bus;
    operating-points-v2 = <0x62>;
    status = okay;
    bus-supply = <0x63>;
    pvtm-supply = <0x05>;
    phandle = <0x16a>;
  };
  bus-npu-opp-table {
    compatible = operating-points-v2;
    nvmem-cells = <0x07>;
    nvmem-cell-names = pvtm;
    rockchip,pvtm-voltage-sel = <0x00 0x14050 0x00 0x14051 0x16b48 0x01 0x16b49 0x186a0 0x02>;
    rockchip,pvtm-ch = <0x00 0x05>;
    phandle = <0x62>;
    opp-1000000000 {
      opp-hz = <0x00 0x3b9aca00>;
      opp-microvolt = <0xe7ef0>;
      opp-microvolt-L0 = <0xe7ef0>;
      opp-microvolt-L1 = <0xe1d48>;
      opp-microvolt-L2 = <0x00>;
    };
    opp-900000000 {
      opp-hz = <0x00 0x35a4e900>;
      opp-microvolt = <0x00>;
    };
  };
  iommu@fde4b000 {
    compatible = rockchip,iommu-v2;
    reg = <0x00 0xfde4b000 0x00 0x40>;
    interrupts = <0x00 0x97 0x04>;
    interrupt-names = rknpu_mmu;
    clocks = <0x1f 0x28 0x1f 0x29>;
    clock-names = aclk\0iface;
    power-domains = <0x21 0x06>;
    #iommu-cells = <0x00>;
    status = okay;
    phandle = <0x5f>;
  };
  gpu@fde60000 {
    compatible = arm,mali-bifrost;
    reg = <0x00 0xfde60000 0x00 0x4000>;
    interrupts = <0x00 0x27 0x04 0x00 0x29 0x04 0x00 0x28 0x04>;
    interrupt-names = GPU\0MMU\0JOB;
    upthreshold = <0x28>;
    downdifferential = <0x0a>;
    clocks = <0x02 0x01 0x1f 0x1b>;
    clock-names = clk_mali\0clk_gpu;
    power-domains = <0x21 0x07>;
    #cooling-cells = <0x02>;
    operating-points-v2 = <0x64>;
    status = okay;
    mali-supply = <0x65>;
    phandle = <0x1d>;
    power-model {
      compatible = simple-power-model;
      leakage-range = <0x05 0x0f>;
      ls = <0xffffa23e 0x5927 0x00>;
      static-coefficient = <0x186a0>;
      dynamic-coefficient = <0x3b9>;
      ts = <0xfffe56a6 0xf87a 0xfffffab5 0x14>;
      thermal-zone = gpu-thermal;
      phandle = <0x16b>;
    };
  };
  opp-table2 {
    compatible = operating-points-v2;
    mbist-vmin = <0xc96a8 0xdbba0 0xe7ef0>;
    nvmem-cells = <0x66 0x07 0x08>;
    nvmem-cell-names = leakage\0pvtm\0mbist-vmin;
    phandle = <0x64>;
    opp-200000000 {
      opp-hz = <0x00 0xbebc200>;
      opp-microvolt = <0xc96a8>;
    };
    opp-300000000 {
      opp-hz = <0x00 0x11e1a300>;
      opp-microvolt = <0xc96a8>;
    };
    opp-400000000 {
      opp-hz = <0x00 0x17d78400>;
      opp-microvolt = <0xc96a8>;
    };
    opp-600000000 {
      opp-hz = <0x00 0x23c34600>;
      opp-microvolt = <0xc96a8>;
    };
    opp-700000000 {
      opp-hz = <0x00 0x29b92700>;
      opp-microvolt = <0xdbba0>;
    };
    opp-800000000 {
      opp-hz = <0x00 0x2faf0800>;
      opp-microvolt = <0xe7ef0>;
    };
  };
  pvtm@fde80000 {
    compatible = rockchip,rk3568-gpu-pvtm;
    reg = <0x00 0xfde80000 0x00 0x100>;
    #address-cells = <0x01>;
    #size-cells = <0x00>;
    pvtm@1 {
      reg = <0x01>;
      clocks = <0x1f 0x1e 0x1f 0x1d>;
      clock-names = clk\0pclk;
      resets = <0x1f 0x24 0x1f 0x23>;
      reset-names = rts\0rst-p;
      thermal-zone = gpu-thermal;
    };
  };
  pvtm@fde90000 {
    compatible = rockchip,rk3568-npu-pvtm;
    reg = <0x00 0xfde90000 0x00 0x100>;
    #address-cells = <0x01>;
    #size-cells = <0x00>;
    pvtm@2 {
      reg = <0x02>;
      clocks = <0x1f 0x2b 0x1f 0x2a 0x1f 0x25>;
      clock-names = clk\0pclk\0hclk;
      resets = <0x1f 0x2e 0x1f 0x2d>;
      reset-names = rts\0rst-p;
      thermal-zone = soc-thermal;
    };
  };
  vdpu@fdea0400 {
    compatible = rockchip,vpu-decoder-v2;
    reg = <0x00 0xfdea0400 0x00 0x400>;
    interrupts = <0x00 0x8b 0x04>;
    interrupt-names = irq_dec;
    clocks = <0x1f 0xee 0x1f 0xef>;
    clock-names = aclk_vcodec\0hclk_vcodec;
    resets = <0x1f 0x11a 0x1f 0x11b>;
    reset-names = video_a\0video_h;
    iommus = <0x67>;
    power-domains = <0x21 0x0b>;
    rockchip,srv = <0x68>;
    rockchip,taskqueue-node = <0x00>;
    rockchip,resetgroup-node = <0x00>;
    status = okay;
    phandle = <0x16c>;
  };
  iommu@fdea0800 {
    compatible = rockchip,iommu-v2;
    reg = <0x00 0xfdea0800 0x00 0x40>;
    interrupts = <0x00 0x8a 0x04>;
    interrupt-names = vdpu_mmu;
    clock-names = aclk\0iface;
    clocks = <0x1f 0xee 0x1f 0xef>;
    power-domains = <0x21 0x0b>;
    #iommu-cells = <0x00>;
    status = okay;
    phandle = <0x67>;
  };
  rk_rga@fdeb0000 {
    compatible = rockchip,rga2;
    reg = <0x00 0xfdeb0000 0x00 0x1000>;
    interrupts = <0x00 0x5a 0x04>;
    clocks = <0x1f 0xf3 0x1f 0xf4 0x1f 0xf5>;
    clock-names = aclk_rga\0hclk_rga\0clk_rga;
    power-domains = <0x21 0x0a>;
    status = okay;
    phandle = <0x16d>;
  };
  ebc@fdec0000 {
    compatible = rockchip,rk3568-ebc-tcon;
    reg = <0x00 0xfdec0000 0x00 0x5000>;
    interrupts = <0x00 0x11 0x04>;
    clocks = <0x1f 0xf9 0x1f 0xfa>;
    clock-names = hclk\0dclk;
    power-domains = <0x21 0x0a>;
    rockchip,grf = <0x32>;
    pinctrl-names = default;
    pinctrl-0 = <0x69>;
    status = disabled;
    phandle = <0x16e>;
  };
  jpegd@fded0000 {
    compatible = rockchip,rkv-jpeg-decoder-v1;
    reg = <0x00 0xfded0000 0x00 0x400>;
    interrupts = <0x00 0x3e 0x04>;
    clocks = <0x1f 0xfb 0x1f 0xfc>;
    clock-names = aclk_vcodec\0hclk_vcodec;
    resets = <0x1f 0x12c 0x1f 0x12d>;
    reset-names = video_a\0video_h;
    iommus = <0x6a>;
    rockchip,srv = <0x68>;
    rockchip,taskqueue-node = <0x01>;
    rockchip,resetgroup-node = <0x01>;
    power-domains = <0x21 0x0a>;
    status = okay;
    phandle = <0x16f>;
  };
  iommu@fded0480 {
    compatible = rockchip,iommu-v2;
    reg = <0x00 0xfded0480 0x00 0x40>;
    interrupts = <0x00 0x3d 0x04>;
    interrupt-names = jpegd_mmu;
    clock-names = aclk\0iface;
    clocks = <0x1f 0xfb 0x1f 0xfc>;
    power-domains = <0x21 0x0a>;
    #iommu-cells = <0x00>;
    status = okay;
    phandle = <0x6a>;
  };
  vepu@fdee0000 {
    compatible = rockchip,vpu-encoder-v2;
    reg = <0x00 0xfdee0000 0x00 0x400>;
    interrupts = <0x00 0x40 0x04>;
    clocks = <0x1f 0xfd 0x1f 0xfe>;
    clock-names = aclk_vcodec\0hclk_vcodec;
    resets = <0x1f 0x12e 0x1f 0x12f>;
    reset-names = video_a\0video_h;
    iommus = <0x6b>;
    rockchip,srv = <0x68>;
    rockchip,taskqueue-node = <0x02>;
    rockchip,resetgroup-node = <0x02>;
    power-domains = <0x21 0x0a>;
    status = okay;
    phandle = <0x170>;
  };
  iommu@fdee0800 {
    compatible = rockchip,iommu-v2;
    reg = <0x00 0xfdee0800 0x00 0x40>;
    interrupts = <0x00 0x3f 0x04>;
    interrupt-names = vepu_mmu;
    clock-names = aclk\0iface;
    clocks = <0x1f 0xfd 0x1f 0xfe>;
    power-domains = <0x21 0x0a>;
    #iommu-cells = <0x00>;
    status = okay;
    phandle = <0x6b>;
  };
  iep@fdef0000 {
    compatible = rockchip,iep-v2;
    reg = <0x00 0xfdef0000 0x00 0x500>;
    interrupts = <0x00 0x38 0x04>;
    clocks = <0x1f 0xf6 0x1f 0xf7 0x1f 0xf8>;
    clock-names = aclk\0hclk\0sclk;
    resets = <0x1f 0x127 0x1f 0x128 0x1f 0x129>;
    reset-names = rst_a\0rst_h\0rst_s;
    power-domains = <0x21 0x0a>;
    rockchip,srv = <0x68>;
    rockchip,taskqueue-node = <0x05>;
    rockchip,resetgroup-node = <0x05>;
    iommus = <0x6c>;
    status = okay;
    phandle = <0x171>;
  };
  iommu@fdef0800 {
    compatible = rockchip,iommu-v2;
    reg = <0x00 0xfdef0800 0x00 0x100>;
    interrupts = <0x00 0x38 0x04>;
    interrupt-names = iep_mmu;
    clocks = <0x1f 0xf6 0x1f 0xf7>;
    clock-names = aclk\0iface;
    #iommu-cells = <0x00>;
    power-domains = <0x21 0x0a>;
    status = okay;
    phandle = <0x6c>;
  };
  eink@fdf00000 {
    compatible = rockchip,rk3568-eink-tcon;
    reg = <0x00 0xfdf00000 0x00 0x74>;
    interrupts = <0x00 0xb2 0x04>;
    clocks = <0x1f 0xff 0x1f 0x100>;
    clock-names = pclk\0hclk;
    status = disabled;
    phandle = <0x172>;
  };
  rkvenc@fdf40000 {
    compatible = rockchip,rkv-encoder-v1;
    reg = <0x00 0xfdf40000 0x00 0x400>;
    interrupts = <0x00 0x8c 0x04>;
    interrupt-names = irq_enc;
    clocks = <0x1f 0x103 0x1f 0x104 0x1f 0x105>;
    clock-names = aclk_vcodec\0hclk_vcodec\0clk_core;
    rockchip,normal-rates = <0x11b3dc40 0x00 0x11b3dc40>;
    resets = <0x1f 0x133 0x1f 0x134 0x1f 0x135>;
    reset-names = video_a\0video_h\0video_core;
    assigned-clocks = <0x1f 0x103 0x1f 0x105>;
    assigned-clock-rates = <0x11b3dc40 0x11b3dc40>;
    iommus = <0x6d>;
    node-name = rkvenc;
    rockchip,srv = <0x68>;
    rockchip,taskqueue-node = <0x03>;
    rockchip,resetgroup-node = <0x03>;
    power-domains = <0x21 0x0e>;
    operating-points-v2 = <0x6e>;
    status = okay;
    venc-supply = <0x63>;
    phandle = <0x173>;
  };
  rkvenc-opp-table {
    compatible = operating-points-v2;
    nvmem-cells = <0x07>;
    nvmem-cell-names = pvtm;
    rockchip,pvtm-voltage-sel = <0x00 0x14050 0x00 0x14051 0x16b48 0x01 0x16b49 0x186a0 0x02>;
    rockchip,pvtm-ch = <0x00 0x05>;
    phandle = <0x6e>;
    opp-297000000 {
      opp-hz = <0x00 0x11b3dc40>;
      opp-microvolt = <0x00>;
    };
    opp-400000000 {
      opp-hz = <0x00 0x17d78400>;
      opp-microvolt = <0xe7ef0>;
      opp-microvolt-L0 = <0xe7ef0>;
      opp-microvolt-L1 = <0xe1d48>;
      opp-microvolt-L2 = <0x00>;
    };
  };
  iommu@fdf40f00 {
    compatible = rockchip,iommu-v2;
    reg = <0x00 0xfdf40f00 0x00 0x40 0x00 0xfdf40f40 0x00 0x40>;
    interrupts = <0x00 0x8d 0x04 0x00 0x8e 0x04>;
    interrupt-names = rkvenc_mmu0\0rkvenc_mmu1;
    clocks = <0x1f 0x103 0x1f 0x104>;
    clock-names = aclk\0iface;
    #iommu-cells = <0x00>;
    power-domains = <0x21 0x0e>;
    status = okay;
    phandle = <0x6d>;
  };
  rkvdec@fdf80200 {
    compatible = rockchip,rkv-decoder-rk3568\0rockchip,rkv-decoder-v2;
    reg = <0x00 0xfdf80200 0x00 0x400 0x00 0xfdf80100 0x00 0x100>;
    reg-names = regs\0link;
    interrupts = <0x00 0x5b 0x04>;
    interrupt-names = irq_dec;
    clocks = <0x1f 0x108 0x1f 0x109 0x1f 0x10a 0x1f 0x10b 0x1f 0x10c>;
    clock-names = aclk_vcodec\0hclk_vcodec\0clk_cabac\0clk_core\0clk_hevc_cabac;
    rockchip,normal-rates = <0x11b3dc40 0x00 0x11b3dc40 0x11b3dc40 0x23c34600>;
    rockchip,advanced-rates = <0x179a7b00 0x00 0x179a7b00 0x179a7b00 0x23c34600>;
    rockchip,default-max-load = <0x1fe000>;
    resets = <0x1f 0x142 0x1f 0x143 0x1f 0x144 0x1f 0x145 0x1f 0x146>;
    assigned-clocks = <0x1f 0x108 0x1f 0x10a 0x1f 0x10b 0x1f 0x10c>;
    assigned-clock-rates = <0x11b3dc40 0x11b3dc40 0x11b3dc40 0x11b3dc40>;
    reset-names = video_a\0video_h\0video_cabac\0video_core\0video_hevc_cabac;
    power-domains = <0x21 0x0d>;
    iommus = <0x6f>;
    rockchip,srv = <0x68>;
    rockchip,taskqueue-node = <0x04>;
    rockchip,resetgroup-node = <0x04>;
    rockchip,sram = <0x70>;
    rockchip,rcb-iova = <0x10000000 0x10000>;
    rockchip,rcb-min-width = <0x200>;
    rockchip,task-capacity = <0x10>;
    status = okay;
    phandle = <0x174>;
  };
  iommu@fdf80800 {
    compatible = rockchip,iommu-v2;
    reg = <0x00 0xfdf80800 0x00 0x40 0x00 0xfdf80840 0x00 0x40>;
    interrupts = <0x00 0x5c 0x04>;
    interrupt-names = rkvdec_mmu;
    clocks = <0x1f 0x108 0x1f 0x109>;
    clock-names = aclk\0iface;
    power-domains = <0x21 0x0d>;
    #iommu-cells = <0x00>;
    status = okay;
    phandle = <0x6f>;
  };
  mipi-csi2@fdfb0000 {
    compatible = rockchip,rk3568-mipi-csi2;
    reg = <0x00 0xfdfb0000 0x00 0x10000>;
    reg-names = csihost_regs;
    interrupts = <0x00 0x08 0x04 0x00 0x09 0x04>;
    interrupt-names = csi-intr1\0csi-intr2;
    clocks = <0x1f 0xd5>;
    clock-names = pclk_csi2host;
    resets = <0x1f 0xff>;
    reset-names = srst_csihost_p;
    status = disabled;
    phandle = <0x175>;
  };
  rkcif@fdfe0000 {
    compatible = rockchip,rk3568-cif;
    reg = <0x00 0xfdfe0000 0x00 0x8000>;
    reg-names = cif_regs;
    interrupts = <0x00 0x92 0x04>;
    interrupt-names = cif-intr;
    clocks = <0x1f 0xce 0x1f 0xcf 0x1f 0xd0 0x1f 0xd1>;
    clock-names = aclk_cif\0hclk_cif\0dclk_cif\0iclk_cif_g;
    resets = <0x1f 0xf7 0x1f 0xf8 0x1f 0xf9 0x1f 0xfb 0x1f 0xfa>;
    reset-names = rst_cif_a\0rst_cif_h\0rst_cif_d\0rst_cif_p\0rst_cif_i;
    assigned-clocks = <0x1f 0xd0>;
    assigned-clock-rates = <0x11e1a300>;
    power-domains = <0x21 0x08>;
    rockchip,grf = <0x32>;
    iommus = <0x71>;
    status = okay;
    phandle = <0x72>;
  };
  iommu@fdfe0800 {
    compatible = rockchip,iommu-v2;
    reg = <0x00 0xfdfe0800 0x00 0x100>;
    interrupts = <0x00 0x92 0x04>;
    interrupt-names = cif_mmu;
    clocks = <0x1f 0xce 0x1f 0xcf>;
    clock-names = aclk\0iface;
    power-domains = <0x21 0x08>;
    #iommu-cells = <0x00>;
    status = okay;
    phandle = <0x71>;
  };
  rkcif_dvp {
    compatible = rockchip,rkcif-dvp;
    rockchip,hw = <0x72>;
    status = disabled;
    phandle = <0x73>;
    port {
    };
  };
  rkcif_dvp_sditf {
    compatible = rockchip,rkcif-sditf;
    rockchip,cif = <0x73>;
    status = disabled;
    phandle = <0x176>;
  };
  rkcif_mipi_lvds {
    compatible = rockchip,rkcif-mipi-lvds;
    rockchip,hw = <0x72>;
    status = disabled;
    phandle = <0x74>;
  };
  rkcif_mipi_lvds_sditf {
    compatible = rockchip,rkcif-sditf;
    rockchip,cif = <0x74>;
    status = disabled;
    phandle = <0x177>;
  };
  rkisp@fdff0000 {
    compatible = rockchip,rk3568-rkisp;
    reg = <0x00 0xfdff0000 0x00 0x10000>;
    interrupts = <0x00 0x39 0x04 0x00 0x3a 0x04 0x00 0x3c 0x04>;
    interrupt-names = mipi_irq\0mi_irq\0isp_irq;
    clocks = <0x1f 0xd2 0x1f 0xd3 0x1f 0xd4>;
    clock-names = aclk_isp\0hclk_isp\0clk_isp;
    resets = <0x1f 0xfd 0x1f 0xfc>;
    reset-names = isp\0isp-h;
    rockchip,grf = <0x32>;
    power-domains = <0x21 0x08>;
    iommus = <0x75>;
    rockchip,iq-feature = <0x3fb 0xf7fe67ff>;
    status = okay;
    phandle = <0x76>;
  };
  iommu@fdff1a00 {
    compatible = rockchip,iommu-v2;
    reg = <0x00 0xfdff1a00 0x00 0x100>;
    interrupts = <0x00 0x3b 0x04>;
    interrupt-names = isp_mmu;
    clocks = <0x1f 0xd2 0x1f 0xd3>;
    clock-names = aclk\0iface;
    power-domains = <0x21 0x08>;
    #iommu-cells = <0x00>;
    status = okay;
    phandle = <0x75>;
  };
  rkisp-vir0 {
    compatible = rockchip,rkisp-vir;
    rockchip,hw = <0x76>;
    status = okay;
    phandle = <0x178>;
    port {
      #address-cells = <0x01>;
      #size-cells = <0x00>;
      endpoint@0 {
        reg = <0x00>;
        remote-endpoint = <0x77>;
        phandle = <0x102>;
      };
    };
  };
  rkisp-vir1 {
    compatible = rockchip,rkisp-vir;
    rockchip,hw = <0x76>;
    status = disabled;
    phandle = <0x179>;
  };
  ethernet@fe010000 {
    compatible = rockchip,rk3568-gmac\0snps,dwmac-4.20a;
    reg = <0x00 0xfe010000 0x00 0x10000>;
    interrupts = <0x00 0x20 0x04 0x00 0x1d 0x04>;
    interrupt-names = macirq\0eth_wake_irq;
    rockchip,grf = <0x32>;
    clocks = <0x1f 0x186 0x1f 0x189 0x1f 0x189 0x1f 0xc7 0x1f 0xc3 0x1f 0xc4 0x1f 0x189 0x1f 0xc8 0x1f 0xac>;
    clock-names = stmmaceth\0mac_clk_rx\0mac_clk_tx\0clk_mac_refout\0aclk_mac\0pclk_mac\0clk_mac_speed\0ptp_ref\0pclk_xpcs;
    resets = <0x1f 0xec>;
    reset-names = stmmaceth;
    snps,axi-config = <0x78>;
    snps,mtl-rx-config = <0x79>;
    snps,mtl-tx-config = <0x7a>;
    status = disabled;
    phandle = <0x17a>;
    mdio {
      compatible = snps,dwmac-mdio;
      #address-cells = <0x01>;
      #size-cells = <0x00>;
      phandle = <0x17b>;
      phy@0 {
        compatible = ethernet-phy-ieee802.3-c22;
        reg = <0x00>;
        phandle = <0x17c>;
      };
    };
    stmmac-axi-config {
      snps,wr_osr_lmt = <0x04>;
      snps,rd_osr_lmt = <0x08>;
      snps,blen = <0x00 0x00 0x00 0x00 0x10 0x08 0x04>;
      phandle = <0x78>;
    };
    rx-queues-config {
      snps,rx-queues-to-use = <0x01>;
      phandle = <0x79>;
      queue0 {
      };
    };
    tx-queues-config {
      snps,tx-queues-to-use = <0x01>;
      phandle = <0x7a>;
      queue0 {
      };
    };
  };
  vop@fe040000 {
    compatible = rockchip,rk3568-vop;
    reg = <0x00 0xfe040000 0x00 0x3000 0x00 0xfe044000 0x00 0x1000>;
    reg-names = regs\0gamma_lut;
    rockchip,grf = <0x32>;
    interrupts = <0x00 0x94 0x04>;
    clocks = <0x1f 0xdd 0x1f 0xde 0x1f 0xdf 0x1f 0xe0 0x1f 0xe1>;
    clock-names = aclk_vop\0hclk_vop\0dclk_vp0\0dclk_vp1\0dclk_vp2;
    iommus = <0x7b>;
    power-domains = <0x21 0x09>;
    status = okay;
    assigned-clocks = <0x1f 0xdf 0x1f 0xe0>;
    assigned-clock-parents = <0x31 0x02 0x1f 0x05>;
    phandle = <0x17d>;
    ports {
      #address-cells = <0x01>;
      #size-cells = <0x00>;
      phandle = <0x12>;
      port@0 {
        #address-cells = <0x01>;
        #size-cells = <0x00>;
        reg = <0x00>;
        phandle = <0x17e>;
        endpoint@0 {
          reg = <0x00>;
          remote-endpoint = <0x7c>;
          phandle = <0x87>;
        };
        endpoint@1 {
          reg = <0x01>;
          remote-endpoint = <0x7d>;
          phandle = <0x15>;
        };
        endpoint@2 {
          reg = <0x02>;
          remote-endpoint = <0x7e>;
          phandle = <0x16>;
        };
        endpoint@3 {
          reg = <0x03>;
          remote-endpoint = <0x7f>;
          phandle = <0x17>;
        };
      };
      port@1 {
        #address-cells = <0x01>;
        #size-cells = <0x00>;
        reg = <0x01>;
        phandle = <0x17f>;
        endpoint@0 {
          reg = <0x00>;
          remote-endpoint = <0x80>;
          phandle = <0x14>;
        };
        endpoint@1 {
          reg = <0x01>;
          remote-endpoint = <0x81>;
          phandle = <0x8f>;
        };
        endpoint@2 {
          reg = <0x02>;
          remote-endpoint = <0x82>;
          phandle = <0x9b>;
        };
        endpoint@3 {
          reg = <0x03>;
          remote-endpoint = <0x83>;
          phandle = <0x99>;
        };
        endpoint@4 {
          reg = <0x04>;
          remote-endpoint = <0x84>;
          phandle = <0x18>;
        };
      };
      port@2 {
        #address-cells = <0x01>;
        #size-cells = <0x00>;
        reg = <0x02>;
        phandle = <0x180>;
        endpoint@0 {
          reg = <0x00>;
          remote-endpoint = <0x85>;
          phandle = <0x2f>;
        };
        endpoint@1 {
          reg = <0x01>;
          remote-endpoint = <0x86>;
          phandle = <0x19>;
        };
      };
    };
  };
  iommu@fe043e00 {
    compatible = rockchip,iommu-v2;
    reg = <0x00 0xfe043e00 0x00 0x100 0x00 0xfe043f00 0x00 0x100>;
    interrupts = <0x00 0x94 0x04>;
    interrupt-names = vop_mmu;
    clocks = <0x1f 0xdd 0x1f 0xde>;
    clock-names = aclk\0iface;
    #iommu-cells = <0x00>;
    status = okay;
    phandle = <0x7b>;
  };
  dsi@fe060000 {
    compatible = rockchip,rk3568-mipi-dsi;
    reg = <0x00 0xfe060000 0x00 0x10000>;
    interrupts = <0x00 0x44 0x04>;
    clocks = <0x1f 0xe8 0x1f 0xda 0x2e>;
    clock-names = pclk\0hclk\0hs_clk;
    resets = <0x1f 0x110>;
    reset-names = apb;
    phys = <0x2e>;
    phy-names = mipi_dphy;
    power-domains = <0x21 0x09>;
    rockchip,grf = <0x32>;
    #address-cells = <0x01>;
    #size-cells = <0x00>;
    status = okay;
    phandle = <0x181>;
    ports {
      #address-cells = <0x01>;
      #size-cells = <0x00>;
      port@0 {
        reg = <0x00>;
        #address-cells = <0x01>;
        #size-cells = <0x00>;
        phandle = <0x182>;
        endpoint@0 {
          reg = <0x00>;
          remote-endpoint = <0x87>;
          status = disabled;
          phandle = <0x7c>;
        };
        endpoint@1 {
          reg = <0x01>;
          remote-endpoint = <0x14>;
          status = okay;
          phandle = <0x80>;
        };
      };
      port@1 {
        reg = <0x01>;
        endpoint {
          remote-endpoint = <0x88>;
          phandle = <0x8d>;
        };
      };
    };
    panel@0 {
      status = okay;
      compatible = simple-panel-dsi;
      reg = <0x00>;
      backlight = <0x89>;
      reset-delay-ms = <0x78>;
      enable-delay-ms = <0x78>;
      init-delay-ms = <0x78>;
      stbyb-delay-ms = <0x78>;
      prepare-delay-ms = <0x78>;
      unprepare-delay-ms = <0x78>;
      disable-delay-ms = <0x78>;
      dsi,flags = <0xa03>;
      dsi,format = <0x00>;
      dsi,lanes = <0x04>;
      width-mm = <0x44>;
      height-mm = <0x78>;
      panel-init-sequence = [39 00 04 b9 ff 83 99 15 00 02 d2 77 39 00 10 b1 02 04 74 94 01 32 33 11 11 ab 4d 56 73 02 02 39 00 10 b2 00 80 80 ae 05 07 5a 11 00 00 10 1e 70 03 d4 39 00 2d b4 00 ff 02 c0 02 c0 00 00 08 00 04 06 00 32 04 0a 08 21 03 01 00 0f b8 8b 02 c0 02 c0 00 00 08 00 04 06 00 32 04 0a 08 01 00 0f b8 01 39 00 22 d3 00 00 00 00 00 00 06 00 00 10 04 00 04 00 00 00 00 00 00 00 00 00 00 01 00 05 05 07 00 00 00 05 40 39 00 21 d5 18 18 19 19 18 18 21 20 01 00 07 06 05 04 03 02 18 18 18 18 18 18 2f 2f 30 30 31 31 18 18 18 18 39 00 21 d6 18 18 19 19 40 40 20 21 02 03 04 05 06 07 00 01 40 40 40 40 40 40 2f 2f 30 30 31 31 40 40 40 40 39 00 11 d8 a2 aa 02 a0 a2 a8 02 a0 b0 00 00 00 b0 00 00 00 15 00 02 bd 01 39 00 11 d8 b0 00 00 00 b0 00 00 00 e2 aa 03 f0 e2 aa 03 f0 15 00 02 bd 02 39 00 09 d8 e2 aa 03 f0 e2 aa 03 f0 15 00 02 bd 00 39 00 03 b6 7a 7a 39 00 37 e0 00 18 27 24 5a 68 79 78 81 8a 92 99 9e a7 af b4 b9 c3 c7 d1 c6 d4 d5 6c 67 71 77 00 00 18 27 24 5a 68 79 78 81 8a 92 99 9e a7 af b4 b9 c3 c7 d1 c6 d4 d5 6c 67 77 39 00 03 c6 ff f9 15 00 02 cc 08 05 78 01 11 05 14 01 29];
      panel-exit-sequence = <0x5000128 0x5000110>;
      power-supply = <0x8a>;
      reset-gpios = <0x36 0x15 0x01>;
      pinctrl-names = default;
      pinctrl-0 = <0x8b>;
      phandle = <0x183>;
      display-timings {
        native-mode = <0x8c>;
        phandle = <0x184>;
        timing0 {
          clock-frequency = <0x7641700>;
          hactive = <0x438>;
          vactive = <0x780>;
          hfront-porch = <0x20>;
          hsync-len = <0x08>;
          hback-porch = <0x20>;
          vfront-porch = <0x10>;
          vsync-len = <0x02>;
          vback-porch = <0x0e>;
          hsync-active = <0x00>;
          vsync-active = <0x00>;
          de-active = <0x00>;
          pixelclk-active = <0x01>;
          phandle = <0x8c>;
        };
      };
      ports {
        #address-cells = <0x01>;
        #size-cells = <0x00>;
        port@0 {
          reg = <0x00>;
          endpoint {
            remote-endpoint = <0x8d>;
            phandle = <0x88>;
          };
        };
      };
    };
  };
  dsi@fe070000 {
    compatible = rockchip,rk3568-mipi-dsi;
    reg = <0x00 0xfe070000 0x00 0x10000>;
    interrupts = <0x00 0x45 0x04>;
    clocks = <0x1f 0xe9 0x1f 0xda 0x8e>;
    clock-names = pclk\0hclk\0hs_clk;
    resets = <0x1f 0x111>;
    reset-names = apb;
    phys = <0x8e>;
    phy-names = mipi_dphy;
    power-domains = <0x21 0x09>;
    rockchip,grf = <0x32>;
    #address-cells = <0x01>;
    #size-cells = <0x00>;
    status = disabled;
    phandle = <0x185>;
    ports {
      #address-cells = <0x01>;
      #size-cells = <0x00>;
      port@0 {
        reg = <0x00>;
        #address-cells = <0x01>;
        #size-cells = <0x00>;
        phandle = <0x186>;
        endpoint@0 {
          reg = <0x00>;
          remote-endpoint = <0x15>;
          status = disabled;
          phandle = <0x7d>;
        };
        endpoint@1 {
          reg = <0x01>;
          remote-endpoint = <0x8f>;
          status = disabled;
          phandle = <0x81>;
        };
      };
      port@1 {
        reg = <0x01>;
        endpoint {
          remote-endpoint = <0x90>;
          phandle = <0x95>;
        };
      };
    };
    panel@0 {
      status = okay;
      compatible = simple-panel-dsi;
      reg = <0x00>;
      backlight = <0x91>;
      reset-delay-ms = <0x3c>;
      enable-delay-ms = <0x3c>;
      prepare-delay-ms = <0x3c>;
      unprepare-delay-ms = <0x3c>;
      disable-delay-ms = <0x3c>;
      dsi,flags = <0xa03>;
      dsi,format = <0x00>;
      dsi,lanes = <0x04>;
      panel-init-sequence = <0x5780111 0x51e0129>;
      panel-exit-sequence = <0x5000128 0x5000110>;
      power-supply = <0x92>;
      reset-gpios = <0x3f 0x04 0x01>;
      pinctrl-names = default;
      pinctrl-0 = <0x93>;
      phandle = <0x187>;
      display-timings {
        native-mode = <0x94>;
        phandle = <0x188>;
        timing0 {
          clock-frequency = <0x7de2900>;
          hactive = <0x438>;
          vactive = <0x780>;
          hfront-porch = <0x0f>;
          hsync-len = <0x02>;
          hback-porch = <0x1e>;
          vfront-porch = <0x0f>;
          vsync-len = <0x02>;
          vback-porch = <0x0f>;
          hsync-active = <0x00>;
          vsync-active = <0x00>;
          de-active = <0x00>;
          pixelclk-active = <0x01>;
          phandle = <0x94>;
        };
      };
      ports {
        #address-cells = <0x01>;
        #size-cells = <0x00>;
        port@0 {
          reg = <0x00>;
          endpoint {
            remote-endpoint = <0x95>;
            phandle = <0x90>;
          };
        };
      };
    };
  };
  hdmi@fe0a0000 {
    compatible = rockchip,rk3568-dw-hdmi;
    reg = <0x00 0xfe0a0000 0x00 0x20000>;
    interrupts = <0x00 0x2d 0x04>;
    clocks = <0x1f 0xe6 0x1f 0xe7 0x1f 0x193 0x31 0x02 0x1f 0xde>;
    clock-names = iahb\0isfr\0cec\0ref\0hclk;
    power-domains = <0x21 0x09>;
    reg-io-width = <0x04>;
    rockchip,grf = <0x32>;
    #sound-dai-cells = <0x00>;
    pinctrl-names = default;
    pinctrl-0 = <0x96 0x97 0x98>;
    status = disabled;
    rockchip,phy-table = <0x58834d4 0x8009 0x00 0x270 0x9d5b340 0x800b 0x00 0x26d 0xb1069a8 0x800b 0x00 0x1ed 0x11b3dc40 0x800b 0x00 0x1ad 0x2367b880 0x8029 0x00 0x88 0x00 0x00 0x00 0x00>;
    phandle = <0x119>;
    ports {
      #address-cells = <0x01>;
      #size-cells = <0x00>;
      port {
        reg = <0x00>;
        #address-cells = <0x01>;
        #size-cells = <0x00>;
        phandle = <0x189>;
        endpoint@0 {
          reg = <0x00>;
          remote-endpoint = <0x17>;
          status = disabled;
          phandle = <0x7f>;
        };
        endpoint@1 {
          reg = <0x01>;
          remote-endpoint = <0x99>;
          status = disabled;
          phandle = <0x83>;
        };
      };
    };
  };
  edp@fe0c0000 {
    compatible = rockchip,rk3568-edp;
    reg = <0x00 0xfe0c0000 0x00 0x10000>;
    interrupts = <0x00 0x12 0x04>;
    clocks = <0x31 0x29 0x1f 0xea 0x1f 0xeb 0x1f 0xda>;
    clock-names = dp\0pclk\0spdif\0hclk;
    resets = <0x1f 0x113 0x1f 0x112>;
    reset-names = dp\0apb;
    phys = <0x9a>;
    phy-names = dp;
    power-domains = <0x21 0x09>;
    status = disabled;
    phandle = <0x18a>;
    ports {
      #address-cells = <0x01>;
      #size-cells = <0x00>;
      port@0 {
        reg = <0x00>;
        #address-cells = <0x01>;
        #size-cells = <0x00>;
        phandle = <0x18b>;
        endpoint@0 {
          reg = <0x00>;
          remote-endpoint = <0x16>;
          status = disabled;
          phandle = <0x7e>;
        };
        endpoint@1 {
          reg = <0x01>;
          remote-endpoint = <0x9b>;
          status = disabled;
          phandle = <0x82>;
        };
      };
    };
  };
  nocp-cpu@fe102000 {
    compatible = rockchip,rk3568-nocp;
    reg = <0x00 0xfe102000 0x00 0x100>;
    phandle = <0x9d>;
  };
  nocp-gpu-vpu-rga-venc@fe102400 {
    compatible = rockchip,rk3568-nocp;
    reg = <0x00 0xfe102400 0x00 0x100>;
    phandle = <0x18c>;
  };
  nocp-vdec@fe102800 {
    compatible = rockchip,rk3568-nocp;
    reg = <0x00 0xfe102800 0x00 0x100>;
    phandle = <0x18d>;
  };
  nocp-vi-usb-peri-pipe@fe102c00 {
    compatible = rockchip,rk3568-nocp;
    reg = <0x00 0xfe102c00 0x00 0x100>;
    phandle = <0x18e>;
  };
  nocp-vo@fe103000 {
    compatible = rockchip,rk3568-nocp;
    reg = <0x00 0xfe103000 0x00 0x100>;
    phandle = <0x18f>;
  };
  qos@fe128000 {
    compatible = syscon;
    reg = <0x00 0xfe128000 0x00 0x20>;
    phandle = <0x47>;
  };
  qos@fe138080 {
    compatible = syscon;
    reg = <0x00 0xfe138080 0x00 0x20>;
    phandle = <0x56>;
  };
  qos@fe138100 {
    compatible = syscon;
    reg = <0x00 0xfe138100 0x00 0x20>;
    phandle = <0x57>;
  };
  qos@fe138180 {
    compatible = syscon;
    reg = <0x00 0xfe138180 0x00 0x20>;
    phandle = <0x58>;
  };
  qos@fe148000 {
    compatible = syscon;
    reg = <0x00 0xfe148000 0x00 0x20>;
    phandle = <0x48>;
  };
  qos@fe148080 {
    compatible = syscon;
    reg = <0x00 0xfe148080 0x00 0x20>;
    phandle = <0x49>;
  };
  qos@fe148100 {
    compatible = syscon;
    reg = <0x00 0xfe148100 0x00 0x20>;
    phandle = <0x4a>;
  };
  qos@fe150000 {
    compatible = syscon;
    reg = <0x00 0xfe150000 0x00 0x20>;
    phandle = <0x54>;
  };
  qos@fe158000 {
    compatible = syscon;
    reg = <0x00 0xfe158000 0x00 0x20>;
    phandle = <0x4e>;
  };
  qos@fe158100 {
    compatible = syscon;
    reg = <0x00 0xfe158100 0x00 0x20>;
    phandle = <0x4f>;
  };
  qos@fe158180 {
    compatible = syscon;
    reg = <0x00 0xfe158180 0x00 0x20>;
    phandle = <0x50>;
  };
  qos@fe158200 {
    compatible = syscon;
    reg = <0x00 0xfe158200 0x00 0x20>;
    phandle = <0x51>;
  };
  qos@fe158280 {
    compatible = syscon;
    reg = <0x00 0xfe158280 0x00 0x20>;
    phandle = <0x52>;
  };
  qos@fe158300 {
    compatible = syscon;
    reg = <0x00 0xfe158300 0x00 0x20>;
    phandle = <0x53>;
  };
  qos@fe180000 {
    compatible = syscon;
    reg = <0x00 0xfe180000 0x00 0x20>;
    phandle = <0x46>;
  };
  qos@fe190000 {
    compatible = syscon;
    reg = <0x00 0xfe190000 0x00 0x20>;
    phandle = <0x59>;
  };
  qos@fe190280 {
    compatible = syscon;
    reg = <0x00 0xfe190280 0x00 0x20>;
    phandle = <0x5a>;
  };
  qos@fe190300 {
    compatible = syscon;
    reg = <0x00 0xfe190300 0x00 0x20>;
    phandle = <0x5b>;
  };
  qos@fe190380 {
    compatible = syscon;
    reg = <0x00 0xfe190380 0x00 0x20>;
    phandle = <0x5c>;
  };
  qos@fe190400 {
    compatible = syscon;
    reg = <0x00 0xfe190400 0x00 0x20>;
    phandle = <0x5d>;
  };
  qos@fe198000 {
    compatible = syscon;
    reg = <0x00 0xfe198000 0x00 0x20>;
    phandle = <0x55>;
  };
  qos@fe1a8000 {
    compatible = syscon;
    reg = <0x00 0xfe1a8000 0x00 0x20>;
    phandle = <0x4b>;
  };
  qos@fe1a8080 {
    compatible = syscon;
    reg = <0x00 0xfe1a8080 0x00 0x20>;
    phandle = <0x4c>;
  };
  qos@fe1a8100 {
    compatible = syscon;
    reg = <0x00 0xfe1a8100 0x00 0x20>;
    phandle = <0x4d>;
  };
  dwmmc@fe000000 {
    compatible = rockchip,rk3568-dw-mshc\0rockchip,rk3288-dw-mshc;
    reg = <0x00 0xfe000000 0x00 0x4000>;
    interrupts = <0x00 0x64 0x04>;
    max-frequency = <0x8f0d180>;
    clocks = <0x1f 0xc1 0x1f 0xc2 0x1f 0x18e 0x1f 0x18f>;
    clock-names = biu\0ciu\0ciu-drive\0ciu-sample;
    fifo-depth = <0x100>;
    resets = <0x1f 0xeb>;
    reset-names = reset;
    status = disabled;
    phandle = <0x190>;
  };
  dfi@fe230000 {
    reg = <0x00 0xfe230000 0x00 0x400>;
    compatible = rockchip,rk3568-dfi;
    rockchip,pmugrf = <0x33>;
    status = okay;
    phandle = <0x9c>;
  };
  dmc {
    compatible = rockchip,rk3568-dmc;
    interrupts = <0x00 0x0a 0x04>;
    interrupt-names = complete;
    devfreq-events = <0x9c 0x9d>;
    clocks = <0x02 0x03>;
    clock-names = dmc_clk;
    operating-points-v2 = <0x9e>;
    ddr_timing = <0x9f>;
    vop-bw-dmc-freq = <0x00 0x23c 0x4f1a0 0x23d 0x1869f 0x80e80>;
    cpu-bw-dmc-freq = <0x00 0x15e 0x4f1a0 0x15f 0x190 0x80e80 0x191 0x1869f 0xbe6e0>;
    upthreshold = <0x28>;
    downdifferential = <0x14>;
    system-status-level = <0x01 0x04 0x08 0x08 0x02 0x01 0x10 0x04 0x10000 0x04 0x1000 0x08 0x4000 0x08 0x2000 0x08 0xc00 0x08>;
    auto-min-freq = <0x4f1a0>;
    auto-freq-en = <0x01>;
    #cooling-cells = <0x02>;
    status = okay;
    center-supply = <0x63>;
    phandle = <0x13>;
  };
  dmc-opp-table {
    compatible = operating-points-v2;
    mbist-vmin = <0xc96a8 0xdbba0 0xe7ef0>;
    nvmem-cells = <0xa0 0x07 0x08>;
    nvmem-cell-names = leakage\0pvtm\0mbist-vmin;
    rockchip,temp-hysteresis = <0x1388>;
    rockchip,low-temp = <0x00>;
    rockchip,low-temp-adjust-volt = <0x00 0x618 0x61a8>;
    rockchip,leakage-voltage-sel = <0x01 0x50 0x00 0x51 0xfe 0x01>;
    phandle = <0x9e>;
    opp-1560000000 {
      opp-hz = <0x00 0x5cfbb600>;
      opp-microvolt = <0xdbba0>;
      opp-microvolt-L0 = <0xdbba0>;
      opp-microvolt-L1 = <0xcf850>;
    };
  };
  dmcdbg {
    compatible = rockchip,rk3568-dmcdbg;
    status = disabled;
    phandle = <0x191>;
  };
  pcie@fe260000 {
    compatible = rockchip,rk3568-pcie\0snps,dw-pcie;
    #address-cells = <0x03>;
    #size-cells = <0x02>;
    bus-range = <0x00 0x0f>;
    clocks = <0x1f 0x81 0x1f 0x82 0x1f 0x83 0x1f 0x84 0x1f 0x85>;
    clock-names = aclk_mst\0aclk_slv\0aclk_dbi\0pclk\0aux;
    device_type = pci;
    interrupts = <0x00 0x4b 0x04 0x00 0x4a 0x04 0x00 0x49 0x04 0x00 0x48 0x04 0x00 0x47 0x04>;
    interrupt-names = sys\0pmc\0msg\0legacy\0err;
    #interrupt-cells = <0x01>;
    interrupt-map-mask = <0x00 0x00 0x00 0x07>;
    interrupt-map = <0x00 0x00 0x00 0x01 0xa1 0x00 0x00 0x00 0x00 0x02 0xa1 0x01 0x00 0x00 0x00 0x03 0xa1 0x02 0x00 0x00 0x00 0x04 0xa1 0x03>;
    linux,pci-domain = <0x00>;
    num-ib-windows = <0x06>;
    num-ob-windows = <0x02>;
    max-link-speed = <0x02>;
    msi-map = <0x00 0xa2 0x00 0x1000>;
    num-lanes = <0x01>;
    phys = <0x22 0x02>;
    phy-names = pcie-phy;
    power-domains = <0x21 0x0f>;
    ranges = <0x800 0x00 0x00 0x03 0x00 0x00 0x800000 0x81000000 0x00 0x800000 0x03 0x800000 0x00 0x100000 0x83000000 0x00 0x900000 0x03 0x900000 0x00 0x3f700000>;
    reg = <0x03 0xc0000000 0x00 0x400000 0x00 0xfe260000 0x00 0x10000>;
    reg-names = pcie-dbi\0pcie-apb;
    resets = <0x1f 0xa1>;
    reset-names = pipe;
    status = okay;
    reset-gpios = <0xa3 0x0a 0x00>;
    vpcie3v3-supply = <0xa4>;
    phandle = <0x192>;
    legacy-interrupt-controller {
      #address-cells = <0x00>;
      #interrupt-cells = <0x01>;
      interrupt-parent = <0x01>;
      interrupts = <0x00 0x48 0x01>;
      phandle = <0xa1>;
    };
  };
  dwmmc@fe2b0000 {
    compatible = rockchip,rk3568-dw-mshc\0rockchip,rk3288-dw-mshc;
    reg = <0x00 0xfe2b0000 0x00 0x4000>;
    interrupts = <0x00 0x62 0x04>;
    max-frequency = <0x8f0d180>;
    clocks = <0x1f 0xb0 0x1f 0xb1 0x1f 0x18a 0x1f 0x18b>;
    clock-names = biu\0ciu\0ciu-drive\0ciu-sample;
    fifo-depth = <0x100>;
    resets = <0x1f 0xd4>;
    reset-names = reset;
    status = okay;
    bus-width = <0x04>;
    vmmc-supply = <0xa5>;
    vqmmc-supply = <0x2b>;
    pinctrl-names = default;
    pinctrl-0 = <0xa6 0xa7 0xa8 0xa9>;
    phandle = <0x193>;
  };
  dwmmc@fe2c0000 {
    compatible = rockchip,rk3568-dw-mshc\0rockchip,rk3288-dw-mshc;
    reg = <0x00 0xfe2c0000 0x00 0x4000>;
    interrupts = <0x00 0x63 0x04>;
    max-frequency = <0x8f0d180>;
    clocks = <0x1f 0xb2 0x1f 0xb3 0x1f 0x18c 0x1f 0x18d>;
    clock-names = biu\0ciu\0ciu-drive\0ciu-sample;
    fifo-depth = <0x100>;
    resets = <0x1f 0xd6>;
    reset-names = reset;
    status = okay;
    bus-width = <0x04>;
    mmc-pwrseq = <0xaa>;
    pinctrl-names = default;
    pinctrl-0 = <0xab 0xac 0xad>;
    phandle = <0x194>;
  };
  sfc@fe300000 {
    compatible = rockchip,sfc;
    reg = <0x00 0xfe300000 0x00 0x4000>;
    interrupts = <0x00 0x65 0x04>;
    clocks = <0x1f 0x78 0x1f 0x76>;
    clock-names = clk_sfc\0hclk_sfc;
    assigned-clocks = <0x1f 0x78>;
    assigned-clock-rates = <0x5f5e100>;
    status = okay;
    phandle = <0x195>;
  };
  sdhci@fe310000 {
    compatible = rockchip,dwcmshc-sdhci\0snps,dwcmshc-sdhci;
    reg = <0x00 0xfe310000 0x00 0x10000>;
    interrupts = <0x00 0x13 0x04>;
    assigned-clocks = <0x1f 0x7b 0x1f 0x7d 0x1f 0x7c>;
    assigned-clock-rates = <0xbebc200 0x16e3600 0xbebc200>;
    clocks = <0x1f 0x7c 0x1f 0x7a 0x1f 0x79 0x1f 0x7b 0x1f 0x7d>;
    clock-names = core\0bus\0axi\0block\0timer;
    status = okay;
    bus-width = <0x08>;
    max-frequency = <0xbebc200>;
    phandle = <0x196>;
  };
  nandc@fe330000 {
    compatible = rockchip,rk-nandc-v9;
    reg = <0x00 0xfe330000 0x00 0x4000>;
    interrupts = <0x00 0x46 0x04>;
    nandc_id = <0x00>;
    clocks = <0x1f 0x75 0x1f 0x74>;
    clock-names = clk_nandc\0hclk_nandc;
    status = okay;
    #address-cells = <0x01>;
    #size-cells = <0x00>;
    phandle = <0x197>;
    nand@0 {
      reg = <0x00>;
      nand-bus-width = <0x08>;
      nand-ecc-mode = hw;
      nand-ecc-strength = <0x10>;
      nand-ecc-step-size = <0x400>;
    };
  };
  crypto@fe380000 {
    compatible = rockchip,rk3568-crypto;
    reg = <0x00 0xfe380000 0x00 0x4000>;
    interrupts = <0x00 0x04 0x04>;
    clocks = <0x1f 0x6a 0x1f 0x6b 0x1f 0x6c 0x1f 0x6d>;
    clock-names = aclk\0hclk\0sclk\0apb_pclk;
    assigned-clocks = <0x1f 0x6c>;
    assigned-clock-rates = <0xbebc200>;
    resets = <0x1f 0x69>;
    reset-names = crypto-rst;
    status = disabled;
    phandle = <0x198>;
  };
  rng@fe388000 {
    compatible = rockchip,cryptov2-rng;
    reg = <0x00 0xfe388000 0x00 0x2000>;
    clocks = <0x1f 0x70 0x1f 0x6f>;
    clock-names = clk_trng\0hclk_trng;
    resets = <0x1f 0x6d>;
    reset-names = reset;
    status = okay;
    phandle = <0x199>;
  };
  otp@fe38c000 {
    compatible = rockchip,rk3568-otp;
    reg = <0x00 0xfe38c000 0x00 0x4000>;
    #address-cells = <0x01>;
    #size-cells = <0x01>;
    clocks = <0x1f 0x73 0x1f 0x72 0x1f 0x71 0x1f 0x181>;
    clock-names = usr\0sbpi\0apb\0phy;
    resets = <0x1f 0x1cf>;
    reset-names = otp_phy;
    phandle = <0x19a>;
    cpu-code@2 {
      reg = <0x02 0x02>;
      phandle = <0x0f>;
    };
    cpu-version@8 {
      reg = <0x08 0x01>;
      bits = <0x03 0x03>;
      phandle = <0x0e>;
    };
    mbist-vmin@9 {
      reg = <0x09 0x01>;
      bits = <0x00 0x04>;
      phandle = <0x08>;
    };
    id@a {
      reg = <0x0a 0x10>;
      phandle = <0x0d>;
    };
    cpu-leakage@1a {
      reg = <0x1a 0x01>;
      phandle = <0x06>;
    };
    log-leakage@1b {
      reg = <0x1b 0x01>;
      phandle = <0xa0>;
    };
    npu-leakage@1c {
      reg = <0x1c 0x01>;
      phandle = <0x61>;
    };
    gpu-leakage@1d {
      reg = <0x1d 0x01>;
      phandle = <0x66>;
    };
    core-pvtm@2a {
      reg = <0x2a 0x02>;
      phandle = <0x07>;
    };
  };
  i2s@fe400000 {
    compatible = rockchip,rk3568-i2s-tdm;
    reg = <0x00 0xfe400000 0x00 0x1000>;
    interrupts = <0x00 0x34 0x04>;
    clocks = <0x1f 0x3f 0x1f 0x43 0x1f 0x39>;
    clock-names = mclk_tx\0mclk_rx\0hclk;
    dmas = <0xae 0x00>;
    dma-names = tx;
    resets = <0x1f 0x50 0x1f 0x51>;
    reset-names = tx-m\0rx-m;
    rockchip,cru = <0x1f>;
    rockchip,grf = <0x32>;
    #sound-dai-cells = <0x00>;
    status = okay;
    phandle = <0x118>;
  };
  i2s@fe410000 {
    compatible = rockchip,rk3568-i2s-tdm;
    reg = <0x00 0xfe410000 0x00 0x1000>;
    interrupts = <0x00 0x35 0x04>;
    clocks = <0x1f 0x47 0x1f 0x4b 0x1f 0x3a>;
    clock-names = mclk_tx\0mclk_rx\0hclk;
    dmas = <0xae 0x02 0xae 0x03>;
    dma-names = tx\0rx;
    resets = <0x1f 0x52 0x1f 0x53>;
    reset-names = tx-m\0rx-m;
    rockchip,cru = <0x1f>;
    rockchip,grf = <0x32>;
    #sound-dai-cells = <0x00>;
    pinctrl-names = default;
    pinctrl-0 = <0xaf 0xb0 0xb1 0xb2>;
    status = okay;
    rockchip,clk-trcm = <0x01>;
    phandle = <0xc1>;
  };
  i2s@fe420000 {
    compatible = rockchip,rk3568-i2s-tdm;
    reg = <0x00 0xfe420000 0x00 0x1000>;
    interrupts = <0x00 0x36 0x04>;
    clocks = <0x1f 0x4f 0x1f 0x4f 0x1f 0x3b>;
    clock-names = mclk_tx\0mclk_rx\0hclk;
    dmas = <0xae 0x04 0xae 0x05>;
    dma-names = tx\0rx;
    rockchip,cru = <0x1f>;
    rockchip,grf = <0x32>;
    rockchip,clk-trcm = <0x01>;
    #sound-dai-cells = <0x00>;
    pinctrl-names = default;
    pinctrl-0 = <0xb3 0xb4 0xb5 0xb6>;
    status = disabled;
    phandle = <0x19b>;
  };
  i2s@fe430000 {
    compatible = rockchip,rk3568-i2s-tdm;
    reg = <0x00 0xfe430000 0x00 0x1000>;
    interrupts = <0x00 0x37 0x04>;
    clocks = <0x1f 0x53 0x1f 0x57 0x1f 0x3c>;
    clock-names = mclk_tx\0mclk_rx\0hclk;
    dmas = <0xae 0x06 0xae 0x07>;
    dma-names = tx\0rx;
    resets = <0x1f 0x55 0x1f 0x56>;
    reset-names = tx-m\0rx-m;
    rockchip,cru = <0x1f>;
    rockchip,grf = <0x32>;
    rockchip,clk-trcm = <0x01>;
    #sound-dai-cells = <0x00>;
    pinctrl-names = default;
    pinctrl-0 = <0xb7 0xb8 0xb9 0xba>;
    status = disabled;
    phandle = <0x114>;
  };
  pdm@fe440000 {
    compatible = rockchip,rk3568-pdm;
    reg = <0x00 0xfe440000 0x00 0x1000>;
    clocks = <0x1f 0x5a 0x1f 0x59>;
    clock-names = pdm_clk\0pdm_hclk;
    dmas = <0xae 0x09>;
    dma-names = rx;
    pinctrl-names = default;
    pinctrl-0 = <0xbb 0xbc 0xbd 0xbe 0xbf 0xc0>;
    #sound-dai-cells = <0x00>;
    status = disabled;
    phandle = <0x11b>;
  };
  vad@fe450000 {
    compatible = rockchip,rk3568-vad;
    reg = <0x00 0xfe450000 0x00 0x10000>;
    reg-names = vad;
    clocks = <0x1f 0x5b>;
    clock-names = hclk;
    interrupts = <0x00 0x89 0x04>;
    rockchip,audio-src = <0xc1>;
    rockchip,det-channel = <0x00>;
    rockchip,mode = <0x00>;
    #sound-dai-cells = <0x00>;
    status = disabled;
    rockchip,buffer-time-ms = <0x80>;
    phandle = <0x120>;
  };
  spdif@fe460000 {
    compatible = rockchip,rk3568-spdif;
    reg = <0x00 0xfe460000 0x00 0x1000>;
    interrupts = <0x00 0x66 0x04>;
    dmas = <0xae 0x01>;
    dma-names = tx;
    clock-names = mclk\0hclk;
    clocks = <0x1f 0x5f 0x1f 0x5c>;
    #sound-dai-cells = <0x00>;
    pinctrl-names = default;
    pinctrl-0 = <0xc2>;
    status = disabled;
    phandle = <0x11e>;
  };
  audpwm@fe470000 {
    compatible = rockchip,rk3568-audio-pwm\0rockchip,audio-pwm-v1;
    reg = <0x00 0xfe470000 0x00 0x1000>;
    clocks = <0x1f 0x63 0x1f 0x60>;
    clock-names = clk\0hclk;
    dmas = <0xae 0x08>;
    dma-names = tx;
    #sound-dai-cells = <0x00>;
    rockchip,sample-width-bits = <0x0b>;
    rockchip,interpolat-points = <0x01>;
    status = disabled;
    phandle = <0x19c>;
  };
  codec-digital@fe478000 {
    compatible = rockchip,rk3568-codec-digital\0rockchip,codec-digital-v1;
    reg = <0x00 0xfe478000 0x00 0x1000>;
    clocks = <0x1f 0x67 0x1f 0x66 0x1f 0x65 0x1f 0x64>;
    clock-names = adc\0dac\0i2c\0pclk;
    pinctrl-names = default;
    pinctrl-0 = <0xc3>;
    resets = <0x1f 0x5f>;
    reset-names = reset;
    rockchip,grf = <0x32>;
    #sound-dai-cells = <0x00>;
    status = disabled;
    phandle = <0x115>;
  };
  dmac@fe530000 {
    compatible = arm,pl330\0arm,primecell;
    reg = <0x00 0xfe530000 0x00 0x4000>;
    interrupts = <0x00 0x0e 0x04 0x00 0x0d 0x04>;
    clocks = <0x1f 0x10d>;
    clock-names = apb_pclk;
    #dma-cells = <0x01>;
    phandle = <0x40>;
  };
  dmac@fe550000 {
    compatible = arm,pl330\0arm,primecell;
    reg = <0x00 0xfe550000 0x00 0x4000>;
    interrupts = <0x00 0x10 0x04 0x00 0x0f 0x04>;
    clocks = <0x1f 0x10d>;
    clock-names = apb_pclk;
    #dma-cells = <0x01>;
    phandle = <0xae>;
  };
  rkscr@fe560000 {
    compatible = rockchip-scr;
    reg = <0x00 0xfe560000 0x00 0x10000>;
    interrupts = <0x00 0x61 0x04>;
    pinctrl-names = default;
    pinctrl-0 = <0xc4>;
    clocks = <0x1f 0x114>;
    clock-names = g_pclk_sim_card;
    status = disabled;
    phandle = <0x19d>;
  };
  can@fe570000 {
    compatible = rockchip,canfd-1.0;
    reg = <0x00 0xfe570000 0x00 0x1000>;
    interrupts = <0x00 0x01 0x04>;
    clocks = <0x1f 0x141 0x1f 0x140>;
    clock-names = baudclk\0apb_pclk;
    resets = <0x1f 0x155 0x1f 0x154>;
    reset-names = can\0can-apb;
    tx-fifo-depth = <0x01>;
    rx-fifo-depth = <0x06>;
    status = disabled;
    assigned-clocks = <0x1f 0x141>;
    assigned-clock-rates = <0x8f0d180>;
    pinctrl-names = default;
    pinctrl-0 = <0xc5>;
    phandle = <0x19e>;
  };
  can@fe580000 {
    compatible = rockchip,canfd-1.0;
    reg = <0x00 0xfe580000 0x00 0x1000>;
    interrupts = <0x00 0x02 0x04>;
    clocks = <0x1f 0x143 0x1f 0x142>;
    clock-names = baudclk\0apb_pclk;
    resets = <0x1f 0x157 0x1f 0x156>;
    reset-names = can\0can-apb;
    tx-fifo-depth = <0x01>;
    rx-fifo-depth = <0x06>;
    status = disabled;
    assigned-clocks = <0x1f 0x143>;
    assigned-clock-rates = <0x8f0d180>;
    pinctrl-names = default;
    pinctrl-0 = <0xc6>;
    phandle = <0x19f>;
  };
  can@fe590000 {
    compatible = rockchip,canfd-1.0;
    reg = <0x00 0xfe590000 0x00 0x1000>;
    interrupts = <0x00 0x03 0x04>;
    clocks = <0x1f 0x145 0x1f 0x144>;
    clock-names = baudclk\0apb_pclk;
    resets = <0x1f 0x159 0x1f 0x158>;
    reset-names = can\0can-apb;
    tx-fifo-depth = <0x01>;
    rx-fifo-depth = <0x06>;
    status = disabled;
    assigned-clocks = <0x1f 0x145>;
    assigned-clock-rates = <0x8f0d180>;
    pinctrl-names = default;
    pinctrl-0 = <0xc7>;
    phandle = <0x1a0>;
  };
  i2c@fe5a0000 {
    compatible = rockchip,rk3399-i2c;
    reg = <0x00 0xfe5a0000 0x00 0x1000>;
    clocks = <0x1f 0x148 0x1f 0x147>;
    clock-names = i2c\0pclk;
    interrupts = <0x00 0x2f 0x04>;
    pinctrl-names = default;
    pinctrl-0 = <0xc8>;
    #address-cells = <0x01>;
    #size-cells = <0x00>;
    status = disabled;
    phandle = <0x1a1>;
    gt1x@14 {
      compatible = goodix,gt1x;
      status = disabled;
      reg = <0x14>;
      pinctrl-names = default;
      pinctrl-0 = <0xc9>;
      goodix,rst-gpio = <0x36 0x0e 0x00>;
      goodix,irq-gpio = <0x36 0x0d 0x08>;
      power-supply = <0x8a>;
      phandle = <0x1a2>;
    };
  };
  i2c@fe5b0000 {
    compatible = rockchip,rk3399-i2c;
    reg = <0x00 0xfe5b0000 0x00 0x1000>;
    clocks = <0x1f 0x14a 0x1f 0x149>;
    clock-names = i2c\0pclk;
    interrupts = <0x00 0x30 0x04>;
    pinctrl-names = default;
    pinctrl-0 = <0xca>;
    #address-cells = <0x01>;
    #size-cells = <0x00>;
    status = okay;
    phandle = <0x1a3>;
    gc5035@37 {
      compatible = galaxycore,gc5035;
      status = okay;
      reg = <0x37>;
      clocks = <0x1f 0xd7>;
      clock-names = xvclk;
      power-domains = <0x21 0x08>;
      pinctrl-names = rockchip,camera_default;
      pinctrl-0 = <0xcb>;
      reset-gpios = <0xcc 0x08 0x00>;
      pwdn-gpios = <0x3f 0x16 0x00>;
      rockchip,camera-module-index = <0x00>;
      rockchip,camera-module-facing = back;
      rockchip,camera-module-name = XHG-RKX11F-V5;
      rockchip,camera-module-lens-name = HR232H65;
      phandle = <0x1a4>;
      port {
        endpoint {
          remote-endpoint = <0xcd>;
          data-lanes = <0x01 0x02>;
          phandle = <0x100>;
        };
      };
    };
    gc5025@37 {
      compatible = galaxycore,gc5025;
      status = okay;
      reg = <0x37>;
      clocks = <0x1f 0xd7>;
      clock-names = xvclk;
      power-domains = <0x21 0x08>;
      pinctrl-names = rockchip,camera_default;
      pinctrl-0 = <0xcb>;
      reset-gpios = <0xcc 0x08 0x01>;
      pwdn-gpios = <0x3f 0x16 0x01>;
      rockchip,camera-module-index = <0x01>;
      rockchip,camera-module-facing = back;
      rockchip,camera-module-name = TongJu;
      rockchip,camera-module-lens-name = CHT842-MD;
      phandle = <0x1a5>;
      port {
        endpoint {
          remote-endpoint = <0xce>;
          data-lanes = <0x01 0x02>;
          phandle = <0x101>;
        };
      };
    };
  };
  i2c@fe5c0000 {
    compatible = rockchip,rk3399-i2c;
    reg = <0x00 0xfe5c0000 0x00 0x1000>;
    clocks = <0x1f 0x14c 0x1f 0x14b>;
    clock-names = i2c\0pclk;
    interrupts = <0x00 0x31 0x04>;
    pinctrl-names = default;
    pinctrl-0 = <0xcf>;
    #address-cells = <0x01>;
    #size-cells = <0x00>;
    status = okay;
    phandle = <0x1a6>;
    hym8563@51 {
      compatible = haoyu,hym8563;
      reg = <0x51>;
      #clock-cells = <0x00>;
      phandle = <0x1a7>;
    };
  };
  i2c@fe5d0000 {
    compatible = rockchip,rk3399-i2c;
    reg = <0x00 0xfe5d0000 0x00 0x1000>;
    clocks = <0x1f 0x14e 0x1f 0x14d>;
    clock-names = i2c\0pclk;
    interrupts = <0x00 0x32 0x04>;
    pinctrl-names = default;
    pinctrl-0 = <0xd0>;
    #address-cells = <0x01>;
    #size-cells = <0x00>;
    status = okay;
    phandle = <0x1a8>;
    sitronix@55 {
      compatible = sitronix,st1633i;
      status = okay;
      reg = <0x55>;
      sitronix,reset-gpios = <0xcc 0x06 0x01>;
      sitronix,interrupt-gpios = <0xcc 0x09 0x02>;
      phandle = <0x1a9>;
    };
  };
  i2c@fe5e0000 {
    compatible = rockchip,rk3399-i2c;
    reg = <0x00 0xfe5e0000 0x00 0x1000>;
    clocks = <0x1f 0x150 0x1f 0x14f>;
    clock-names = i2c\0pclk;
    interrupts = <0x00 0x33 0x04>;
    pinctrl-names = default;
    pinctrl-0 = <0xd1>;
    #address-cells = <0x01>;
    #size-cells = <0x00>;
    status = disabled;
    phandle = <0x1aa>;
    mxc6655xa@15 {
      status = disabled;
      compatible = gs_mxc6655xa;
      pinctrl-names = default;
      pinctrl-0 = <0xd2>;
      reg = <0x15>;
      irq-gpio = <0x3f 0x11 0x08>;
      irq_enable = <0x00>;
      poll_delay_ms = <0x1e>;
      type = <0x02>;
      power-off-in-suspend = <0x01>;
      layout = <0x01>;
      phandle = <0x1ab>;
    };
  };
  timer@fe5f0000 {
    compatible = rockchip,rk3568-timer\0rockchip,rk3288-timer;
    reg = <0x00 0xfe5f0000 0x00 0x1000>;
    interrupts = <0x00 0x6d 0x04>;
    clocks = <0x1f 0x16c 0x1f 0x16d>;
    clock-names = pclk\0timer;
    phandle = <0x1ac>;
  };
  watchdog@fe600000 {
    compatible = snps,dw-wdt;
    reg = <0x00 0xfe600000 0x00 0x100>;
    clocks = <0x1f 0x116 0x1f 0x115>;
    clock-names = tclk\0pclk;
    interrupts = <0x00 0x95 0x04>;
    status = okay;
    phandle = <0x1ad>;
  };
  spi@fe610000 {
    compatible = rockchip,rk3066-spi;
    reg = <0x00 0xfe610000 0x00 0x1000>;
    interrupts = <0x00 0x67 0x04>;
    #address-cells = <0x01>;
    #size-cells = <0x00>;
    clocks = <0x1f 0x152 0x1f 0x151>;
    clock-names = spiclk\0apb_pclk;
    dmas = <0x40 0x14 0x40 0x15>;
    dma-names = tx\0rx;
    pinctrl-names = default\0high_speed;
    pinctrl-0 = <0xd3 0xd4 0xd5>;
    pinctrl-1 = <0xd3 0xd4 0xd6>;
    status = disabled;
    phandle = <0x1ae>;
  };
  spi@fe620000 {
    compatible = rockchip,rk3066-spi;
    reg = <0x00 0xfe620000 0x00 0x1000>;
    interrupts = <0x00 0x68 0x04>;
    #address-cells = <0x01>;
    #size-cells = <0x00>;
    clocks = <0x1f 0x154 0x1f 0x153>;
    clock-names = spiclk\0apb_pclk;
    dmas = <0x40 0x16 0x40 0x17>;
    dma-names = tx\0rx;
    pinctrl-names = default\0high_speed;
    pinctrl-0 = <0xd7 0xd8 0xd9>;
    pinctrl-1 = <0xd7 0xd8 0xda>;
    status = disabled;
    phandle = <0x1af>;
  };
  spi@fe630000 {
    compatible = rockchip,rk3066-spi;
    reg = <0x00 0xfe630000 0x00 0x1000>;
    interrupts = <0x00 0x69 0x04>;
    #address-cells = <0x01>;
    #size-cells = <0x00>;
    clocks = <0x1f 0x156 0x1f 0x155>;
    clock-names = spiclk\0apb_pclk;
    dmas = <0x40 0x18 0x40 0x19>;
    dma-names = tx\0rx;
    pinctrl-names = default\0high_speed;
    pinctrl-0 = <0xdb 0xdc 0xdd>;
    pinctrl-1 = <0xdb 0xdc 0xde>;
    status = disabled;
    phandle = <0x1b0>;
  };
  spi@fe640000 {
    compatible = rockchip,rk3066-spi;
    reg = <0x00 0xfe640000 0x00 0x1000>;
    interrupts = <0x00 0x6a 0x04>;
    #address-cells = <0x01>;
    #size-cells = <0x00>;
    clocks = <0x1f 0x158 0x1f 0x157>;
    clock-names = spiclk\0apb_pclk;
    dmas = <0x40 0x1a 0x40 0x1b>;
    dma-names = tx\0rx;
    pinctrl-names = default\0high_speed;
    pinctrl-0 = <0xdf 0xe0 0xe1>;
    pinctrl-1 = <0xdf 0xe0 0xe2>;
    status = disabled;
    phandle = <0x1b1>;
  };
  serial@fe650000 {
    compatible = rockchip,rk3568-uart\0snps,dw-apb-uart;
    reg = <0x00 0xfe650000 0x00 0x100>;
    interrupts = <0x00 0x75 0x04>;
    clocks = <0x1f 0x11f 0x1f 0x11c>;
    clock-names = baudclk\0apb_pclk;
    reg-shift = <0x02>;
    reg-io-width = <0x04>;
    dmas = <0x40 0x02 0x40 0x03>;
    pinctrl-names = default;
    pinctrl-0 = <0xe3 0xe4>;
    status = okay;
    phandle = <0x1b2>;
  };
  serial@fe660000 {
    compatible = rockchip,rk3568-uart\0snps,dw-apb-uart;
    reg = <0x00 0xfe660000 0x00 0x100>;
    interrupts = <0x00 0x76 0x04>;
    clocks = <0x1f 0x123 0x1f 0x120>;
    clock-names = baudclk\0apb_pclk;
    reg-shift = <0x02>;
    reg-io-width = <0x04>;
    dmas = <0x40 0x04 0x40 0x05>;
    pinctrl-names = default;
    pinctrl-0 = <0xe5>;
    status = disabled;
    phandle = <0x1b3>;
  };
  serial@fe670000 {
    compatible = rockchip,rk3568-uart\0snps,dw-apb-uart;
    reg = <0x00 0xfe670000 0x00 0x100>;
    interrupts = <0x00 0x77 0x04>;
    clocks = <0x1f 0x127 0x1f 0x124>;
    clock-names = baudclk\0apb_pclk;
    reg-shift = <0x02>;
    reg-io-width = <0x04>;
    dmas = <0x40 0x06 0x40 0x07>;
    pinctrl-names = default;
    pinctrl-0 = <0xe6>;
    status = okay;
    phandle = <0x1b4>;
  };
  serial@fe680000 {
    compatible = rockchip,rk3568-uart\0snps,dw-apb-uart;
    reg = <0x00 0xfe680000 0x00 0x100>;
    interrupts = <0x00 0x78 0x04>;
    clocks = <0x1f 0x12b 0x1f 0x128>;
    clock-names = baudclk\0apb_pclk;
    reg-shift = <0x02>;
    reg-io-width = <0x04>;
    dmas = <0x40 0x08 0x40 0x09>;
    pinctrl-names = default;
    pinctrl-0 = <0xe7>;
    status = okay;
    phandle = <0x1b5>;
  };
  serial@fe690000 {
    compatible = rockchip,rk3568-uart\0snps,dw-apb-uart;
    reg = <0x00 0xfe690000 0x00 0x100>;
    interrupts = <0x00 0x79 0x04>;
    clocks = <0x1f 0x12f 0x1f 0x12c>;
    clock-names = baudclk\0apb_pclk;
    reg-shift = <0x02>;
    reg-io-width = <0x04>;
    dmas = <0x40 0x0a 0x40 0x0b>;
    pinctrl-names = default;
    pinctrl-0 = <0xe8>;
    status = disabled;
    phandle = <0x1b6>;
  };
  serial@fe6a0000 {
    compatible = rockchip,rk3568-uart\0snps,dw-apb-uart;
    reg = <0x00 0xfe6a0000 0x00 0x100>;
    interrupts = <0x00 0x7a 0x04>;
    clocks = <0x1f 0x133 0x1f 0x130>;
    clock-names = baudclk\0apb_pclk;
    reg-shift = <0x02>;
    reg-io-width = <0x04>;
    dmas = <0x40 0x0c 0x40 0x0d>;
    pinctrl-names = default;
    pinctrl-0 = <0xe9>;
    status = disabled;
    phandle = <0x1b7>;
  };
  serial@fe6b0000 {
    compatible = rockchip,rk3568-uart\0snps,dw-apb-uart;
    reg = <0x00 0xfe6b0000 0x00 0x100>;
    interrupts = <0x00 0x7b 0x04>;
    clocks = <0x1f 0x137 0x1f 0x134>;
    clock-names = baudclk\0apb_pclk;
    reg-shift = <0x02>;
    reg-io-width = <0x04>;
    dmas = <0x40 0x0e 0x40 0x0f>;
    pinctrl-names = default;
    pinctrl-0 = <0xea>;
    status = disabled;
    phandle = <0x1b8>;
  };
  serial@fe6c0000 {
    compatible = rockchip,rk3568-uart\0snps,dw-apb-uart;
    reg = <0x00 0xfe6c0000 0x00 0x100>;
    interrupts = <0x00 0x7c 0x04>;
    clocks = <0x1f 0x13b 0x1f 0x138>;
    clock-names = baudclk\0apb_pclk;
    reg-shift = <0x02>;
    reg-io-width = <0x04>;
    dmas = <0x40 0x10 0x40 0x11>;
    pinctrl-names = default;
    pinctrl-0 = <0xeb>;
    status = disabled;
    phandle = <0x1b9>;
  };
  serial@fe6d0000 {
    compatible = rockchip,rk3568-uart\0snps,dw-apb-uart;
    reg = <0x00 0xfe6d0000 0x00 0x100>;
    interrupts = <0x00 0x7d 0x04>;
    clocks = <0x1f 0x13f 0x1f 0x13c>;
    clock-names = baudclk\0apb_pclk;
    reg-shift = <0x02>;
    reg-io-width = <0x04>;
    dmas = <0x40 0x12 0x40 0x13>;
    pinctrl-names = default;
    pinctrl-0 = <0xec>;
    status = disabled;
    phandle = <0x1ba>;
  };
  pwm@fe6e0000 {
    compatible = rockchip,rk3568-pwm\0rockchip,rk3328-pwm;
    reg = <0x00 0xfe6e0000 0x00 0x10>;
    #pwm-cells = <0x03>;
    pinctrl-names = active;
    pinctrl-0 = <0xed>;
    clocks = <0x1f 0x15a 0x1f 0x159>;
    clock-names = pwm\0pclk;
    status = okay;
    phandle = <0x116>;
  };
  pwm@fe6e0010 {
    compatible = rockchip,rk3568-pwm\0rockchip,rk3328-pwm;
    reg = <0x00 0xfe6e0010 0x00 0x10>;
    #pwm-cells = <0x03>;
    pinctrl-names = active;
    pinctrl-0 = <0xee>;
    clocks = <0x1f 0x15a 0x1f 0x159>;
    clock-names = pwm\0pclk;
    status = disabled;
    phandle = <0x117>;
  };
  pwm@fe6e0020 {
    compatible = rockchip,rk3568-pwm\0rockchip,rk3328-pwm;
    reg = <0x00 0xfe6e0020 0x00 0x10>;
    #pwm-cells = <0x03>;
    pinctrl-names = active;
    pinctrl-0 = <0xef>;
    clocks = <0x1f 0x15a 0x1f 0x159>;
    clock-names = pwm\0pclk;
    status = disabled;
    phandle = <0x1bb>;
  };
  pwm@fe6e0030 {
    compatible = rockchip,rk3568-pwm\0rockchip,rk3328-pwm;
    reg = <0x00 0xfe6e0030 0x00 0x10>;
    interrupts = <0x00 0x53 0x04 0x00 0x57 0x04>;
    #pwm-cells = <0x03>;
    pinctrl-names = active;
    pinctrl-0 = <0xf0>;
    clocks = <0x1f 0x15a 0x1f 0x159>;
    clock-names = pwm\0pclk;
    status = disabled;
    phandle = <0x1bc>;
  };
  pwm@fe6f0000 {
    compatible = rockchip,rk3568-pwm\0rockchip,rk3328-pwm;
    reg = <0x00 0xfe6f0000 0x00 0x10>;
    #pwm-cells = <0x03>;
    pinctrl-names = active;
    pinctrl-0 = <0xf1>;
    clocks = <0x1f 0x15d 0x1f 0x15c>;
    clock-names = pwm\0pclk;
    status = disabled;
    phandle = <0x1bd>;
  };
  pwm@fe6f0010 {
    compatible = rockchip,rk3568-pwm\0rockchip,rk3328-pwm;
    reg = <0x00 0xfe6f0010 0x00 0x10>;
    #pwm-cells = <0x03>;
    pinctrl-names = active;
    pinctrl-0 = <0xf2>;
    clocks = <0x1f 0x15d 0x1f 0x15c>;
    clock-names = pwm\0pclk;
    status = disabled;
    phandle = <0x1be>;
  };
  pwm@fe6f0020 {
    compatible = rockchip,rk3568-pwm\0rockchip,rk3328-pwm;
    reg = <0x00 0xfe6f0020 0x00 0x10>;
    #pwm-cells = <0x03>;
    pinctrl-names = active;
    pinctrl-0 = <0xf3>;
    clocks = <0x1f 0x15d 0x1f 0x15c>;
    clock-names = pwm\0pclk;
    status = disabled;
    phandle = <0x1bf>;
  };
  pwm@fe6f0030 {
    compatible = rockchip,rk3568-pwm\0rockchip,rk3328-pwm;
    reg = <0x00 0xfe6f0030 0x00 0x10>;
    interrupts = <0x00 0x54 0x04 0x00 0x58 0x04>;
    #pwm-cells = <0x03>;
    pinctrl-names = active;
    pinctrl-0 = <0xf4>;
    clocks = <0x1f 0x15d 0x1f 0x15c>;
    clock-names = pwm\0pclk;
    status = disabled;
    phandle = <0x1c0>;
  };
  pwm@fe700000 {
    compatible = rockchip,rk3568-pwm\0rockchip,rk3328-pwm;
    reg = <0x00 0xfe700000 0x00 0x10>;
    #pwm-cells = <0x03>;
    pinctrl-names = active;
    pinctrl-0 = <0xf5>;
    clocks = <0x1f 0x160 0x1f 0x15f>;
    clock-names = pwm\0pclk;
    status = disabled;
    phandle = <0x1c1>;
  };
  pwm@fe700010 {
    compatible = rockchip,rk3568-pwm\0rockchip,rk3328-pwm;
    reg = <0x00 0xfe700010 0x00 0x10>;
    #pwm-cells = <0x03>;
    pinctrl-names = active;
    pinctrl-0 = <0xf6>;
    clocks = <0x1f 0x160 0x1f 0x15f>;
    clock-names = pwm\0pclk;
    status = disabled;
    phandle = <0x1c2>;
  };
  pwm@fe700020 {
    compatible = rockchip,rk3568-pwm\0rockchip,rk3328-pwm;
    reg = <0x00 0xfe700020 0x00 0x10>;
    #pwm-cells = <0x03>;
    pinctrl-names = active;
    pinctrl-0 = <0xf7>;
    clocks = <0x1f 0x160 0x1f 0x15f>;
    clock-names = pwm\0pclk;
    status = disabled;
    phandle = <0x1c3>;
  };
  pwm@fe700030 {
    compatible = rockchip,rk3568-pwm\0rockchip,rk3328-pwm;
    reg = <0x00 0xfe700030 0x00 0x10>;
    interrupts = <0x00 0x55 0x04 0x00 0x59 0x04>;
    #pwm-cells = <0x03>;
    pinctrl-names = active;
    pinctrl-0 = <0xf8>;
    clocks = <0x1f 0x160 0x1f 0x15f>;
    clock-names = pwm\0pclk;
    status = disabled;
    phandle = <0x1c4>;
  };
  tsadc@fe710000 {
    compatible = rockchip,rk3568-tsadc;
    reg = <0x00 0xfe710000 0x00 0x100>;
    interrupts = <0x00 0x73 0x04>;
    rockchip,grf = <0x32>;
    clocks = <0x1f 0x111 0x1f 0x10f>;
    clock-names = tsadc\0apb_pclk;
    assigned-clocks = <0x1f 0x110 0x1f 0x111>;
    assigned-clock-rates = <0x1036640 0xaae60>;
    resets = <0x1f 0x182 0x1f 0x181 0x1f 0x1d7>;
    reset-names = tsadc\0tsadc-apb\0tsadc-phy;
    #thermal-sensor-cells = <0x01>;
    rockchip,hw-tshut-temp = <0x1d4c0>;
    rockchip,hw-tshut-mode = <0x00>;
    rockchip,hw-tshut-polarity = <0x00>;
    pinctrl-names = gpio\0otpout;
    pinctrl-0 = <0xf9>;
    pinctrl-1 = <0xfa>;
    status = okay;
    phandle = <0x1b>;
  };
  saradc@fe720000 {
    compatible = rockchip,rk3568-saradc\0rockchip,rk3399-saradc;
    reg = <0x00 0xfe720000 0x00 0x100>;
    interrupts = <0x00 0x5d 0x04>;
    #io-channel-cells = <0x01>;
    clocks = <0x1f 0x113 0x1f 0x112>;
    clock-names = saradc\0apb_pclk;
    resets = <0x1f 0x180>;
    reset-names = saradc-apb;
    status = okay;
    vref-supply = <0xfb>;
    phandle = <0x112>;
  };
  mailbox@fe780000 {
    compatible = rockchip,rk3568-mailbox\0rockchip,rk3368-mailbox;
    reg = <0x00 0xfe780000 0x00 0x1000>;
    interrupts = <0x00 0xb7 0x04 0x00 0xb8 0x04 0x00 0xb9 0x04 0x00 0xba 0x04>;
    clocks = <0x1f 0x11b>;
    clock-names = pclk_mailbox;
    #mbox-cells = <0x01>;
    status = disabled;
    phandle = <0x1c5>;
  };
  phy@fe830000 {
    compatible = rockchip,rk3568-naneng-combphy;
    reg = <0x00 0xfe830000 0x00 0x100>;
    #phy-cells = <0x01>;
    clocks = <0x31 0x22 0x1f 0x17d 0x1f 0x7f>;
    clock-names = refclk\0apbclk\0pipe_clk;
    assigned-clocks = <0x31 0x22>;
    assigned-clock-rates = <0x5f5e100>;
    resets = <0x1f 0x1c6 0x1f 0x1c7>;
    reset-names = combphy-apb\0combphy;
    rockchip,pipe-grf = <0xfc>;
    rockchip,pipe-phy-grf = <0xfd>;
    status = okay;
    phandle = <0x20>;
  };
  phy@fe840000 {
    compatible = rockchip,rk3568-naneng-combphy;
    reg = <0x00 0xfe840000 0x00 0x100>;
    #phy-cells = <0x01>;
    clocks = <0x31 0x25 0x1f 0x17e 0x1f 0x7f>;
    clock-names = refclk\0apbclk\0pipe_clk;
    assigned-clocks = <0x31 0x25>;
    assigned-clock-rates = <0x5f5e100>;
    resets = <0x1f 0x1c8 0x1f 0x1c9>;
    reset-names = combphy-apb\0combphy;
    rockchip,pipe-grf = <0xfc>;
    rockchip,pipe-phy-grf = <0xfe>;
    status = okay;
    phandle = <0x22>;
  };
  video-phy@fe850000 {
    compatible = rockchip,rk3568-video-phy;
    reg = <0x00 0xfe850000 0x00 0x10000 0x00 0xfe060000 0x00 0x10000>;
    clocks = <0x31 0x17 0x1f 0x17a 0x1f 0xe8>;
    clock-names = ref\0pclk_phy\0pclk_host;
    #clock-cells = <0x00>;
    resets = <0x1f 0x1bb>;
    reset-names = rst;
    power-domains = <0x21 0x09>;
    #phy-cells = <0x00>;
    status = okay;
    phandle = <0x2e>;
  };
  video-phy@fe860000 {
    compatible = rockchip,rk3568-video-phy;
    reg = <0x00 0xfe860000 0x00 0x10000 0x00 0xfe070000 0x00 0x10000>;
    clocks = <0x31 0x19 0x1f 0x17b 0x1f 0xe9>;
    clock-names = ref\0pclk_phy\0pclk_host;
    #clock-cells = <0x00>;
    resets = <0x1f 0x1bc>;
    reset-names = rst;
    power-domains = <0x21 0x09>;
    #phy-cells = <0x00>;
    status = disabled;
    phandle = <0x8e>;
  };
  csi2-dphy-hw@fe870000 {
    compatible = rockchip,rk3568-csi2-dphy-hw;
    reg = <0x00 0xfe870000 0x00 0x1000>;
    clocks = <0x1f 0x179>;
    clock-names = pclk;
    rockchip,grf = <0x32>;
    status = okay;
    phandle = <0xff>;
  };
  csi2-dphy0 {
    compatible = rockchip,rk3568-csi2-dphy;
    rockchip,hw = <0xff>;
    status = okay;
    phandle = <0x1c6>;
    ports {
      #address-cells = <0x01>;
      #size-cells = <0x00>;
      port@0 {
        reg = <0x00>;
        #address-cells = <0x01>;
        #size-cells = <0x00>;
        endpoint@0 {
          reg = <0x01>;
          remote-endpoint = <0x100>;
          data-lanes = <0x01 0x02>;
          phandle = <0xcd>;
        };
        endpoint@1 {
          reg = <0x01>;
          remote-endpoint = <0x101>;
          data-lanes = <0x01 0x02>;
          phandle = <0xce>;
        };
      };
      port@1 {
        reg = <0x01>;
        #address-cells = <0x01>;
        #size-cells = <0x00>;
        endpoint@0 {
          reg = <0x00>;
          remote-endpoint = <0x102>;
          phandle = <0x77>;
        };
      };
    };
  };
  csi2-dphy1 {
    compatible = rockchip,rk3568-csi2-dphy;
    rockchip,hw = <0xff>;
    status = disabled;
    phandle = <0x1c7>;
  };
  csi2-dphy2 {
    compatible = rockchip,rk3568-csi2-dphy;
    rockchip,hw = <0xff>;
    status = disabled;
    phandle = <0x1c8>;
  };
  usb2-phy@fe8a0000 {
    compatible = rockchip,rk3568-usb2phy;
    reg = <0x00 0xfe8a0000 0x00 0x10000>;
    interrupts = <0x00 0x87 0x04>;
    clocks = <0x31 0x13>;
    clock-names = phyclk;
    #clock-cells = <0x00>;
    assigned-clocks = <0x1f 0x0b>;
    assigned-clock-parents = <0x24>;
    clock-output-names = usb480m_phy;
    rockchip,usbgrf = <0x103>;
    status = okay;
    phandle = <0x24>;
    host-port {
      #phy-cells = <0x00>;
      status = okay;
      phy-supply = <0x104>;
      phandle = <0x25>;
    };
    otg-port {
      #phy-cells = <0x00>;
      status = okay;
      vbus-supply = <0x105>;
      phandle = <0x23>;
    };
  };
  usb2-phy@fe8b0000 {
    compatible = rockchip,rk3568-usb2phy;
    reg = <0x00 0xfe8b0000 0x00 0x10000>;
    interrupts = <0x00 0x88 0x04>;
    clocks = <0x31 0x15>;
    clock-names = phyclk;
    #clock-cells = <0x00>;
    rockchip,usbgrf = <0x106>;
    status = okay;
    phandle = <0x26>;
    host-port {
      #phy-cells = <0x00>;
      status = okay;
      phy-supply = <0x104>;
      phandle = <0x28>;
    };
    otg-port {
      #phy-cells = <0x00>;
      status = okay;
      phy-supply = <0x104>;
      phandle = <0x27>;
    };
  };
  pinctrl {
    compatible = rockchip,rk3568-pinctrl;
    rockchip,grf = <0x32>;
    rockchip,pmu = <0x33>;
    #address-cells = <0x02>;
    #size-cells = <0x02>;
    phandle = <0x107>;
    gpio@fdd60000 {
      compatible = rockchip,gpio-bank;
      reg = <0x00 0xfdd60000 0x00 0x100>;
      interrupts = <0x00 0x21 0x04>;
      clocks = <0x31 0x2e 0x31 0x0c>;
      #gpio-cells = <0x02>;
      gpio-ranges = <0x107 0x00 0x00 0x20>;
      #interrupt-cells = <0x02>;
      phandle = <0x36>;
    };
    gpio@fe740000 {
      compatible = rockchip,gpio-bank;
      reg = <0x00 0xfe740000 0x00 0x100>;
      interrupts = <0x00 0x22 0x04>;
      clocks = <0x1f 0x163 0x1f 0x164>;
      #gpio-cells = <0x02>;
      gpio-ranges = <0x107 0x00 0x20 0x20>;
      #interrupt-cells = <0x02>;
      phandle = <0xa3>;
    };
    gpio@fe750000 {
      compatible = rockchip,gpio-bank;
      reg = <0x00 0xfe750000 0x00 0x100>;
      interrupts = <0x00 0x23 0x04>;
      clocks = <0x1f 0x165 0x1f 0x166>;
      #gpio-cells = <0x02>;
      gpio-ranges = <0x107 0x00 0x40 0x20>;
      #interrupt-cells = <0x02>;
      phandle = <0x11a>;
    };
    gpio@fe760000 {
      compatible = rockchip,gpio-bank;
      reg = <0x00 0xfe760000 0x00 0x100>;
      interrupts = <0x00 0x24 0x04>;
      clocks = <0x1f 0x167 0x1f 0x168>;
      #gpio-cells = <0x02>;
      gpio-ranges = <0x107 0x00 0x60 0x20>;
      #interrupt-cells = <0x02>;
      phandle = <0x3f>;
    };
    gpio@fe770000 {
      compatible = rockchip,gpio-bank;
      reg = <0x00 0xfe770000 0x00 0x100>;
      interrupts = <0x00 0x25 0x04>;
      clocks = <0x1f 0x169 0x1f 0x16a>;
      #gpio-cells = <0x02>;
      gpio-ranges = <0x107 0x00 0x80 0x20>;
      #interrupt-cells = <0x02>;
      phandle = <0xcc>;
    };
    pcfg-pull-up {
      phandle = <0x10a>;
    };
    pcfg-pull-down {
      phandle = <0x111>;
    };
    pcfg-pull-none {
      phandle = <0x108>;
    };
    pcfg-pull-none-drv-level-1 {
      drive-strength = <0x01>;
      phandle = <0x10c>;
    };
    pcfg-pull-none-drv-level-2 {
      drive-strength = <0x02>;
      phandle = <0x10b>;
    };
    pcfg-pull-none-drv-level-3 {
      drive-strength = <0x03>;
      phandle = <0x110>;
    };
    pcfg-pull-up-drv-level-1 {
      drive-strength = <0x01>;
      phandle = <0x10f>;
    };
    pcfg-pull-up-drv-level-2 {
      drive-strength = <0x02>;
      phandle = <0x109>;
    };
    pcfg-pull-none-smt {
      phandle = <0x10d>;
    };
    pcfg-output-low-pull-down {
      phandle = <0x10e>;
    };
    acodec {
      acodec-pins {
        rockchip,pins = <0x01 0x09 0x05 0x108 0x01 0x01 0x05 0x108 0x01 0x00 0x05 0x108 0x01 0x07 0x05 0x108 0x01 0x08 0x05 0x108 0x01 0x03 0x05 0x108 0x01 0x05 0x05 0x108>;
        phandle = <0xc3>;
      };
    };
    cam {
      cam-clkout0 {
        rockchip,pins = <0x04 0x07 0x01 0x108>;
        phandle = <0xcb>;
      };
      camera-pwr {
        rockchip,pins = <0x00 0x11 0x00 0x108>;
        phandle = <0x12b>;
      };
    };
    can0 {
      can0m1-pins {
        rockchip,pins = <0x02 0x02 0x04 0x108 0x02 0x01 0x04 0x108>;
        phandle = <0xc5>;
      };
    };
    can1 {
      can1m1-pins {
        rockchip,pins = <0x04 0x12 0x03 0x108 0x04 0x13 0x03 0x108>;
        phandle = <0xc6>;
      };
    };
    can2 {
      can2m1-pins {
        rockchip,pins = <0x02 0x09 0x04 0x108 0x02 0x0a 0x04 0x108>;
        phandle = <0xc7>;
      };
    };
    clk32k {
      clk32k-out0 {
        rockchip,pins = <0x00 0x08 0x02 0x108>;
        phandle = <0x1e>;
      };
    };
    ebc {
      ebc-pins {
        rockchip,pins = <0x04 0x10 0x02 0x108 0x04 0x0b 0x02 0x108 0x04 0x0c 0x02 0x108 0x04 0x06 0x02 0x108 0x04 0x11 0x02 0x108 0x03 0x16 0x02 0x108 0x03 0x17 0x02 0x108 0x03 0x18 0x02 0x108 0x03 0x19 0x02 0x108 0x03 0x1a 0x02 0x108 0x03 0x1b 0x02 0x108 0x03 0x1c 0x02 0x108 0x03 0x1d 0x02 0x108 0x03 0x1e 0x02 0x108 0x03 0x1f 0x02 0x108 0x04 0x00 0x02 0x108 0x04 0x01 0x02 0x108 0x04 0x02 0x02 0x108 0x04 0x03 0x02 0x108 0x04 0x04 0x02 0x108 0x04 0x05 0x02 0x108 0x04 0x0e 0x02 0x108 0x04 0x0f 0x02 0x108>;
        phandle = <0x69>;
      };
    };
    hdmitx {
      hdmitxm0-cec {
        rockchip,pins = <0x04 0x19 0x01 0x108>;
        phandle = <0x98>;
      };
      hdmitx-scl {
        rockchip,pins = <0x04 0x17 0x01 0x108>;
        phandle = <0x96>;
      };
      hdmitx-sda {
        rockchip,pins = <0x04 0x18 0x01 0x108>;
        phandle = <0x97>;
      };
    };
    i2c0 {
      i2c0-xfer {
        rockchip,pins = <0x00 0x09 0x01 0x10d 0x00 0x0a 0x01 0x10d>;
        phandle = <0x34>;
      };
    };
    i2c1 {
      i2c1-xfer {
        rockchip,pins = <0x00 0x0b 0x01 0x10d 0x00 0x0c 0x01 0x10d>;
        phandle = <0xc8>;
      };
    };
    i2c2 {
      i2c2m1-xfer {
        rockchip,pins = <0x04 0x0d 0x01 0x10d 0x04 0x0c 0x01 0x10d>;
        phandle = <0xca>;
      };
    };
    i2c3 {
      i2c3m0-xfer {
        rockchip,pins = <0x01 0x01 0x01 0x10d 0x01 0x00 0x01 0x10d>;
        phandle = <0xcf>;
      };
    };
    i2c4 {
      i2c4m0-xfer {
        rockchip,pins = <0x04 0x0b 0x01 0x10d 0x04 0x0a 0x01 0x10d>;
        phandle = <0xd0>;
      };
    };
    i2c5 {
      i2c5m0-xfer {
        rockchip,pins = <0x03 0x0b 0x04 0x10d 0x03 0x0c 0x04 0x10d>;
        phandle = <0xd1>;
      };
    };
    i2s1 {
      i2s1m0-lrcktx {
        rockchip,pins = <0x01 0x05 0x01 0x108>;
        phandle = <0xb0>;
      };
      i2s1m0-mclk {
        rockchip,pins = <0x01 0x02 0x01 0x108>;
        phandle = <0x3e>;
      };
      i2s1m0-sclktx {
        rockchip,pins = <0x01 0x03 0x01 0x108>;
        phandle = <0xaf>;
      };
      i2s1m0-sdi0 {
        rockchip,pins = <0x01 0x0b 0x01 0x108>;
        phandle = <0xb1>;
      };
      i2s1m0-sdo0 {
        rockchip,pins = <0x01 0x07 0x01 0x108>;
        phandle = <0xb2>;
      };
    };
    i2s2 {
      i2s2m0-lrcktx {
        rockchip,pins = <0x02 0x13 0x01 0x108>;
        phandle = <0xb4>;
      };
      i2s2m0-sclktx {
        rockchip,pins = <0x02 0x12 0x01 0x108>;
        phandle = <0xb3>;
      };
      i2s2m0-sdi {
        rockchip,pins = <0x02 0x15 0x01 0x108>;
        phandle = <0xb5>;
      };
      i2s2m0-sdo {
        rockchip,pins = <0x02 0x14 0x01 0x108>;
        phandle = <0xb6>;
      };
    };
    i2s3 {
      i2s3m0-lrck {
        rockchip,pins = <0x03 0x04 0x04 0x108>;
        phandle = <0xb8>;
      };
      i2s3m0-sclk {
        rockchip,pins = <0x03 0x03 0x04 0x108>;
        phandle = <0xb7>;
      };
      i2s3m0-sdi {
        rockchip,pins = <0x03 0x06 0x04 0x108>;
        phandle = <0xb9>;
      };
      i2s3m0-sdo {
        rockchip,pins = <0x03 0x05 0x04 0x108>;
        phandle = <0xba>;
      };
    };
    lcdc {
      lcdc-ctl {
        rockchip,pins = <0x03 0x00 0x01 0x108 0x02 0x18 0x01 0x108 0x02 0x19 0x01 0x108 0x02 0x1a 0x01 0x108 0x02 0x1b 0x01 0x108 0x02 0x1c 0x01 0x108 0x02 0x1d 0x01 0x108 0x02 0x1e 0x01 0x108 0x02 0x1f 0x01 0x108 0x03 0x01 0x01 0x108 0x03 0x02 0x01 0x108 0x03 0x03 0x01 0x108 0x03 0x04 0x01 0x108 0x03 0x05 0x01 0x108 0x03 0x06 0x01 0x108 0x03 0x07 0x01 0x108 0x03 0x08 0x01 0x108 0x03 0x09 0x01 0x108 0x03 0x0a 0x01 0x108 0x03 0x0b 0x01 0x108 0x03 0x0c 0x01 0x108 0x03 0x0d 0x01 0x108 0x03 0x0e 0x01 0x108 0x03 0x0f 0x01 0x108 0x03 0x10 0x01 0x108 0x03 0x13 0x01 0x108 0x03 0x11 0x01 0x108 0x03 0x12 0x01 0x108>;
        phandle = <0x30>;
      };
    };
    pdm {
      pdmm0-clk {
        rockchip,pins = <0x01 0x06 0x03 0x108>;
        phandle = <0xbb>;
      };
      pdmm0-clk1 {
        rockchip,pins = <0x01 0x04 0x03 0x108>;
        phandle = <0xbc>;
      };
      pdmm0-sdi0 {
        rockchip,pins = <0x01 0x0b 0x02 0x108>;
        phandle = <0xbd>;
      };
      pdmm0-sdi1 {
        rockchip,pins = <0x01 0x0a 0x03 0x108>;
        phandle = <0xbe>;
      };
      pdmm0-sdi2 {
        rockchip,pins = <0x01 0x09 0x03 0x108>;
        phandle = <0xbf>;
      };
      pdmm0-sdi3 {
        rockchip,pins = <0x01 0x08 0x03 0x108>;
        phandle = <0xc0>;
      };
    };
    pmic {
      pmic_int {
        rockchip,pins = <0x00 0x03 0x00 0x10a>;
        phandle = <0x37>;
      };
      soc_slppin_gpio {
        rockchip,pins = <0x00 0x02 0x00 0x10e>;
        phandle = <0x3a>;
      };
      soc_slppin_slp {
        rockchip,pins = <0x00 0x02 0x01 0x10a>;
        phandle = <0x38>;
      };
      soc_slppin_rst {
        rockchip,pins = <0x00 0x02 0x02 0x108>;
        phandle = <0x1c9>;
      };
    };
    pwm0 {
      pwm0m0-pins {
        rockchip,pins = <0x00 0x0f 0x01 0x108>;
        phandle = <0x42>;
      };
    };
    pwm1 {
      pwm1m0-pins {
        rockchip,pins = <0x00 0x10 0x01 0x108>;
        phandle = <0x43>;
      };
    };
    pwm2 {
      pwm2m0-pins {
        rockchip,pins = <0x00 0x11 0x01 0x108>;
        phandle = <0x44>;
      };
    };
    pwm3 {
      pwm3-pins {
        rockchip,pins = <0x00 0x12 0x01 0x108>;
        phandle = <0x45>;
      };
    };
    pwm4 {
      pwm4-pins {
        rockchip,pins = <0x00 0x13 0x01 0x108>;
        phandle = <0xed>;
      };
    };
    pwm5 {
      pwm5-pins {
        rockchip,pins = <0x00 0x14 0x01 0x108>;
        phandle = <0xee>;
      };
    };
    pwm6 {
      pwm6-pins {
        rockchip,pins = <0x00 0x15 0x01 0x108>;
        phandle = <0xef>;
      };
    };
    pwm7 {
      pwm7-pins {
        rockchip,pins = <0x00 0x16 0x01 0x108>;
        phandle = <0xf0>;
      };
    };
    pwm8 {
      pwm8m0-pins {
        rockchip,pins = <0x03 0x09 0x05 0x108>;
        phandle = <0xf1>;
      };
    };
    pwm9 {
      pwm9m0-pins {
        rockchip,pins = <0x03 0x0a 0x05 0x108>;
        phandle = <0xf2>;
      };
    };
    pwm10 {
      pwm10m0-pins {
        rockchip,pins = <0x03 0x0d 0x05 0x108>;
        phandle = <0xf3>;
      };
    };
    pwm11 {
      pwm11m0-pins {
        rockchip,pins = <0x03 0x0e 0x05 0x108>;
        phandle = <0xf4>;
      };
    };
    pwm12 {
      pwm12m0-pins {
        rockchip,pins = <0x03 0x0f 0x02 0x108>;
        phandle = <0xf5>;
      };
    };
    pwm13 {
      pwm13m0-pins {
        rockchip,pins = <0x03 0x10 0x02 0x108>;
        phandle = <0xf6>;
      };
    };
    pwm14 {
      pwm14m0-pins {
        rockchip,pins = <0x03 0x14 0x01 0x108>;
        phandle = <0xf7>;
      };
    };
    pwm15 {
      pwm15m0-pins {
        rockchip,pins = <0x03 0x15 0x01 0x108>;
        phandle = <0xf8>;
      };
    };
    scr {
      scr-pins {
        rockchip,pins = <0x01 0x02 0x03 0x108 0x01 0x07 0x03 0x10a 0x01 0x03 0x03 0x10a 0x01 0x05 0x03 0x108>;
        phandle = <0xc4>;
      };
    };
    sdmmc0 {
      sdmmc0-bus4 {
        rockchip,pins = <0x01 0x1d 0x01 0x109 0x01 0x1e 0x01 0x109 0x01 0x1f 0x01 0x109 0x02 0x00 0x01 0x109>;
        phandle = <0xa6>;
      };
      sdmmc0-clk {
        rockchip,pins = <0x02 0x02 0x01 0x109>;
        phandle = <0xa7>;
      };
      sdmmc0-cmd {
        rockchip,pins = <0x02 0x01 0x01 0x109>;
        phandle = <0xa8>;
      };
      sdmmc0-det {
        rockchip,pins = <0x00 0x04 0x01 0x10a>;
        phandle = <0xa9>;
      };
    };
    sdmmc1 {
      sdmmc1-bus4 {
        rockchip,pins = <0x02 0x03 0x01 0x109 0x02 0x04 0x01 0x109 0x02 0x05 0x01 0x109 0x02 0x06 0x01 0x109>;
        phandle = <0xab>;
      };
      sdmmc1-clk {
        rockchip,pins = <0x02 0x08 0x01 0x109>;
        phandle = <0xad>;
      };
      sdmmc1-cmd {
        rockchip,pins = <0x02 0x07 0x01 0x109>;
        phandle = <0xac>;
      };
    };
    spdif {
      spdifm1-tx {
        rockchip,pins = <0x03 0x15 0x02 0x108>;
        phandle = <0xc2>;
      };
    };
    spi0 {
      spi0m0-pins {
        rockchip,pins = <0x00 0x0d 0x02 0x108 0x00 0x15 0x02 0x108 0x00 0x0e 0x02 0x108>;
        phandle = <0xd5>;
      };
      spi0m0-cs0 {
        rockchip,pins = <0x00 0x16 0x02 0x108>;
        phandle = <0xd3>;
      };
      spi0m0-cs1 {
        rockchip,pins = <0x00 0x14 0x02 0x108>;
        phandle = <0xd4>;
      };
    };
    spi1 {
      spi1m0-pins {
        rockchip,pins = <0x02 0x0d 0x03 0x108 0x02 0x0e 0x03 0x108 0x02 0x0f 0x04 0x108>;
        phandle = <0xd9>;
      };
      spi1m0-cs0 {
        rockchip,pins = <0x02 0x10 0x04 0x108>;
        phandle = <0xd7>;
      };
      spi1m0-cs1 {
        rockchip,pins = <0x02 0x16 0x03 0x108>;
        phandle = <0xd8>;
      };
    };
    spi2 {
      spi2m0-pins {
        rockchip,pins = <0x02 0x11 0x04 0x108 0x02 0x12 0x04 0x108 0x02 0x13 0x04 0x108>;
        phandle = <0xdd>;
      };
      spi2m0-cs0 {
        rockchip,pins = <0x02 0x14 0x04 0x108>;
        phandle = <0xdb>;
      };
      spi2m0-cs1 {
        rockchip,pins = <0x02 0x15 0x04 0x108>;
        phandle = <0xdc>;
      };
    };
    spi3 {
      spi3m0-pins {
        rockchip,pins = <0x04 0x0b 0x04 0x108 0x04 0x08 0x04 0x108 0x04 0x0a 0x04 0x108>;
        phandle = <0xe1>;
      };
      spi3m0-cs0 {
        rockchip,pins = <0x04 0x06 0x04 0x108>;
        phandle = <0xdf>;
      };
      spi3m0-cs1 {
        rockchip,pins = <0x04 0x07 0x04 0x108>;
        phandle = <0xe0>;
      };
    };
    tsadc {
      tsadc-shutorg {
        rockchip,pins = <0x00 0x01 0x02 0x108>;
        phandle = <0xfa>;
      };
    };
    uart0 {
      uart0-xfer {
        rockchip,pins = <0x00 0x10 0x03 0x10a 0x00 0x11 0x03 0x10a>;
        phandle = <0x41>;
      };
    };
    uart1 {
      uart1m0-xfer {
        rockchip,pins = <0x02 0x0b 0x02 0x10a 0x02 0x0c 0x02 0x10a>;
        phandle = <0xe3>;
      };
      uart1m0-ctsn {
        rockchip,pins = <0x02 0x0e 0x02 0x108>;
        phandle = <0xe4>;
      };
      uart1m0-rtsn {
        rockchip,pins = <0x02 0x0d 0x02 0x108>;
        phandle = <0x128>;
      };
    };
    uart2 {
      uart2m0-xfer {
        rockchip,pins = <0x00 0x18 0x01 0x10a 0x00 0x19 0x01 0x10a>;
        phandle = <0xe5>;
      };
    };
    uart3 {
      uart3m1-xfer {
        rockchip,pins = <0x03 0x10 0x04 0x10a 0x03 0x0f 0x04 0x10a>;
        phandle = <0xe6>;
      };
    };
    uart4 {
      uart4m1-xfer {
        rockchip,pins = <0x03 0x09 0x04 0x10a 0x03 0x0a 0x04 0x10a>;
        phandle = <0xe7>;
      };
    };
    uart5 {
      uart5m0-xfer {
        rockchip,pins = <0x02 0x01 0x03 0x10a 0x02 0x02 0x03 0x10a>;
        phandle = <0xe8>;
      };
    };
    uart6 {
      uart6m0-xfer {
        rockchip,pins = <0x02 0x03 0x03 0x10a 0x02 0x04 0x03 0x10a>;
        phandle = <0xe9>;
      };
    };
    uart7 {
      uart7m0-xfer {
        rockchip,pins = <0x02 0x05 0x03 0x10a 0x02 0x06 0x03 0x10a>;
        phandle = <0xea>;
      };
    };
    uart8 {
      uart8m0-xfer {
        rockchip,pins = <0x02 0x16 0x02 0x10a 0x02 0x15 0x03 0x10a>;
        phandle = <0xeb>;
      };
    };
    uart9 {
      uart9m0-xfer {
        rockchip,pins = <0x02 0x07 0x03 0x10a 0x02 0x08 0x03 0x10a>;
        phandle = <0xec>;
      };
    };
    spi0-hs {
      spi0m0-pins {
        rockchip,pins = <0x00 0x0d 0x02 0x10f 0x00 0x15 0x02 0x10f 0x00 0x0e 0x02 0x10f>;
        phandle = <0xd6>;
      };
    };
    spi1-hs {
      spi1m0-pins {
        rockchip,pins = <0x02 0x0d 0x03 0x10f 0x02 0x0e 0x03 0x10f 0x02 0x0f 0x04 0x10f>;
        phandle = <0xda>;
      };
    };
    spi2-hs {
      spi2m0-pins {
        rockchip,pins = <0x02 0x11 0x04 0x10f 0x02 0x12 0x04 0x10f 0x02 0x13 0x04 0x10f>;
        phandle = <0xde>;
      };
    };
    spi3-hs {
      spi3m0-pins {
        rockchip,pins = <0x04 0x0b 0x04 0x10f 0x04 0x08 0x04 0x10f 0x04 0x0a 0x04 0x10f>;
        phandle = <0xe2>;
      };
    };
    gpio-func {
      tsadc-gpio-func {
        rockchip,pins = <0x00 0x01 0x00 0x108>;
        phandle = <0xf9>;
      };
    };
    mxc6655xa {
      mxc6655xa_irq_gpio {
        rockchip,pins = <0x03 0x11 0x00 0x108>;
        phandle = <0xd2>;
      };
    };
    touch {
      touch-gpio {
        rockchip,pins = <0x00 0x0d 0x00 0x10a 0x00 0x0e 0x00 0x108>;
        phandle = <0xc9>;
      };
    };
    sdio-pwrseq {
      wifi-enable-h {
        rockchip,pins = <0x02 0x09 0x00 0x108>;
        phandle = <0x126>;
      };
    };
    usb {
      vcc5v0-host-en {
        rockchip,pins = <0x00 0x06 0x00 0x108>;
        phandle = <0x123>;
      };
      vcc5v0-otg-en {
        rockchip,pins = <0x00 0x05 0x00 0x108>;
        phandle = <0x124>;
      };
    };
    wireless-bluetooth {
      uart8-gpios {
        rockchip,pins = <0x02 0x09 0x00 0x108>;
        phandle = <0x1ca>;
      };
      uart1-gpios {
        rockchip,pins = <0x02 0x0d 0x00 0x108>;
        phandle = <0x129>;
      };
    };
    headphone {
      hp-det {
        rockchip,pins = <0x03 0x08 0x00 0x111>;
        phandle = <0x12a>;
      };
    };
    wireless-wlan {
      wifi-host-wake-irq {
        rockchip,pins = <0x00 0x14 0x00 0x111>;
        phandle = <0x127>;
      };
    };
    lcd0 {
      lcd0-rst-gpio {
        rockchip,pins = <0x00 0x15 0x00 0x108>;
        phandle = <0x8b>;
      };
    };
    lcd1 {
      lcd1-rst-gpio {
        rockchip,pins = <0x03 0x04 0x00 0x108>;
        phandle = <0x93>;
      };
    };
  };
  adc-keys {
    compatible = adc-keys;
    io-channels = <0x112 0x00>;
    io-channel-names = buttons;
    keyup-threshold-microvolt = <0x1b7740>;
    poll-interval = <0x64>;
    phandle = <0x1cb>;
    vol-up-key {
      label = volume up;
      linux,code = <0x73>;
      press-threshold-microvolt = <0x6d6>;
    };
    vol-down-key {
      label = volume down;
      linux,code = <0x72>;
      press-threshold-microvolt = <0x48a1c>;
    };
    menu-key {
      label = menu;
      linux,code = <0x8b>;
      press-threshold-microvolt = <0xef420>;
    };
    back-key {
      label = back;
      linux,code = <0x9e>;
      press-threshold-microvolt = <0x13eb9c>;
    };
  };
  audiopwmout-diff {
    status = disabled;
    compatible = simple-audio-card;
    simple-audio-card,format = i2s;
    simple-audio-card,name = rockchip,audiopwmout-diff;
    simple-audio-card,mclk-fs = <0x100>;
    simple-audio-card,bitclock-master = <0x113>;
    simple-audio-card,frame-master = <0x113>;
    phandle = <0x1cc>;
    simple-audio-card,cpu {
      sound-dai = <0x114>;
    };
    simple-audio-card,codec {
      sound-dai = <0x115>;
      phandle = <0x113>;
    };
  };
  backlight {
    compatible = pwm-backlight;
    pwms = <0x116 0x00 0x61a8 0x01>;
    brightness-levels = <0x00 0x14 0x14 0x15 0x15 0x16 0x16 0x17 0x17 0x18 0x18 0x19 0x19 0x1a 0x1a 0x1b 0x1b 0x1c 0x1c 0x1d 0x1d 0x1e 0x1e 0x1f 0x1f 0x20 0x20 0x21 0x21 0x22 0x22 0x23 0x23 0x24 0x24 0x25 0x25 0x26 0x26 0x27 0x28 0x29 0x2a 0x2b 0x2c 0x2d 0x2e 0x2f 0x30 0x31 0x32 0x33 0x34 0x35 0x36 0x37 0x38 0x39 0x3a 0x3b 0x3c 0x3d 0x3e 0x3f 0x40 0x41 0x42 0x43 0x44 0x45 0x46 0x47 0x48 0x49 0x4a 0x4b 0x4c 0x4d 0x4e 0x4f 0x50 0x51 0x52 0x53 0x54 0x55 0x56 0x57 0x58 0x59 0x5a 0x5b 0x5c 0x5d 0x5e 0x5f 0x60 0x61 0x62 0x63 0x64 0x65 0x66 0x67 0x68 0x69 0x6a 0x6b 0x6c 0x6d 0x6e 0x6f 0x70 0x71 0x72 0x73 0x74 0x75 0x76 0x77 0x78 0x79 0x7a 0x7b 0x7c 0x7d 0x7e 0x7f 0x80 0x81 0x82 0x83 0x84 0x85 0x86 0x87 0x88 0x89 0x8a 0x8b 0x8c 0x8d 0x8e 0x8f 0x90 0x91 0x92 0x93 0x94 0x95 0x96 0x97 0x98 0x99 0x9a 0x9b 0x9c 0x9d 0x9e 0x9f 0xa0 0xa1 0xa2 0xa3 0xa4 0xa5 0xa6 0xa7 0xa8 0xa9 0xaa 0xab 0xac 0xad 0xae 0xaf 0xb0 0xb1 0xb2 0xb3 0xb4 0xb5 0xb6 0xb7 0xb8 0xb9 0xba 0xbb 0xbc 0xbd 0xbe 0xbf 0xc0 0xc1 0xc2 0xc3 0xc4 0xc5 0xc6 0xc7 0xc8 0xc9 0xca 0xcb 0xcc 0xcd 0xce 0xcf 0xd0 0xd1 0xd2 0xd3 0xd4 0xd5 0xd6 0xd7 0xd8 0xd9 0xda 0xdb 0xdc 0xdd 0xde 0xdf 0xe0 0xe1 0xe2 0xe3 0xe4 0xe5 0xe6 0xe7 0xe8 0xe9 0xea 0xeb 0xec 0xed 0xee 0xef 0xf0 0xf1 0xf2 0xf3 0xf4 0xf5 0xf6 0xf7 0xf8 0xf9 0xfa 0xfb 0xfc 0xfd 0xfe 0xff>;
    default-brightness-level = <0xc8>;
    phandle = <0x89>;
  };
  backlight1 {
    compatible = pwm-backlight;
    pwms = <0x117 0x00 0x61a8 0x00>;
    brightness-levels = <0x00 0x14 0x14 0x15 0x15 0x16 0x16 0x17 0x17 0x18 0x18 0x19 0x19 0x1a 0x1a 0x1b 0x1b 0x1c 0x1c 0x1d 0x1d 0x1e 0x1e 0x1f 0x1f 0x20 0x20 0x21 0x21 0x22 0x22 0x23 0x23 0x24 0x24 0x25 0x25 0x26 0x26 0x27 0x28 0x29 0x2a 0x2b 0x2c 0x2d 0x2e 0x2f 0x30 0x31 0x32 0x33 0x34 0x35 0x36 0x37 0x38 0x39 0x3a 0x3b 0x3c 0x3d 0x3e 0x3f 0x40 0x41 0x42 0x43 0x44 0x45 0x46 0x47 0x48 0x49 0x4a 0x4b 0x4c 0x4d 0x4e 0x4f 0x50 0x51 0x52 0x53 0x54 0x55 0x56 0x57 0x58 0x59 0x5a 0x5b 0x5c 0x5d 0x5e 0x5f 0x60 0x61 0x62 0x63 0x64 0x65 0x66 0x67 0x68 0x69 0x6a 0x6b 0x6c 0x6d 0x6e 0x6f 0x70 0x71 0x72 0x73 0x74 0x75 0x76 0x77 0x78 0x79 0x7a 0x7b 0x7c 0x7d 0x7e 0x7f 0x80 0x81 0x82 0x83 0x84 0x85 0x86 0x87 0x88 0x89 0x8a 0x8b 0x8c 0x8d 0x8e 0x8f 0x90 0x91 0x92 0x93 0x94 0x95 0x96 0x97 0x98 0x99 0x9a 0x9b 0x9c 0x9d 0x9e 0x9f 0xa0 0xa1 0xa2 0xa3 0xa4 0xa5 0xa6 0xa7 0xa8 0xa9 0xaa 0xab 0xac 0xad 0xae 0xaf 0xb0 0xb1 0xb2 0xb3 0xb4 0xb5 0xb6 0xb7 0xb8 0xb9 0xba 0xbb 0xbc 0xbd 0xbe 0xbf 0xc0 0xc1 0xc2 0xc3 0xc4 0xc5 0xc6 0xc7 0xc8 0xc9 0xca 0xcb 0xcc 0xcd 0xce 0xcf 0xd0 0xd1 0xd2 0xd3 0xd4 0xd5 0xd6 0xd7 0xd8 0xd9 0xda 0xdb 0xdc 0xdd 0xde 0xdf 0xe0 0xe1 0xe2 0xe3 0xe4 0xe5 0xe6 0xe7 0xe8 0xe9 0xea 0xeb 0xec 0xed 0xee 0xef 0xf0 0xf1 0xf2 0xf3 0xf4 0xf5 0xf6 0xf7 0xf8 0xf9 0xfa 0xfb 0xfc 0xfd 0xfe 0xff>;
    default-brightness-level = <0xc8>;
    phandle = <0x91>;
  };
  dc-12v {
    compatible = regulator-fixed;
    regulator-name = dc_12v;
    regulator-min-microvolt = <0xb71b00>;
    regulator-max-microvolt = <0xb71b00>;
    phandle = <0x121>;
  };
  hdmi-sound {
    compatible = simple-audio-card;
    simple-audio-card,format = i2s;
    simple-audio-card,mclk-fs = <0x80>;
    simple-audio-card,name = rockchip,hdmi;
    status = disabled;
    phandle = <0x1cd>;
    simple-audio-card,cpu {
      sound-dai = <0x118>;
    };
    simple-audio-card,codec {
      sound-dai = <0x119>;
    };
  };
  leds {
    compatible = gpio-leds;
    phandle = <0x1ce>;
    work {
      gpios = <0xcc 0x17 0x00>;
      linux,default-trigger = heartbeat;
      phandle = <0x1cf>;
    };
    test {
      gpios = <0x11a 0x09 0x00>;
      linux,default-trigger = none;
      default-state = on;
      phandle = <0x1d0>;
    };
  };
  gpio_control {
    status = okay;
    compatible = lxx,gpio-control;
    gpio_test1 = <0x3f 0x15 0x00>;
    gpio_test2 = <0x3f 0x14 0x00>;
    gpio_lcd_hv = <0x3f 0x11 0x00>;
    phandle = <0x1d1>;
  };
  dummy-codec {
    status = disabled;
    compatible = rockchip,dummy-codec;
    #sound-dai-cells = <0x00>;
    phandle = <0x11c>;
  };
  pdm-mic-array {
    status = disabled;
    compatible = simple-audio-card;
    simple-audio-card,name = rockchip,pdm-mic-array;
    phandle = <0x1d2>;
    simple-audio-card,cpu {
      sound-dai = <0x11b>;
    };
    simple-audio-card,codec {
      sound-dai = <0x11c>;
    };
  };
  rk809-sound {
    status = okay;
    compatible = simple-audio-card;
    simple-audio-card,format = i2s;
    simple-audio-card,name = rockchip,rk809-codec;
    simple-audio-card,mclk-fs = <0x100>;
    phandle = <0x1d3>;
    simple-audio-card,cpu {
      sound-dai = <0xc1>;
    };
    simple-audio-card,codec {
      sound-dai = <0x11d>;
    };
  };
  spdif-sound {
    status = okay;
    compatible = simple-audio-card;
    simple-audio-card,name = ROCKCHIP,SPDIF;
    simple-audio-card,cpu {
      sound-dai = <0x11e>;
    };
    simple-audio-card,codec {
      sound-dai = <0x11f>;
    };
  };
  spdif-out {
    status = okay;
    compatible = linux,spdif-dit;
    #sound-dai-cells = <0x00>;
    phandle = <0x11f>;
  };
  vad-sound {
    status = disabled;
    compatible = rockchip,multicodecs-card;
    rockchip,card-name = rockchip,rk3568-vad;
    rockchip,cpu = <0xc1>;
    rockchip,codec = <0x11d 0x120>;
    phandle = <0x1d4>;
  };
  vcc3v3-sys {
    compatible = regulator-fixed;
    regulator-name = vcc3v3_sys;
    regulator-min-microvolt = <0x325aa0>;
    regulator-max-microvolt = <0x325aa0>;
    vin-supply = <0x121>;
    phandle = <0x3d>;
  };
  vcc5v0-sys {
    compatible = regulator-fixed;
    regulator-name = vcc5v0_sys;
    regulator-min-microvolt = <0x4c4b40>;
    regulator-max-microvolt = <0x4c4b40>;
    vin-supply = <0x121>;
    phandle = <0x35>;
  };
  vcc5v0-usb {
    compatible = regulator-fixed;
    regulator-name = vcc5v0_usb;
    regulator-min-microvolt = <0x4c4b40>;
    regulator-max-microvolt = <0x4c4b40>;
    vin-supply = <0x121>;
    phandle = <0x122>;
  };
  vcc5v0-host-regulator {
    compatible = regulator-fixed;
    regulator-name = vcc5v0_host;
    regulator-min-microvolt = <0x4c4b40>;
    regulator-max-microvolt = <0x4c4b40>;
    gpio = <0x36 0x06 0x00>;
    vin-supply = <0x122>;
    pinctrl-names = default;
    pinctrl-0 = <0x123>;
    phandle = <0x104>;
  };
  vcc5v0-otg-regulator {
    compatible = regulator-fixed;
    regulator-name = vcc5v0_otg;
    regulator-min-microvolt = <0x4c4b40>;
    regulator-max-microvolt = <0x4c4b40>;
    gpio = <0x36 0x05 0x00>;
    vin-supply = <0x122>;
    pinctrl-names = default;
    pinctrl-0 = <0x124>;
    phandle = <0x105>;
  };
  vcc3v3-lcd0-n {
    compatible = regulator-fixed;
    regulator-name = vcc3v3_lcd0_n;
    regulator-min-microvolt = <0x325aa0>;
    regulator-max-microvolt = <0x325aa0>;
    gpio = <0x36 0x17 0x00>;
    phandle = <0x8a>;
    regulator-state-mem {
    };
  };
  vcc3v3-lcd1-n {
    compatible = regulator-fixed;
    regulator-name = vcc3v3_lcd1_n;
    regulator-min-microvolt = <0x325aa0>;
    regulator-max-microvolt = <0x325aa0>;
    vin-supply = <0x3d>;
    phandle = <0x92>;
    regulator-state-mem {
    };
  };
  sdio-pwrseq {
    compatible = mmc-pwrseq-simple;
    clocks = <0x125 0x01>;
    clock-names = ext_clock;
    pinctrl-names = default;
    pinctrl-0 = <0x126>;
    post-power-on-delay-ms = <0xc8>;
    reset-gpios = <0x36 0x10 0x01>;
    phandle = <0xaa>;
  };
  wireless-wlan {
    compatible = wlan-platdata;
    rockchip,grf = <0x32>;
    wifi_chip_type = ssv6x5x;
    status = okay;
    pinctrl-names = default;
    pinctrl-0 = <0x127>;
    WIFI,host_wake_irq = <0x36 0x14 0x00>;
    phandle = <0x1d5>;
  };
  wireless-bluetooth {
    compatible = bluetooth-platdata;
    clocks = <0x125 0x01>;
    clock-names = ext_clock;
    uart_rts_gpios = <0x11a 0x0d 0x01>;
    pinctrl-names = default\0rts_gpio;
    pinctrl-0 = <0x128>;
    pinctrl-1 = <0x129>;
    BT,reset_gpio = <0x11a 0x0f 0x00>;
    BT,wake_gpio = <0x11a 0x11 0x00>;
    BT,wake_host_irq = <0x11a 0x10 0x00>;
    status = disabled;
    phandle = <0x1d6>;
  };
  test-power {
    status = okay;
  };
  rk-headset {
    compatible = rockchip_headset;
    headset_gpio = <0x3f 0x01 0x01>;
    pinctrl-names = default;
    pinctrl-0 = <0x12a>;
    phandle = <0x1d7>;
  };
  vcc-camera-regulator {
    compatible = regulator-fixed;
    gpio = <0x36 0x11 0x00>;
    pinctrl-names = default;
    pinctrl-0 = <0x12b>;
    regulator-name = vcc_camera;
    phandle = <0x1d8>;
  };
  gpio-regulator {
    compatible = regulator-fixed;
    regulator-name = vcc3v3_pcie;
    regulator-min-microvolt = <0x325aa0>;
    regulator-max-microvolt = <0x325aa0>;
    gpio = <0x36 0x12 0x00>;
    startup-delay-us = <0x1388>;
    vin-supply = <0x121>;
    phandle = <0xa4>;
  };
  chosen {
    bootargs = earlycon=uart8250,mmio32,0xfe680000 console=ttyFIQ0 root=PARTLABEL=rootfs rootfstype=ext4 ro rootwait overlayroot=device:dev=PARTLABEL=userdata,fstype=ext4,mkfs=1 coherent_pool=1m systemd.gpt_auto=0 cgroup_enable=memory swapaccount=1 swiotlb=0x10000;
    phandle = <0x1d9>;
  };
  fiq-debugger {
    compatible = rockchip,fiq-debugger;
    rockchip,serial-id = <0x04>;
    rockchip,wake-irq = <0x00>;
    rockchip,irq-mode-enable = <0x01>;
    rockchip,baudrate = <0x1c200>;
    interrupts = <0x00 0xfc 0x08>;
    pinctrl-names = default;
    pinctrl-0 = <0xe7>;
    status = okay;
  };
  debug@fd904000 {
    compatible = rockchip,debug;
    reg = <0x00 0xfd904000 0x00 0x1000 0x00 0xfd905000 0x00 0x1000 0x00 0xfd906000 0x00 0x1000 0x00 0xfd907000 0x00 0x1000>;
    phandle = <0x1da>;
  };
  cspmu@fd90c000 {
    compatible = rockchip,cspmu;
    reg = <0x00 0xfd90c000 0x00 0x1000 0x00 0xfd90d000 0x00 0x1000 0x00 0xfd90e000 0x00 0x1000 0x00 0xfd90f000 0x00 0x1000>;
    phandle = <0x1db>;
  };
  __symbols__ {
    ddr_timing = /ddr_timing;
    cpu0 = /cpus/cpu@0;
    cpu1 = /cpus/cpu@100;
    cpu2 = /cpus/cpu@200;
    cpu3 = /cpus/cpu@300;
    CPU_SLEEP = /cpus/idle-states/cpu-sleep;
    cpu0_opp_table = /cpu0-opp-table;
    display_subsystem = /display-subsystem;
    route_dsi0 = /display-subsystem/route/route-dsi0;
    route_dsi1 = /display-subsystem/route/route-dsi1;
    route_edp = /display-subsystem/route/route-edp;
    route_hdmi = /display-subsystem/route/route-hdmi;
    route_lvds = /display-subsystem/route/route-lvds;
    route_rgb = /display-subsystem/route/route-rgb;
    optee = /firmware/optee;
    scmi = /firmware/scmi;
    scmi_clk = /firmware/scmi/protocol@14;
    sdei = /firmware/sdei;
    mpp_srv = /mpp-srv;
    reserved_memory = /reserved-memory;
    drm_logo = /reserved-memory/drm-logo@00000000;
    drm_cubic_lut = /reserved-memory/drm-cubic-lut@00000000;
    ramoops = /reserved-memory/ramoops@110000;
    rockchip_suspend = /rockchip-suspend;
    rockchip_system_monitor = /rockchip-system-monitor;
    thermal_zones = /thermal-zones;
    soc_thermal = /thermal-zones/soc-thermal;
    threshold = /thermal-zones/soc-thermal/trips/trip-point-0;
    target = /thermal-zones/soc-thermal/trips/trip-point-1;
    soc_crit = /thermal-zones/soc-thermal/trips/soc-crit;
    gpu_thermal = /thermal-zones/gpu-thermal;
    gmac1_clkin = /external-gmac1-clock;
    gmac1_xpcsclk = /xpcs-gmac1-clock;
    i2s1_mclkin_rx = /i2s1-mclkin-rx;
    i2s1_mclkin_tx = /i2s1-mclkin-tx;
    i2s2_mclkin = /i2s2-mclkin;
    i2s3_mclkin = /i2s3-mclkin;
    mpll = /mpll;
    xin24m = /xin24m;
    xin32k = /xin32k;
    scmi_shmem = /scmi-shmem@10f000;
    sata1 = /sata@fc400000;
    sata2 = /sata@fc800000;
    usbdrd30 = /usbdrd;
    usbdrd_dwc3 = /usbdrd/dwc3@fcc00000;
    usbhost30 = /usbhost;
    usbhost_dwc3 = /usbhost/dwc3@fd000000;
    gic = /interrupt-controller@fd400000;
    its = /interrupt-controller@fd400000/interrupt-controller@fd440000;
    usb_host0_ehci = /usb@fd800000;
    usb_host0_ohci = /usb@fd840000;
    usb_host1_ehci = /usb@fd880000;
    usb_host1_ohci = /usb@fd8c0000;
    xpcs = /syscon@fda00000;
    pmugrf = /syscon@fdc20000;
    pmu_io_domains = /syscon@fdc20000/io-domains;
    reboot_mode = /syscon@fdc20000/reboot-mode;
    pipegrf = /syscon@fdc50000;
    grf = /syscon@fdc60000;
    io_domains = /syscon@fdc60000/io-domains;
    lvds = /syscon@fdc60000/lvds;
    lvds_in_vp1 = /syscon@fdc60000/lvds/ports/port@0/endpoint@1;
    lvds_in_vp2 = /syscon@fdc60000/lvds/ports/port@0/endpoint@2;
    rgb = /syscon@fdc60000/rgb;
    rgb_in_vp2 = /syscon@fdc60000/rgb/ports/port@0/endpoint@2;
    pipe_phy_grf0 = /syscon@fdc70000;
    pipe_phy_grf1 = /syscon@fdc80000;
    pipe_phy_grf2 = /syscon@fdc90000;
    usb2phy0_grf = /syscon@fdca0000;
    usb2phy1_grf = /syscon@fdca8000;
    edp_phy = /edp-phy@fdcb0000;
    sram = /sram@fdcc0000;
    rkvdec_sram = /sram@fdcc0000/rkvdec-sram@0;
    pmucru = /clock-controller@fdd00000;
    cru = /clock-controller@fdd20000;
    i2c0 = /i2c@fdd40000;
    vdd_cpu = /i2c@fdd40000/tcs4525@1c;
    rk809 = /i2c@fdd40000/pmic@20;
    pinctrl_rk8xx = /i2c@fdd40000/pmic@20/pinctrl_rk8xx;
    rk817_slppin_null = /i2c@fdd40000/pmic@20/pinctrl_rk8xx/rk817_slppin_null;
    rk817_slppin_slp = /i2c@fdd40000/pmic@20/pinctrl_rk8xx/rk817_slppin_slp;
    rk817_slppin_pwrdn = /i2c@fdd40000/pmic@20/pinctrl_rk8xx/rk817_slppin_pwrdn;
    rk817_slppin_rst = /i2c@fdd40000/pmic@20/pinctrl_rk8xx/rk817_slppin_rst;
    vdd_logic = /i2c@fdd40000/pmic@20/regulators/DCDC_REG1;
    vdd_gpu = /i2c@fdd40000/pmic@20/regulators/DCDC_REG2;
    vcc_ddr = /i2c@fdd40000/pmic@20/regulators/DCDC_REG3;
    vdd_npu = /i2c@fdd40000/pmic@20/regulators/DCDC_REG4;
    vdda0v9_image = /i2c@fdd40000/pmic@20/regulators/LDO_REG1;
    vdda_0v9 = /i2c@fdd40000/pmic@20/regulators/LDO_REG2;
    vdda0v9_pmu = /i2c@fdd40000/pmic@20/regulators/LDO_REG3;
    vccio_acodec = /i2c@fdd40000/pmic@20/regulators/LDO_REG4;
    vccio_sd = /i2c@fdd40000/pmic@20/regulators/LDO_REG5;
    vcc3v3_pmu = /i2c@fdd40000/pmic@20/regulators/LDO_REG6;
    vcca_1v8 = /i2c@fdd40000/pmic@20/regulators/LDO_REG7;
    vcca1v8_pmu = /i2c@fdd40000/pmic@20/regulators/LDO_REG8;
    vcca1v8_image = /i2c@fdd40000/pmic@20/regulators/LDO_REG9;
    vcc_1v8 = /i2c@fdd40000/pmic@20/regulators/DCDC_REG5;
    vcc_3v3 = /i2c@fdd40000/pmic@20/regulators/SWITCH_REG1;
    vcc3v3_sd = /i2c@fdd40000/pmic@20/regulators/SWITCH_REG2;
    rk809_codec = /i2c@fdd40000/pmic@20/codec;
    uart0 = /serial@fdd50000;
    pwm0 = /pwm@fdd70000;
    pwm1 = /pwm@fdd70010;
    pwm2 = /pwm@fdd70020;
    pwm3 = /pwm@fdd70030;
    pmu = /power-management@fdd90000;
    power = /power-management@fdd90000/power-controller;
    rknpu = /npu@fde40000;
    npu_opp_table = /npu-opp-table;
    bus_npu = /bus-npu;
    bus_npu_opp_table = /bus-npu-opp-table;
    rknpu_mmu = /iommu@fde4b000;
    gpu = /gpu@fde60000;
    gpu_power_model = /gpu@fde60000/power-model;
    gpu_opp_table = /opp-table2;
    vdpu = /vdpu@fdea0400;
    vdpu_mmu = /iommu@fdea0800;
    rk_rga = /rk_rga@fdeb0000;
    ebc = /ebc@fdec0000;
    jpegd = /jpegd@fded0000;
    jpegd_mmu = /iommu@fded0480;
    vepu = /vepu@fdee0000;
    vepu_mmu = /iommu@fdee0800;
    iep = /iep@fdef0000;
    iep_mmu = /iommu@fdef0800;
    eink = /eink@fdf00000;
    rkvenc = /rkvenc@fdf40000;
    rkvenc_opp_table = /rkvenc-opp-table;
    rkvenc_mmu = /iommu@fdf40f00;
    rkvdec = /rkvdec@fdf80200;
    rkvdec_mmu = /iommu@fdf80800;
    mipi_csi2 = /mipi-csi2@fdfb0000;
    rkcif = /rkcif@fdfe0000;
    rkcif_mmu = /iommu@fdfe0800;
    rkcif_dvp = /rkcif_dvp;
    rkcif_dvp_sditf = /rkcif_dvp_sditf;
    rkcif_mipi_lvds = /rkcif_mipi_lvds;
    rkcif_mipi_lvds_sditf = /rkcif_mipi_lvds_sditf;
    rkisp = /rkisp@fdff0000;
    rkisp_mmu = /iommu@fdff1a00;
    rkisp_vir0 = /rkisp-vir0;
    isp0_in = /rkisp-vir0/port/endpoint@0;
    rkisp_vir1 = /rkisp-vir1;
    gmac1 = /ethernet@fe010000;
    mdio1 = /ethernet@fe010000/mdio;
    rgmii_phy0 = /ethernet@fe010000/mdio/phy@0;
    gmac1_stmmac_axi_setup = /ethernet@fe010000/stmmac-axi-config;
    gmac1_mtl_rx_setup = /ethernet@fe010000/rx-queues-config;
    gmac1_mtl_tx_setup = /ethernet@fe010000/tx-queues-config;
    vop = /vop@fe040000;
    vop_out = /vop@fe040000/ports;
    vp0 = /vop@fe040000/ports/port@0;
    vp0_out_dsi0 = /vop@fe040000/ports/port@0/endpoint@0;
    vp0_out_dsi1 = /vop@fe040000/ports/port@0/endpoint@1;
    vp0_out_edp = /vop@fe040000/ports/port@0/endpoint@2;
    vp0_out_hdmi = /vop@fe040000/ports/port@0/endpoint@3;
    vp1 = /vop@fe040000/ports/port@1;
    vp1_out_dsi0 = /vop@fe040000/ports/port@1/endpoint@0;
    vp1_out_dsi1 = /vop@fe040000/ports/port@1/endpoint@1;
    vp1_out_edp = /vop@fe040000/ports/port@1/endpoint@2;
    vp1_out_hdmi = /vop@fe040000/ports/port@1/endpoint@3;
    vp1_out_lvds = /vop@fe040000/ports/port@1/endpoint@4;
    vp2 = /vop@fe040000/ports/port@2;
    vp2_out_lvds = /vop@fe040000/ports/port@2/endpoint@0;
    vp2_out_rgb = /vop@fe040000/ports/port@2/endpoint@1;
    vop_mmu = /iommu@fe043e00;
    dsi0 = /dsi@fe060000;
    dsi0_in = /dsi@fe060000/ports/port@0;
    dsi0_in_vp0 = /dsi@fe060000/ports/port@0/endpoint@0;
    dsi0_in_vp1 = /dsi@fe060000/ports/port@0/endpoint@1;
    dsi_out_panel = /dsi@fe060000/ports/port@1/endpoint;
    dsi0_panel = /dsi@fe060000/panel@0;
    disp_timings0 = /dsi@fe060000/panel@0/display-timings;
    dsi0_timing0 = /dsi@fe060000/panel@0/display-timings/timing0;
    panel_in_dsi = /dsi@fe060000/panel@0/ports/port@0/endpoint;
    dsi1 = /dsi@fe070000;
    dsi1_in = /dsi@fe070000/ports/port@0;
    dsi1_in_vp0 = /dsi@fe070000/ports/port@0/endpoint@0;
    dsi1_in_vp1 = /dsi@fe070000/ports/port@0/endpoint@1;
    dsi1_out_panel = /dsi@fe070000/ports/port@1/endpoint;
    dsi1_panel = /dsi@fe070000/panel@0;
    disp_timings1 = /dsi@fe070000/panel@0/display-timings;
    dsi1_timing0 = /dsi@fe070000/panel@0/display-timings/timing0;
    panel_in_dsi1 = /dsi@fe070000/panel@0/ports/port@0/endpoint;
    hdmi = /hdmi@fe0a0000;
    hdmi_in = /hdmi@fe0a0000/ports/port;
    hdmi_in_vp0 = /hdmi@fe0a0000/ports/port/endpoint@0;
    hdmi_in_vp1 = /hdmi@fe0a0000/ports/port/endpoint@1;
    edp = /edp@fe0c0000;
    edp_in = /edp@fe0c0000/ports/port@0;
    edp_in_vp0 = /edp@fe0c0000/ports/port@0/endpoint@0;
    edp_in_vp1 = /edp@fe0c0000/ports/port@0/endpoint@1;
    nocp_cpu = /nocp-cpu@fe102000;
    nocp_gpu_vpu_rga_venc = /nocp-gpu-vpu-rga-venc@fe102400;
    nocp_npu_vdec = /nocp-vdec@fe102800;
    nocp_vi_usb_peri_pipe = /nocp-vi-usb-peri-pipe@fe102c00;
    nocp_vo = /nocp-vo@fe103000;
    qos_gpu = /qos@fe128000;
    qos_rkvenc_rd_m0 = /qos@fe138080;
    qos_rkvenc_rd_m1 = /qos@fe138100;
    qos_rkvenc_wr_m0 = /qos@fe138180;
    qos_isp = /qos@fe148000;
    qos_vicap0 = /qos@fe148080;
    qos_vicap1 = /qos@fe148100;
    qos_vpu = /qos@fe150000;
    qos_ebc = /qos@fe158000;
    qos_iep = /qos@fe158100;
    qos_jpeg_dec = /qos@fe158180;
    qos_jpeg_enc = /qos@fe158200;
    qos_rga_rd = /qos@fe158280;
    qos_rga_wr = /qos@fe158300;
    qos_npu = /qos@fe180000;
    qos_pcie2x1 = /qos@fe190000;
    qos_sata1 = /qos@fe190280;
    qos_sata2 = /qos@fe190300;
    qos_usb3_0 = /qos@fe190380;
    qos_usb3_1 = /qos@fe190400;
    qos_rkvdec = /qos@fe198000;
    qos_hdcp = /qos@fe1a8000;
    qos_vop_m0 = /qos@fe1a8080;
    qos_vop_m1 = /qos@fe1a8100;
    sdmmc2 = /dwmmc@fe000000;
    dfi = /dfi@fe230000;
    dmc = /dmc;
    dmc_opp_table = /dmc-opp-table;
    dmcdbg = /dmcdbg;
    pcie2x1 = /pcie@fe260000;
    pcie2x1_intc = /pcie@fe260000/legacy-interrupt-controller;
    sdmmc0 = /dwmmc@fe2b0000;
    sdmmc1 = /dwmmc@fe2c0000;
    sfc = /sfc@fe300000;
    sdhci = /sdhci@fe310000;
    nandc0 = /nandc@fe330000;
    crypto = /crypto@fe380000;
    rng = /rng@fe388000;
    otp = /otp@fe38c000;
    cpu_code = /otp@fe38c000/cpu-code@2;
    otp_cpu_version = /otp@fe38c000/cpu-version@8;
    mbist_vmin = /otp@fe38c000/mbist-vmin@9;
    otp_id = /otp@fe38c000/id@a;
    cpu_leakage = /otp@fe38c000/cpu-leakage@1a;
    log_leakage = /otp@fe38c000/log-leakage@1b;
    npu_leakage = /otp@fe38c000/npu-leakage@1c;
    gpu_leakage = /otp@fe38c000/gpu-leakage@1d;
    core_pvtm = /otp@fe38c000/core-pvtm@2a;
    i2s0_8ch = /i2s@fe400000;
    i2s1_8ch = /i2s@fe410000;
    i2s2_2ch = /i2s@fe420000;
    i2s3_2ch = /i2s@fe430000;
    pdm = /pdm@fe440000;
    vad = /vad@fe450000;
    spdif_8ch = /spdif@fe460000;
    audpwm = /audpwm@fe470000;
    dig_acodec = /codec-digital@fe478000;
    dmac0 = /dmac@fe530000;
    dmac1 = /dmac@fe550000;
    scr = /rkscr@fe560000;
    can0 = /can@fe570000;
    can1 = /can@fe580000;
    can2 = /can@fe590000;
    i2c1 = /i2c@fe5a0000;
    gt1x = /i2c@fe5a0000/gt1x@14;
    i2c2 = /i2c@fe5b0000;
    gc5035 = /i2c@fe5b0000/gc5035@37;
    gc5035_out = /i2c@fe5b0000/gc5035@37/port/endpoint;
    gc5025 = /i2c@fe5b0000/gc5025@37;
    gc5025_out = /i2c@fe5b0000/gc5025@37/port/endpoint;
    i2c3 = /i2c@fe5c0000;
    hym8563 = /i2c@fe5c0000/hym8563@51;
    i2c4 = /i2c@fe5d0000;
    touchscreen = /i2c@fe5d0000/sitronix@55;
    i2c5 = /i2c@fe5e0000;
    mxc6655xa = /i2c@fe5e0000/mxc6655xa@15;
    rktimer = /timer@fe5f0000;
    wdt = /watchdog@fe600000;
    spi0 = /spi@fe610000;
    spi1 = /spi@fe620000;
    spi2 = /spi@fe630000;
    spi3 = /spi@fe640000;
    uart1 = /serial@fe650000;
    uart2 = /serial@fe660000;
    uart3 = /serial@fe670000;
    uart4 = /serial@fe680000;
    uart5 = /serial@fe690000;
    uart6 = /serial@fe6a0000;
    uart7 = /serial@fe6b0000;
    uart8 = /serial@fe6c0000;
    uart9 = /serial@fe6d0000;
    pwm4 = /pwm@fe6e0000;
    pwm5 = /pwm@fe6e0010;
    pwm6 = /pwm@fe6e0020;
    pwm7 = /pwm@fe6e0030;
    pwm8 = /pwm@fe6f0000;
    pwm9 = /pwm@fe6f0010;
    pwm10 = /pwm@fe6f0020;
    pwm11 = /pwm@fe6f0030;
    pwm12 = /pwm@fe700000;
    pwm13 = /pwm@fe700010;
    pwm14 = /pwm@fe700020;
    pwm15 = /pwm@fe700030;
    tsadc = /tsadc@fe710000;
    saradc = /saradc@fe720000;
    mailbox = /mailbox@fe780000;
    combphy1_usq = /phy@fe830000;
    combphy2_psq = /phy@fe840000;
    video_phy0 = /video-phy@fe850000;
    video_phy1 = /video-phy@fe860000;
    csi2_dphy_hw = /csi2-dphy-hw@fe870000;
    csi2_dphy0 = /csi2-dphy0;
    mipi_in_ucam0 = /csi2-dphy0/ports/port@0/endpoint@0;
    mipi_in_ucam1 = /csi2-dphy0/ports/port@0/endpoint@1;
    csidphy_out = /csi2-dphy0/ports/port@1/endpoint@0;
    csi2_dphy1 = /csi2-dphy1;
    csi2_dphy2 = /csi2-dphy2;
    usb2phy0 = /usb2-phy@fe8a0000;
    u2phy0_host = /usb2-phy@fe8a0000/host-port;
    u2phy0_otg = /usb2-phy@fe8a0000/otg-port;
    usb2phy1 = /usb2-phy@fe8b0000;
    u2phy1_host = /usb2-phy@fe8b0000/host-port;
    u2phy1_otg = /usb2-phy@fe8b0000/otg-port;
    pinctrl = /pinctrl;
    gpio0 = /pinctrl/gpio@fdd60000;
    gpio1 = /pinctrl/gpio@fe740000;
    gpio2 = /pinctrl/gpio@fe750000;
    gpio3 = /pinctrl/gpio@fe760000;
    gpio4 = /pinctrl/gpio@fe770000;
    pcfg_pull_up = /pinctrl/pcfg-pull-up;
    pcfg_pull_down = /pinctrl/pcfg-pull-down;
    pcfg_pull_none = /pinctrl/pcfg-pull-none;
    pcfg_pull_none_drv_level_1 = /pinctrl/pcfg-pull-none-drv-level-1;
    pcfg_pull_none_drv_level_2 = /pinctrl/pcfg-pull-none-drv-level-2;
    pcfg_pull_none_drv_level_3 = /pinctrl/pcfg-pull-none-drv-level-3;
    pcfg_pull_up_drv_level_1 = /pinctrl/pcfg-pull-up-drv-level-1;
    pcfg_pull_up_drv_level_2 = /pinctrl/pcfg-pull-up-drv-level-2;
    pcfg_pull_none_smt = /pinctrl/pcfg-pull-none-smt;
    pcfg_output_low_pull_down = /pinctrl/pcfg-output-low-pull-down;
    acodec_pins = /pinctrl/acodec/acodec-pins;
    cam_clkout0 = /pinctrl/cam/cam-clkout0;
    camera_pwr = /pinctrl/cam/camera-pwr;
    can0m1_pins = /pinctrl/can0/can0m1-pins;
    can1m1_pins = /pinctrl/can1/can1m1-pins;
    can2m1_pins = /pinctrl/can2/can2m1-pins;
    clk32k_out0 = /pinctrl/clk32k/clk32k-out0;
    ebc_pins = /pinctrl/ebc/ebc-pins;
    hdmitxm0_cec = /pinctrl/hdmitx/hdmitxm0-cec;
    hdmitx_scl = /pinctrl/hdmitx/hdmitx-scl;
    hdmitx_sda = /pinctrl/hdmitx/hdmitx-sda;
    i2c0_xfer = /pinctrl/i2c0/i2c0-xfer;
    i2c1_xfer = /pinctrl/i2c1/i2c1-xfer;
    i2c2m1_xfer = /pinctrl/i2c2/i2c2m1-xfer;
    i2c3m0_xfer = /pinctrl/i2c3/i2c3m0-xfer;
    i2c4m0_xfer = /pinctrl/i2c4/i2c4m0-xfer;
    i2c5m0_xfer = /pinctrl/i2c5/i2c5m0-xfer;
    i2s1m0_lrcktx = /pinctrl/i2s1/i2s1m0-lrcktx;
    i2s1m0_mclk = /pinctrl/i2s1/i2s1m0-mclk;
    i2s1m0_sclktx = /pinctrl/i2s1/i2s1m0-sclktx;
    i2s1m0_sdi0 = /pinctrl/i2s1/i2s1m0-sdi0;
    i2s1m0_sdo0 = /pinctrl/i2s1/i2s1m0-sdo0;
    i2s2m0_lrcktx = /pinctrl/i2s2/i2s2m0-lrcktx;
    i2s2m0_sclktx = /pinctrl/i2s2/i2s2m0-sclktx;
    i2s2m0_sdi = /pinctrl/i2s2/i2s2m0-sdi;
    i2s2m0_sdo = /pinctrl/i2s2/i2s2m0-sdo;
    i2s3m0_lrck = /pinctrl/i2s3/i2s3m0-lrck;
    i2s3m0_sclk = /pinctrl/i2s3/i2s3m0-sclk;
    i2s3m0_sdi = /pinctrl/i2s3/i2s3m0-sdi;
    i2s3m0_sdo = /pinctrl/i2s3/i2s3m0-sdo;
    lcdc_ctl = /pinctrl/lcdc/lcdc-ctl;
    pdmm0_clk = /pinctrl/pdm/pdmm0-clk;
    pdmm0_clk1 = /pinctrl/pdm/pdmm0-clk1;
    pdmm0_sdi0 = /pinctrl/pdm/pdmm0-sdi0;
    pdmm0_sdi1 = /pinctrl/pdm/pdmm0-sdi1;
    pdmm0_sdi2 = /pinctrl/pdm/pdmm0-sdi2;
    pdmm0_sdi3 = /pinctrl/pdm/pdmm0-sdi3;
    pmic_int = /pinctrl/pmic/pmic_int;
    soc_slppin_gpio = /pinctrl/pmic/soc_slppin_gpio;
    soc_slppin_slp = /pinctrl/pmic/soc_slppin_slp;
    soc_slppin_rst = /pinctrl/pmic/soc_slppin_rst;
    pwm0m0_pins = /pinctrl/pwm0/pwm0m0-pins;
    pwm1m0_pins = /pinctrl/pwm1/pwm1m0-pins;
    pwm2m0_pins = /pinctrl/pwm2/pwm2m0-pins;
    pwm3_pins = /pinctrl/pwm3/pwm3-pins;
    pwm4_pins = /pinctrl/pwm4/pwm4-pins;
    pwm5_pins = /pinctrl/pwm5/pwm5-pins;
    pwm6_pins = /pinctrl/pwm6/pwm6-pins;
    pwm7_pins = /pinctrl/pwm7/pwm7-pins;
    pwm8m0_pins = /pinctrl/pwm8/pwm8m0-pins;
    pwm9m0_pins = /pinctrl/pwm9/pwm9m0-pins;
    pwm10m0_pins = /pinctrl/pwm10/pwm10m0-pins;
    pwm11m0_pins = /pinctrl/pwm11/pwm11m0-pins;
    pwm12m0_pins = /pinctrl/pwm12/pwm12m0-pins;
    pwm13m0_pins = /pinctrl/pwm13/pwm13m0-pins;
    pwm14m0_pins = /pinctrl/pwm14/pwm14m0-pins;
    pwm15m0_pins = /pinctrl/pwm15/pwm15m0-pins;
    scr_pins = /pinctrl/scr/scr-pins;
    sdmmc0_bus4 = /pinctrl/sdmmc0/sdmmc0-bus4;
    sdmmc0_clk = /pinctrl/sdmmc0/sdmmc0-clk;
    sdmmc0_cmd = /pinctrl/sdmmc0/sdmmc0-cmd;
    sdmmc0_det = /pinctrl/sdmmc0/sdmmc0-det;
    sdmmc1_bus4 = /pinctrl/sdmmc1/sdmmc1-bus4;
    sdmmc1_clk = /pinctrl/sdmmc1/sdmmc1-clk;
    sdmmc1_cmd = /pinctrl/sdmmc1/sdmmc1-cmd;
    spdifm1_tx = /pinctrl/spdif/spdifm1-tx;
    spi0m0_pins = /pinctrl/spi0/spi0m0-pins;
    spi0m0_cs0 = /pinctrl/spi0/spi0m0-cs0;
    spi0m0_cs1 = /pinctrl/spi0/spi0m0-cs1;
    spi1m0_pins = /pinctrl/spi1/spi1m0-pins;
    spi1m0_cs0 = /pinctrl/spi1/spi1m0-cs0;
    spi1m0_cs1 = /pinctrl/spi1/spi1m0-cs1;
    spi2m0_pins = /pinctrl/spi2/spi2m0-pins;
    spi2m0_cs0 = /pinctrl/spi2/spi2m0-cs0;
    spi2m0_cs1 = /pinctrl/spi2/spi2m0-cs1;
    spi3m0_pins = /pinctrl/spi3/spi3m0-pins;
    spi3m0_cs0 = /pinctrl/spi3/spi3m0-cs0;
    spi3m0_cs1 = /pinctrl/spi3/spi3m0-cs1;
    tsadc_shutorg = /pinctrl/tsadc/tsadc-shutorg;
    uart0_xfer = /pinctrl/uart0/uart0-xfer;
    uart1m0_xfer = /pinctrl/uart1/uart1m0-xfer;
    uart1m0_ctsn = /pinctrl/uart1/uart1m0-ctsn;
    uart1m0_rtsn = /pinctrl/uart1/uart1m0-rtsn;
    uart2m0_xfer = /pinctrl/uart2/uart2m0-xfer;
    uart3m1_xfer = /pinctrl/uart3/uart3m1-xfer;
    uart4m1_xfer = /pinctrl/uart4/uart4m1-xfer;
    uart5m0_xfer = /pinctrl/uart5/uart5m0-xfer;
    uart6m0_xfer = /pinctrl/uart6/uart6m0-xfer;
    uart7m0_xfer = /pinctrl/uart7/uart7m0-xfer;
    uart8m0_xfer = /pinctrl/uart8/uart8m0-xfer;
    uart9m0_xfer = /pinctrl/uart9/uart9m0-xfer;
    spi0m0_pins_hs = /pinctrl/spi0-hs/spi0m0-pins;
    spi1m0_pins_hs = /pinctrl/spi1-hs/spi1m0-pins;
    spi2m0_pins_hs = /pinctrl/spi2-hs/spi2m0-pins;
    spi3m0_pins_hs = /pinctrl/spi3-hs/spi3m0-pins;
    tsadc_gpio_func = /pinctrl/gpio-func/tsadc-gpio-func;
    mxc6655xa_irq_gpio = /pinctrl/mxc6655xa/mxc6655xa_irq_gpio;
    touch_gpio = /pinctrl/touch/touch-gpio;
    wifi_enable_h = /pinctrl/sdio-pwrseq/wifi-enable-h;
    vcc5v0_host_en = /pinctrl/usb/vcc5v0-host-en;
    vcc5v0_otg_en = /pinctrl/usb/vcc5v0-otg-en;
    uart8_gpios = /pinctrl/wireless-bluetooth/uart8-gpios;
    uart1_gpios = /pinctrl/wireless-bluetooth/uart1-gpios;
    hp_det = /pinctrl/headphone/hp-det;
    wifi_host_wake_irq = /pinctrl/wireless-wlan/wifi-host-wake-irq;
    lcd0_rst_gpio = /pinctrl/lcd0/lcd0-rst-gpio;
    lcd1_rst_gpio = /pinctrl/lcd1/lcd1-rst-gpio;
    adc_keys = /adc-keys;
    audiopwmout_diff = /audiopwmout-diff;
    master = /audiopwmout-diff/simple-audio-card,codec;
    backlight = /backlight;
    backlight1 = /backlight1;
    dc_12v = /dc-12v;
    hdmi_sound = /hdmi-sound;
    leds = /leds;
    work_led = /leds/work;
    test_led = /leds/test;
    misc = /gpio_control;
    pdmics = /dummy-codec;
    pdm_mic_array = /pdm-mic-array;
    rk809_sound = /rk809-sound;
    spdif_out = /spdif-out;
    vad_sound = /vad-sound;
    vcc3v3_sys = /vcc3v3-sys;
    vcc5v0_sys = /vcc5v0-sys;
    vcc5v0_usb = /vcc5v0-usb;
    vcc5v0_host = /vcc5v0-host-regulator;
    vcc5v0_otg = /vcc5v0-otg-regulator;
    vcc3v3_lcd0_n = /vcc3v3-lcd0-n;
    vcc3v3_lcd1_n = /vcc3v3-lcd1-n;
    sdio_pwrseq = /sdio-pwrseq;
    wireless_wlan = /wireless-wlan;
    wireless_bluetooth = /wireless-bluetooth;
    rk_headset = /rk-headset;
    vcc_camera = /vcc-camera-regulator;
    vcc3v3_pcie = /gpio-regulator;
    chosen = /chosen;
    debug = /debug@fd904000;
    cspmu = /cspmu@fd90c000;
  };
};
